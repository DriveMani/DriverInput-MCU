AUTOSAR XML (schema 4-3-0)
package /Interface
  4 x sender receiver interface:
    If_DriverInputValidatedData
      5 x data:
        BrakeSw: type=boolean
        AccelSw: type=boolean
        SocLevel: type=uint8
        VehicleSpeed: type=uint8
        DriverInputFault: type=boolean
    If_VcuToDrv
      data RegenLevel: type=uint8
      data RegenEnable: type=boolean
      data LimitReason: type=uint8
    If_DrvToVcu
      6 x data:
        BrakeSw: type=boolean
        AccelSw: type=boolean
        SocLevel: type=uint8
        VehicleSpeed: type=uint8
        DriverInputFault: type=boolean
        AliveCounter: type=uint8
    If_DriverInputData
      5 x data:
        BrakeSw: type=boolean
        AccelSw: type=boolean
        SocLevel: type=uint8
        VehicleSpeed: type=uint8
        ReadStatus: type=boolean
