AUTOSAR XML (schema 4-0-3)
package /AUTOSAR
  composition sw component type CSWC_RootCompostion
    13 x component:
      SWC_Actuator: type=SWC_Actuator
      SWC_AppMode: type=SWC_AppMode
      SWC_CanCom: type=SWC_CanCom
      SWC_ComM: type=SWC_ComM
      SWC_DiagnosticMonitor: type=SWC_DiagnosticMonitor
      SWC_DiagnosticService: type=SWC_DiagnosticService
      SWC_HwInput: type=SWC_HwInput
      SWC_ErrM: type=SWC_ErrM
      SWC_InputDiag: type=SWC_InputDiag
      SWC_LedCtrl: type=SWC_LedCtrl
      SWC_TestModeManager: type=SWC_TestModeManager
      SWC_TestModeUser: type=SWC_TestModeUser
      SWC_WdgMTest: type=SWC_WdgMTest
    connect SWC_InputDiag.P_DriverInputValidatedData -> SWC_CanCom.R_DriverInputValidatedData
    connect SWC_InputDiag.P_DriverInputValidatedData -> SWC_LedCtrl.R_DriverInputValidatedData
    connect SWC_HwInput.P_DriverInputData -> SWC_InputDiag.R_DriverInput
    connect SWC_CanCom.P_VcuToDrv -> SWC_LedCtrl.R_VcuToDrv
