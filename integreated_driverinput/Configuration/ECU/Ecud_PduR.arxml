AUTOSAR XML (schema 4-0-3)
package /AUTOSAR
  module config PduR: implementation-config-variant=VARIANT-PRE-COMPILE, module-description=BswImplementation_PduR
    4 x PduRBswModules, all with PduRChangeParameterRequestApi=0, PduRRetransmission=0, PduRTxConfirmation=1, PduRUseTag=0:
      PduRBswModules_CanIf: PduRCancelReceive=0, PduRCancelTransmit=0, PduRCommunicationInterface=1, PduRLowerModule=1, PduRTransportProtocol=0, PduRTriggertransmit=0, PduRUpperModule=0, PduRBswModuleRef=CanIf
      PduRBswModules_Com: PduRCancelReceive=0, PduRCancelTransmit=0, PduRCommunicationInterface=1, PduRLowerModule=0, PduRTransportProtocol=1, PduRTriggertransmit=1, PduRUpperModule=1, PduRBswModuleRef=Com
      PduRBswModules_Dcm: PduRCancelReceive=1, PduRCancelTransmit=1, PduRCommunicationInterface=0, PduRLowerModule=0, PduRTransportProtocol=1, PduRTriggertransmit=0, PduRUpperModule=1, PduRBswModuleRef=Dcm
      PduRBswModules_CanTp: PduRCancelReceive=1, PduRCancelTransmit=1, PduRCommunicationInterface=0, PduRLowerModule=1, PduRTransportProtocol=1, PduRTriggertransmit=0, PduRUpperModule=0, PduRBswModuleRef=CanTp
    PduRGeneral: PduRDevErrorDetect=1, PduRVersionInfoApi=0, PduRZeroCostOperation=0
    PduRRoutingTables: PduRConfigurationId=0
      PduRRoutingTable: category=TOOL_CONFIGURED, PduRIsMinimumRouting=0
        25 x PduRRoutingPath, all with category=TOOL_CONFIGURED:
          IN_Project_VCURegenStatus_RoutingPath
            PduR_Project_VCURegenStatus_DestPdu (PduRDestPdu): category=TOOL_CONFIGURED, PduRDestPduHandleId=0, PduRTransmissionConfirmation=1, PduRDestPduRef=Pdu_ISignalIPdu_Project_VCURegenStatus
            PduR_Project_VCURegenStatus_SrcPdu (PduRSrcPdu): category=TOOL_CONFIGURED, PduRSourcePduHandleId=0, PduRSrcPduRef=Pdu_ISignalIPdu_Project_VCURegenStatus
          IN_Project_GST_Msg_TP2_RoutingPath
            PduR_Project_GST_Msg_TP2_DestPdu (PduRDestPdu): category=TOOL_CONFIGURED, PduRDestPduHandleId=0, PduRTransmissionConfirmation=1, PduRDestPduRef=Pdu_ISignalIPdu_Project_GST_Msg_TP2
            PduR_Project_GST_Msg_TP2_SrcPdu (PduRSrcPdu): category=TOOL_CONFIGURED, PduRSourcePduHandleId=0, PduRSrcPduRef=Pdu_ISignalIPdu_Project_GST_Msg_TP2
          IN_Project_GST_Msg_TP1_RoutingPath
            PduR_Project_GST_Msg_TP1_DestPdu (PduRDestPdu): category=TOOL_CONFIGURED, PduRDestPduHandleId=1, PduRTransmissionConfirmation=1, PduRDestPduRef=Pdu_ISignalIPdu_Project_GST_Msg_TP1
            PduR_Project_GST_Msg_TP1_SrcPdu (PduRSrcPdu): category=TOOL_CONFIGURED, PduRSourcePduHandleId=1, PduRSrcPduRef=Pdu_ISignalIPdu_Project_GST_Msg_TP1
          IN_Project_GST_Msg_TP_Phys_RoutingPath
            PduR_DcmIPdu_Project_GST_Msg_TP_Phys_DestPdu (PduRDestPdu): category=TOOL_CONFIGURED, PduRDestPduHandleId=2, PduRTransmissionConfirmation=1, PduRDestPduRef=Pdu_DcmIPdu_Project_GST_Msg_TP_Phys
            PduR_DcmIPdu_Project_GST_Msg_TP_Phys_SrcPdu (PduRSrcPdu): category=TOOL_CONFIGURED, PduRSourcePduHandleId=2, PduRSrcPduRef=Pdu_DcmIPdu_Project_GST_Msg_TP_Phys
          IN_Project_ECU2_Msg_PIF1_RoutingPath
            PduR_Project_ECU2_Msg_PIF1_DestPdu (PduRDestPdu): category=TOOL_CONFIGURED, PduRDestPduHandleId=1, PduRTransmissionConfirmation=1, PduRDestPduRef=Pdu_ISignalIPdu_Project_ECU2_Msg_PIF1
            PduR_Project_ECU2_Msg_PIF1_SrcPdu (PduRSrcPdu): category=TOOL_CONFIGURED, PduRSourcePduHandleId=1, PduRSrcPduRef=Pdu_ISignalIPdu_Project_ECU2_Msg_PIF1
          IN_Project_ECU2_Msg_POE1_RoutingPath
            PduR_Project_ECU2_Msg_POE1_DestPdu (PduRDestPdu): category=TOOL_CONFIGURED, PduRDestPduHandleId=2, PduRTransmissionConfirmation=1, PduRDestPduRef=Pdu_ISignalIPdu_Project_ECU2_Msg_POE1
            PduR_Project_ECU2_Msg_POE1_SrcPdu (PduRSrcPdu): category=TOOL_CONFIGURED, PduRSourcePduHandleId=2, PduRSrcPduRef=Pdu_ISignalIPdu_Project_ECU2_Msg_POE1
          IN_Project_ECU2_Msg_OE1_RoutingPath
            PduR_Project_ECU2_Msg_OE1_DestPdu (PduRDestPdu): category=TOOL_CONFIGURED, PduRDestPduHandleId=3, PduRTransmissionConfirmation=1, PduRDestPduRef=Pdu_ISignalIPdu_Project_ECU2_Msg_OE1
            PduR_Project_ECU2_Msg_OE1_SrcPdu (PduRSrcPdu): category=TOOL_CONFIGURED, PduRSourcePduHandleId=3, PduRSrcPduRef=Pdu_ISignalIPdu_Project_ECU2_Msg_OE1
          IN_Project_ECU2_Msg_P1_RoutingPath
            PduR_Project_ECU2_Msg_P1_DestPdu (PduRDestPdu): category=TOOL_CONFIGURED, PduRDestPduHandleId=4, PduRTransmissionConfirmation=1, PduRDestPduRef=Pdu_ISignalIPdu_Project_ECU2_Msg_P1
            PduR_Project_ECU2_Msg_P1_SrcPdu (PduRSrcPdu): category=TOOL_CONFIGURED, PduRSourcePduHandleId=4, PduRSrcPduRef=Pdu_ISignalIPdu_Project_ECU2_Msg_P1
          IN_Project_GST_Msg_TP_Func_RoutingPath
            PduR_DcmIPdu_Project_GST_Msg_TP_Func_DestPdu (PduRDestPdu): category=TOOL_CONFIGURED, PduRDestPduHandleId=3, PduRTransmissionConfirmation=1, PduRDestPduRef=Pdu_DcmIPdu_Project_GST_Msg_TP_Func
            PduR_DcmIPdu_Project_GST_Msg_TP_Func_SrcPdu (PduRSrcPdu): category=TOOL_CONFIGURED, PduRSourcePduHandleId=3, PduRSrcPduRef=Pdu_DcmIPdu_Project_GST_Msg_TP_Func
          OUT_Project_DriverStatus_RoutingPath
            PduR_Project_DriverStatus_DestPdu (PduRDestPdu): category=TOOL_CONFIGURED, PduRDestPduHandleId=0, PduRTransmissionConfirmation=1, PduRDestPduRef=Pdu_ISignalIPdu_Project_DriverStatus
            PduR_Project_DriverStatus_SrcPdu (PduRSrcPdu): category=TOOL_CONFIGURED, PduRSourcePduHandleId=0, PduRSrcPduRef=Pdu_ISignalIPdu_Project_DriverStatus
          OUT_Project_ECU1_GST_Msg_TP_RoutingPath
            PduR_DcmIPdu_Project_ECU1_GST_Msg_TP_DestPdu (PduRDestPdu): category=TOOL_CONFIGURED, PduRDestPduHandleId=0, PduRTransmissionConfirmation=1, PduRDestPduRef=Pdu_DcmIPdu_Project_ECU1_GST_Msg_TP
            PduR_DcmIPdu_Project_ECU1_GST_Msg_TP_SrcPdu (PduRSrcPdu): category=TOOL_CONFIGURED, PduRSourcePduHandleId=1, PduRSrcPduRef=Pdu_DcmIPdu_Project_ECU1_GST_Msg_TP
          OUT_Project_ECU1_Msg_GW1_RoutingPath
            PduR_Project_ECU1_Msg_GW1_DestPdu (PduRDestPdu): category=TOOL_CONFIGURED, PduRDestPduHandleId=1, PduRTransmissionConfirmation=1, PduRDestPduRef=Pdu_ISignalIPdu_Project_ECU1_Msg_GW1
            PduR_Project_ECU1_Msg_GW1_SrcPdu (PduRSrcPdu): category=TOOL_CONFIGURED, PduRSourcePduHandleId=2, PduRSrcPduRef=Pdu_ISignalIPdu_Project_ECU1_Msg_GW1
          OUT_Project_ECU1_Msg_TP2_RoutingPath
            PduR_Project_ECU1_Msg_TP2_DestPdu (PduRDestPdu): category=TOOL_CONFIGURED, PduRDestPduHandleId=1, PduRTransmissionConfirmation=1, PduRDestPduRef=Pdu_ISignalIPdu_Project_ECU1_Msg_TP2
            PduR_Project_ECU1_Msg_TP2_SrcPdu (PduRSrcPdu): category=TOOL_CONFIGURED, PduRSourcePduHandleId=3, PduRSrcPduRef=Pdu_ISignalIPdu_Project_ECU1_Msg_TP2
          OUT_Project_ECU1_Msg_IF1_RoutingPath
            PduR_Project_ECU1_Msg_IF1_DestPdu (PduRDestPdu): category=TOOL_CONFIGURED, PduRDestPduHandleId=2, PduRTransmissionConfirmation=1, PduRDestPduRef=Pdu_ISignalIPdu_Project_ECU1_Msg_IF1
            PduR_Project_ECU1_Msg_IF1_SrcPdu (PduRSrcPdu): category=TOOL_CONFIGURED, PduRSourcePduHandleId=4, PduRSrcPduRef=Pdu_ISignalIPdu_Project_ECU1_Msg_IF1
          OUT_Project_ECU1_Msg_POE3_RoutingPath
            PduR_Project_ECU1_Msg_POE3_DestPdu (PduRDestPdu): category=TOOL_CONFIGURED, PduRDestPduHandleId=3, PduRTransmissionConfirmation=1, PduRDestPduRef=Pdu_ISignalIPdu_Project_ECU1_Msg_POE3
            PduR_Project_ECU1_Msg_POE3_SrcPdu (PduRSrcPdu): category=TOOL_CONFIGURED, PduRSourcePduHandleId=5, PduRSrcPduRef=Pdu_ISignalIPdu_Project_ECU1_Msg_POE3
          OUT_Project_ECU1_Msg_TP1_RoutingPath
            PduR_Project_ECU1_Msg_TP1_DestPdu (PduRDestPdu): category=TOOL_CONFIGURED, PduRDestPduHandleId=2, PduRTransmissionConfirmation=1, PduRDestPduRef=Pdu_ISignalIPdu_Project_ECU1_Msg_TP1
            PduR_Project_ECU1_Msg_TP1_SrcPdu (PduRSrcPdu): category=TOOL_CONFIGURED, PduRSourcePduHandleId=6, PduRSrcPduRef=Pdu_ISignalIPdu_Project_ECU1_Msg_TP1
          OUT_Project_ECU1_Msg_P4_RoutingPath
            PduR_Project_ECU1_Msg_P4_DestPdu (PduRDestPdu): category=TOOL_CONFIGURED, PduRDestPduHandleId=4, PduRTransmissionConfirmation=1, PduRDestPduRef=Pdu_ISignalIPdu_Project_ECU1_Msg_P4
            PduR_Project_ECU1_Msg_P4_SrcPdu (PduRSrcPdu): category=TOOL_CONFIGURED, PduRSourcePduHandleId=7, PduRSrcPduRef=Pdu_ISignalIPdu_Project_ECU1_Msg_P4
          OUT_Project_ECU1_Msg_P3_RoutingPath
            PduR_Project_ECU1_Msg_P3_DestPdu (PduRDestPdu): category=TOOL_CONFIGURED, PduRDestPduHandleId=5, PduRTransmissionConfirmation=1, PduRDestPduRef=Pdu_ISignalIPdu_Project_ECU1_Msg_P3
            PduR_Project_ECU1_Msg_P3_SrcPdu (PduRSrcPdu): category=TOOL_CONFIGURED, PduRSourcePduHandleId=8, PduRSrcPduRef=Pdu_ISignalIPdu_Project_ECU1_Msg_P3
          OUT_Project_ECU1_Msg_PIF1_RoutingPath
            PduR_Project_ECU1_Msg_PIF1_DestPdu (PduRDestPdu): category=TOOL_CONFIGURED, PduRDestPduHandleId=6, PduRTransmissionConfirmation=1, PduRDestPduRef=Pdu_ISignalIPdu_Project_ECU1_Msg_PIF1
            PduR_Project_ECU1_Msg_PIF1_SrcPdu (PduRSrcPdu): category=TOOL_CONFIGURED, PduRSourcePduHandleId=9, PduRSrcPduRef=Pdu_ISignalIPdu_Project_ECU1_Msg_PIF1
          OUT_Project_ECU1_Msg_P2_RoutingPath
            PduR_Project_ECU1_Msg_P2_DestPdu (PduRDestPdu): category=TOOL_CONFIGURED, PduRDestPduHandleId=7, PduRTransmissionConfirmation=1, PduRDestPduRef=Pdu_ISignalIPdu_Project_ECU1_Msg_P2
            PduR_Project_ECU1_Msg_P2_SrcPdu (PduRSrcPdu): category=TOOL_CONFIGURED, PduRSourcePduHandleId=10, PduRSrcPduRef=Pdu_ISignalIPdu_Project_ECU1_Msg_P2
          OUT_Project_ECU1_Msg_P1_RoutingPath
            PduR_Project_ECU1_Msg_P1_DestPdu (PduRDestPdu): category=TOOL_CONFIGURED, PduRDestPduHandleId=8, PduRTransmissionConfirmation=1, PduRDestPduRef=Pdu_ISignalIPdu_Project_ECU1_Msg_P1
            PduR_Project_ECU1_Msg_P1_SrcPdu (PduRSrcPdu): category=TOOL_CONFIGURED, PduRSourcePduHandleId=11, PduRSrcPduRef=Pdu_ISignalIPdu_Project_ECU1_Msg_P1
          OUT_Project_ECU1_Msg_POE2_RoutingPath
            PduR_Project_ECU1_Msg_POE2_DestPdu (PduRDestPdu): category=TOOL_CONFIGURED, PduRDestPduHandleId=9, PduRTransmissionConfirmation=1, PduRDestPduRef=Pdu_ISignalIPdu_Project_ECU1_Msg_POE2
            PduR_Project_ECU1_Msg_POE2_SrcPdu (PduRSrcPdu): category=TOOL_CONFIGURED, PduRSourcePduHandleId=12, PduRSrcPduRef=Pdu_ISignalIPdu_Project_ECU1_Msg_POE2
          OUT_Project_ECU1_Msg_POE1_RoutingPath
            PduR_Project_ECU1_Msg_POE1_DestPdu (PduRDestPdu): category=TOOL_CONFIGURED, PduRDestPduHandleId=10, PduRTransmissionConfirmation=1, PduRDestPduRef=Pdu_ISignalIPdu_Project_ECU1_Msg_POE1
            PduR_Project_ECU1_Msg_POE1_SrcPdu (PduRSrcPdu): category=TOOL_CONFIGURED, PduRSourcePduHandleId=13, PduRSrcPduRef=Pdu_ISignalIPdu_Project_ECU1_Msg_POE1
          OUT_Project_ECU1_Msg_OE2_RoutingPath
            PduR_Project_ECU1_Msg_OE2_DestPdu (PduRDestPdu): category=TOOL_CONFIGURED, PduRDestPduHandleId=11, PduRTransmissionConfirmation=1, PduRDestPduRef=Pdu_ISignalIPdu_Project_ECU1_Msg_OE2
            PduR_Project_ECU1_Msg_OE2_SrcPdu (PduRSrcPdu): category=TOOL_CONFIGURED, PduRSourcePduHandleId=14, PduRSrcPduRef=Pdu_ISignalIPdu_Project_ECU1_Msg_OE2
          OUT_Project_ECU1_Msg_OE1_RoutingPath
            PduR_Project_ECU1_Msg_OE1_DestPdu (PduRDestPdu): category=TOOL_CONFIGURED, PduRDestPduHandleId=12, PduRTransmissionConfirmation=1, PduRDestPduRef=Pdu_ISignalIPdu_Project_ECU1_Msg_OE1
            PduR_Project_ECU1_Msg_OE1_SrcPdu (PduRSrcPdu): category=TOOL_CONFIGURED, PduRSourcePduHandleId=15, PduRSrcPduRef=Pdu_ISignalIPdu_Project_ECU1_Msg_OE1
