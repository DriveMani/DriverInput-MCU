AUTOSAR XML (schema 4-0-3)
package /Can
  module config Can: implementation-config-variant=VARIANT-POST-BUILD, module-description=BswImplementation_Can
    NonAutosar: CanDisableDemReportErrorStatus=0, CanApiErrorStatus=0, CanApiCheckTxCancel=0
    CanConfigSet
      ECU1_Project (CanController):
        category = TOOL_CONFIGURED
        CanHwChannel = FlexCAN_B
        CanControllerActivation = 1
        CanControllerBaseAddress = 0
        CanControllerId = 0
        CanRxProcessing = Interrupt
        CanTxProcessing = Interrupt
        CanBusoffProcessing = Interrupt
        CanWakeupProcessing = Interrupt
        CanBccSupport = 0
        CanWakeupSupport = 0
        CanListenOnlyMode = 0
        CanLoopBackMode = 0
        CanSoftwareBusOffRecovery = 1
        CanAutoBusOffRecovery = 0
        CanTrippleSamplingEnable = 0
        CanWakeUpSourceFilter = 0
        CanLowestBuffTransmitFirst = 0
        CanLocalPriorityEn = 0
        CanWarningEnable = 0
        CanClockFromBus = 0
        CanControllerRxFifoEnable = 0
        CanRxFifoWarningNotification = NULL_PTR
        CanRxFifoOverflowNotification = NULL_PTR
        CanErrorControllerNotifEn = 0
        CanErrorControllerNotification = NULL_PTR
        CanControllerDefaultBaudrate = CanControllerBaudrateConfig
        CanControllerBaudrateConfig:
          category = TOOL_CONFIGURED
          CanControllerCheckCanStandard = 1
          CanAdvancedSetting = 0
          CanBusLength = 40
          CanPropDelayTranceiver = 150
          CanControllerPrescaller = 1
          CanControllerPrescaller_Alt = 1
          CanControllerBaudRate = 500
          CanControllerPropSeg = 2
          CanControllerSeg1 = 7
          CanControllerSeg2 = 3
          CanControllerSyncJumpWidth = 3
        DefaultFilterMask (CanFilterMask): category=TOOL_CONFIGURED, CanFilterMaskValue=2047
        DefaultExtFilterMask (CanFilterMask): category=TOOL_CONFIGURED, CanFilterMaskValue=536870911
      25 x CanHardwareObject, all with category=TOOL_CONFIGURED, CanHandleType=FULL, CanIdType=STANDARD, CanMBPrio=0, CanControllerRef=ECU1_Project:
        IN_HwObj_ECU1_Project_0x7df_Project_GST_Msg_TP_Func: CanIdValue=2015, CanObjectType=RECEIVE, CanObjectId=0, CanFilterMaskRef=DefaultFilterMask
        IN_HwObj_ECU1_Project_0x76d_Project_VCURegenStatus: CanIdValue=1901, CanObjectType=RECEIVE, CanObjectId=1, CanFilterMaskRef=DefaultFilterMask
        IN_HwObj_ECU1_Project_0x707_Project_GST_Msg_TP2: CanIdValue=1799, CanObjectType=RECEIVE, CanObjectId=2, CanFilterMaskRef=DefaultFilterMask
        IN_HwObj_ECU1_Project_0x706_Project_GST_Msg_TP1: CanIdValue=1798, CanObjectType=RECEIVE, CanObjectId=3, CanFilterMaskRef=DefaultFilterMask
        IN_HwObj_ECU1_Project_0x703_Project_GST_Msg_TP_Phys: CanIdValue=1795, CanObjectType=RECEIVE, CanObjectId=4, CanFilterMaskRef=DefaultFilterMask
        IN_HwObj_ECU1_Project_0x503_Project_ECU2_Msg_P1: CanIdValue=1283, CanObjectType=RECEIVE, CanObjectId=5, CanFilterMaskRef=DefaultFilterMask
        IN_HwObj_ECU1_Project_0x301_Project_ECU2_Msg_PIF1: CanIdValue=769, CanObjectType=RECEIVE, CanObjectId=6, CanFilterMaskRef=DefaultFilterMask
        IN_HwObj_ECU1_Project_0x103_Project_ECU2_Msg_POE1: CanIdValue=259, CanObjectType=RECEIVE, CanObjectId=7, CanFilterMaskRef=DefaultFilterMask
        IN_HwObj_ECU1_Project_0x3_Project_ECU2_Msg_OE1: CanIdValue=3, CanObjectType=RECEIVE, CanObjectId=8, CanFilterMaskRef=DefaultFilterMask
        OUT_HwObj_ECU1_Project_0x1_Project_ECU1_Msg_OE1: CanIdValue=1, CanObjectType=TRANSMIT, CanObjectId=9
        OUT_HwObj_ECU1_Project_0x2_Project_ECU1_Msg_OE2: CanIdValue=2, CanObjectType=TRANSMIT, CanObjectId=10
        OUT_HwObj_ECU1_Project_0x55_Project_ECU1_Msg_GW1: CanIdValue=85, CanObjectType=TRANSMIT, CanObjectId=11
        OUT_HwObj_ECU1_Project_0x100_Project_ECU1_Msg_POE3: CanIdValue=256, CanObjectType=TRANSMIT, CanObjectId=12
        OUT_HwObj_ECU1_Project_0x101_Project_ECU1_Msg_POE1: CanIdValue=257, CanObjectType=TRANSMIT, CanObjectId=13
        OUT_HwObj_ECU1_Project_0x102_Project_ECU1_Msg_POE2: CanIdValue=258, CanObjectType=TRANSMIT, CanObjectId=14
        OUT_HwObj_ECU1_Project_0x200_Project_ECU1_Msg_IF1: CanIdValue=512, CanObjectType=TRANSMIT, CanObjectId=15
        OUT_HwObj_ECU1_Project_0x300_Project_ECU1_Msg_PIF1: CanIdValue=768, CanObjectType=TRANSMIT, CanObjectId=16
        OUT_HwObj_ECU1_Project_0x501_Project_ECU1_Msg_P1: CanIdValue=1281, CanObjectType=TRANSMIT, CanObjectId=17
        OUT_HwObj_ECU1_Project_0x502_Project_ECU1_Msg_P2: CanIdValue=1282, CanObjectType=TRANSMIT, CanObjectId=18
        OUT_HwObj_ECU1_Project_0x601_Project_ECU1_Msg_P3: CanIdValue=1537, CanObjectType=TRANSMIT, CanObjectId=19
        OUT_HwObj_ECU1_Project_0x602_Project_ECU1_Msg_P4: CanIdValue=1538, CanObjectType=TRANSMIT, CanObjectId=20
        OUT_HwObj_ECU1_Project_0x701_Project_ECU1_Msg_TP1: CanIdValue=1793, CanObjectType=TRANSMIT, CanObjectId=21
        OUT_HwObj_ECU1_Project_0x704_Project_ECU1_Msg_TP2: CanIdValue=1796, CanObjectType=TRANSMIT, CanObjectId=22
        OUT_HwObj_ECU1_Project_0x705_Project_ECU1_GST_Msg_TP: CanIdValue=1797, CanObjectType=TRANSMIT, CanObjectId=23
        OUT_HwObj_ECU1_Project_0x76c_Project_DriverStatus: CanIdValue=1900, CanObjectType=TRANSMIT, CanObjectId=24
    CanGeneral:
      CanChangeBaudrateApi = 0
      CanDevErrorDetection = 1
      CanVersionInfoApi = 0
      CanIndex = 0
      CanMainFunctionBusoffPeriod = 0.0010
      CanMainFunctionWakeupPeriod = 0.0010
      CanMainFunctionModePeriod = 0.001
      CanMultiplexedTransmission = 1
      CanHardwareCancellation = 0
      CanIdenticalIdCancellation = 1
      CanTimeoutDuration = 20000
      CanCrystalFrequencyHz = 8000000
      CanCodeSizeOptimization = 0
      CanExtendedIDSupport = 0
      CanMBCountExtensionSupport = 0
      CanApiEnableMbAbort = 0
      CanAbortOnlyOneMB = 0
      CanEnableDualClockMode = 0
      CanCounterRef = OsCounter_0
      CanMainFunctionRWPeriods: category=TOOL_CONFIGURED
        CanMainFunctionReadPeriod_0 (CanMainFunctionReadPeriod): CanMainFunctionReadPeriod=0.0010
        CanMainFunctionWritePeriod_0 (CanMainFunctionWritePeriod): CanMainFunctionWritePeriod=0.0010
    CommonPublishedInformation:
      ArReleaseMajorVersion = 4
      ArReleaseMinorVersion = 0
      ArReleaseRevisionVersion = 3
      ModuleId = 80
      SwMajorVersion = 1
      SwMinorVersion = 0
      VendorId = 43
      SwPatchVersion = 1
