AUTOSAR XML (schema 4-0-3)
package /AUTOSAR
  module config BswM: implementation-config-variant=VARIANT-PRE-COMPILE, module-description=BswImplementation_BswM
    BswMGeneral:
      BswMMainFunctionPeriod = 0.01
      BswMComMEnabled = 1
      BswMCanSMEnabled = 1
      BswMDcmEnabled = 1
      BswMLinSMEnabled = 0
      BswMEcuMEnabled = 1
      BswMNvMEnabled = 1
      BswMSchMEnabled = 1
      BswMGenericRequestEnabled = 1
      BswMJ1939NmEnabled = 0
      BswMDevErrorDetect = 1
      BswMEthSMEnabled = 0
      BswMFrSMEnabled = 0
      BswMLinTPEnabled = 0
      BswMWdgMEnabled = 1
      BswMJ1939DcmEnabled = 0
      BswMVersionInfoApi = 0
      BswMUserIncludeFiles:
        category = TOOL_CONFIGURED
        BswMUserIncludeFile = Com.h
        BswMUserIncludeFile = ComM.h
        BswMUserIncludeFile = Dem.h
        BswMUserIncludeFile = EcuM.h
        BswMUserIncludeFile = FiM.h
        BswMUserIncludeFile = Mem_Integration.h
        BswMUserIncludeFile = Rte_Main.h
        BswMUserIncludeFile = WdgM.h
    BswMConfig
      BswMArbitration: category=TOOL_CONFIGURED
        19 x BswMModeRequestPort, all with category=TOOL_CONFIGURED, BswMRequestProcessing=BSWM_IMMEDIATE:
          MRP_IMM_BswModeNotification_modeNotificationPort_DcmCommunicationControl_0
            BswMModeRequestSource: category=TOOL_CONFIGURED
              BswMBswModeNotification: category=TOOL_CONFIGURED, BswMBswModeDeclarationGroupPrototypeRef=modeNotificationPort_DcmCommunicationControl_0
            BswMModeInitValue: category=TOOL_CONFIGURED
              BswMSwcModeInitValue: category=TOOL_CONFIGURED, BswMSwcModeInitValueRef=DCM_ENABLE_RX_TX_NORM_NM
          MRP_IMM_BswModeNotification_modeNotificationPort_DcmControlDTCSetting
            BswMModeRequestSource: category=TOOL_CONFIGURED
              BswMBswModeNotification: category=TOOL_CONFIGURED, BswMBswModeDeclarationGroupPrototypeRef=modeNotificationPort_DcmControlDTCSetting
            BswMModeInitValue: category=TOOL_CONFIGURED
              BswMSwcModeInitValue: category=TOOL_CONFIGURED, BswMSwcModeInitValueRef=ENABLEDTCSETTING
          MRP_IMM_BswModeNotification_modeNotificationPort_DcmDiagnosticSessionControl
            BswMModeRequestSource: category=TOOL_CONFIGURED
              BswMBswModeNotification: category=TOOL_CONFIGURED, BswMBswModeDeclarationGroupPrototypeRef=modeNotificationPort_DcmDiagnosticSessionControl
            BswMModeInitValue: category=TOOL_CONFIGURED
              BswMSwcModeInitValue: category=TOOL_CONFIGURED, BswMSwcModeInitValueRef=DCM_DEFAULT_SESSION
          MRP_IMM_BswModeNotification_modeNotificationPort_DcmEcuReset
            BswMModeRequestSource: category=TOOL_CONFIGURED
              BswMBswModeNotification: category=TOOL_CONFIGURED, BswMBswModeDeclarationGroupPrototypeRef=modeNotificationPort_DcmEcuReset
            BswMModeInitValue: category=TOOL_CONFIGURED
              BswMSwcModeInitValue: category=TOOL_CONFIGURED, BswMSwcModeInitValueRef=NONE
          MRP_IMM_BswModeNotification_modeNotificationPort_DcmModeRapidPowerShutDown
            BswMModeRequestSource: category=TOOL_CONFIGURED
              BswMBswModeNotification: category=TOOL_CONFIGURED, BswMBswModeDeclarationGroupPrototypeRef=modeNotificationPort_DcmModeRapidPowerShutDown
            BswMModeInitValue: category=TOOL_CONFIGURED
              BswMSwcModeInitValue: category=TOOL_CONFIGURED, BswMSwcModeInitValueRef=ENABLE_RAPIDPOWERSHUTDOWN
          MRP_IMM_CanSMIndication_Project
            BswMModeRequestSource: category=TOOL_CONFIGURED
              BswMCanSMIndication: category=TOOL_CONFIGURED, BswMCanSMChannelRef=ComMChannel_Project
            BswMModeInitValue: category=TOOL_CONFIGURED
              BswMBswModeInitValue: category=TOOL_CONFIGURED, BswMBswModeInitValueMode=CANSM_BSWM_NO_COMMUNICATION
          MRP_IMM_ComMIndication_Project
            BswMModeRequestSource: category=TOOL_CONFIGURED
              BswMComMIndication: category=TOOL_CONFIGURED, BswMComMChannelRef=ComMChannel_Project
            BswMModeInitValue: category=TOOL_CONFIGURED
              BswMBswModeInitValue: category=TOOL_CONFIGURED, BswMBswModeInitValueMode=COMM_NO_COMMUNICATION
          MRP_IMM_DcmComModeRequest_Project
            BswMModeRequestSource: category=TOOL_CONFIGURED
              BswMDcmComModeRequest: category=TOOL_CONFIGURED, BswMDcmComMChannelRef=ComMChannel_Project
            BswMModeInitValue: category=TOOL_CONFIGURED
              BswMBswModeInitValue: category=TOOL_CONFIGURED, BswMBswModeInitValueMode=DCM_ENABLE_RX_TX_NORM_NM
          MRP_IMM_EcuMIndication
            BswMModeRequestSource: category=TOOL_CONFIGURED
              BswMEcuMIndication: category=TOOL_CONFIGURED
            BswMModeInitValue: category=TOOL_CONFIGURED
              BswMBswModeInitValue: category=TOOL_CONFIGURED, BswMBswModeInitValueMode=ECUM_STATE_STARTUP_ONE
          MRP_IMM_EcuMWakeupSource_CAN1RX
            BswMModeRequestSource: category=TOOL_CONFIGURED
              BswMEcuMWakeupSource: category=TOOL_CONFIGURED, BswMEcuMWakeupSrcRef=ECUM_WKSOURCE_CAN1RX
            BswMModeInitValue: category=TOOL_CONFIGURED
              BswMBswModeInitValue: category=TOOL_CONFIGURED, BswMBswModeInitValueMode=ECUM_WKSTATUS_NONE
          MRP_IMM_EcuMWakeupSource_CAN1RX_POLL
            BswMModeRequestSource: category=TOOL_CONFIGURED
              BswMEcuMWakeupSource: category=TOOL_CONFIGURED, BswMEcuMWakeupSrcRef=ECUM_WKSOURCE_CAN1RX_POLL
            BswMModeInitValue: category=TOOL_CONFIGURED
              BswMBswModeInitValue: category=TOOL_CONFIGURED, BswMBswModeInitValueMode=ECUM_WKSTATUS_NONE
          MRP_IMM_GenericRequest_CanSMBOR_Project
            BswMModeRequestSource: category=TOOL_CONFIGURED
              BswMGenericRequest: category=TOOL_CONFIGURED, BswMModeRequesterId=140, BswMRequestedModeMax=1
            BswMModeInitValue: category=TOOL_CONFIGURED
              BswMBswModeInitValue: category=TOOL_CONFIGURED, BswMBswModeInitValueMode=CANSM_BSWM_BOR_COMPLETE
          MRP_IMM_GenericRequest_EcuState
            BswMModeRequestSource: category=TOOL_CONFIGURED
              BswMGenericRequest: category=TOOL_CONFIGURED, BswMModeRequesterId=42, BswMRequestedModeMax=400
            BswMModeInitValue: category=TOOL_CONFIGURED
              BswMBswModeInitValue: category=TOOL_CONFIGURED, BswMBswModeInitValueMode=BSWM_ECUSTATE_READY
          MRP_IMM_GenericRequest_NvMLowPower
            BswMModeRequestSource: category=TOOL_CONFIGURED
              BswMGenericRequest: category=TOOL_CONFIGURED, BswMModeRequesterId=20, BswMRequestedModeMax=1
            BswMModeInitValue: category=TOOL_CONFIGURED
              BswMBswModeInitValue: category=TOOL_CONFIGURED, BswMBswModeInitValueMode=NVM_LOWPOWER_ALLOW
          MRP_IMM_GenericRequest_ShutdownTarget
            BswMModeRequestSource: category=TOOL_CONFIGURED
              BswMGenericRequest: category=TOOL_CONFIGURED, BswMModeRequesterId=298, BswMRequestedModeMax=3
            BswMModeInitValue: category=TOOL_CONFIGURED
              BswMBswModeInitValue: category=TOOL_CONFIGURED, BswMBswModeInitValueMode=BSWM_SHUTDOWNTARGET_RUN
          MRP_IMM_NvMJobModeIndication_ReadAll
            BswMModeRequestSource: category=TOOL_CONFIGURED
              BswMNvMJobModeIndication: category=TOOL_CONFIGURED, BswMNvmService=NvmReadAll
            BswMModeInitValue: category=TOOL_CONFIGURED
              BswMBswModeInitValue: category=TOOL_CONFIGURED, BswMBswModeInitValueMode=NVM_MAXVALUE
          MRP_IMM_NvMJobModeIndication_WriteAll
            BswMModeRequestSource: category=TOOL_CONFIGURED
              BswMNvMJobModeIndication: category=TOOL_CONFIGURED, BswMNvmService=NvmWriteAll
            BswMModeInitValue: category=TOOL_CONFIGURED
              BswMBswModeInitValue: category=TOOL_CONFIGURED, BswMBswModeInitValueMode=NVM_MAXVALUE
          MRP_IMM_SwcModeRequest_AppMode
            BswMModeRequestSource: category=TOOL_CONFIGURED
              BswMSwcModeRequest: category=TOOL_CONFIGURED, BswMSwcModeRequestVariableDataPrototypeRef=AppMode
          MRP_IMM_SwcModeRequest_ComMMode_Project
            BswMModeRequestSource: category=TOOL_CONFIGURED
              BswMSwcModeRequest: category=TOOL_CONFIGURED, BswMSwcModeRequestVariableDataPrototypeRef=ComMMode_Project
        86 x BswMModeCondition, all with category=TOOL_CONFIGURED:
          MC_IMM_BswModeNotification_modeNotificationPort_DcmCommunicationControl_0_EQ_DCM_DISABLE_RX_DISABLE_TX_NM: BswMConditionType=BSWM_EQUALS, BswMConditionMode=MRP_IMM_BswModeNotification_modeNotificationPort_DcmCommunicationControl_0
            BswMConditionValue: category=TOOL_CONFIGURED
              BswMModeDeclaration: category=TOOL_CONFIGURED, BswMModeValueRef=DCM_DISABLE_RX_DISABLE_TX_NM
          MC_IMM_BswModeNotification_modeNotificationPort_DcmCommunicationControl_0_EQ_DCM_DISABLE_RX_ENABLE_TX_NORM: BswMConditionType=BSWM_EQUALS, BswMConditionMode=MRP_IMM_BswModeNotification_modeNotificationPort_DcmCommunicationControl_0
            BswMConditionValue: category=TOOL_CONFIGURED
              BswMModeDeclaration: category=TOOL_CONFIGURED, BswMModeValueRef=DCM_DISABLE_RX_ENABLE_TX_NORM
          MC_IMM_BswModeNotification_modeNotificationPort_DcmCommunicationControl_0_EQ_DCM_DISABLE_RX_ENABLE_TX_NORM_NM: BswMConditionType=BSWM_EQUALS, BswMConditionMode=MRP_IMM_BswModeNotification_modeNotificationPort_DcmCommunicationControl_0
            BswMConditionValue: category=TOOL_CONFIGURED
              BswMModeDeclaration: category=TOOL_CONFIGURED, BswMModeValueRef=DCM_DISABLE_RX_ENABLE_TX_NORM_NM
          MC_IMM_BswModeNotification_modeNotificationPort_DcmCommunicationControl_0_EQ_DCM_DISABLE_RX_TX_NM: BswMConditionType=BSWM_EQUALS, BswMConditionMode=MRP_IMM_BswModeNotification_modeNotificationPort_DcmCommunicationControl_0
            BswMConditionValue: category=TOOL_CONFIGURED
              BswMModeDeclaration: category=TOOL_CONFIGURED, BswMModeValueRef=DCM_DISABLE_RX_TX_NM
          MC_IMM_BswModeNotification_modeNotificationPort_DcmCommunicationControl_0_EQ_DCM_DISABLE_RX_TX_NORMAL: BswMConditionType=BSWM_EQUALS, BswMConditionMode=MRP_IMM_BswModeNotification_modeNotificationPort_DcmCommunicationControl_0
            BswMConditionValue: category=TOOL_CONFIGURED
              BswMModeDeclaration: category=TOOL_CONFIGURED, BswMModeValueRef=DCM_DISABLE_RX_TX_NORMAL
          MC_IMM_BswModeNotification_modeNotificationPort_DcmCommunicationControl_0_EQ_DCM_DISABLE_RX_TX_NORM_NM: BswMConditionType=BSWM_EQUALS, BswMConditionMode=MRP_IMM_BswModeNotification_modeNotificationPort_DcmCommunicationControl_0
            BswMConditionValue: category=TOOL_CONFIGURED
              BswMModeDeclaration: category=TOOL_CONFIGURED, BswMModeValueRef=DCM_DISABLE_RX_TX_NORM_NM
          MC_IMM_BswModeNotification_modeNotificationPort_DcmCommunicationControl_0_EQ_DCM_ENABLE_RX_DISABLE_TX_NM: BswMConditionType=BSWM_EQUALS, BswMConditionMode=MRP_IMM_BswModeNotification_modeNotificationPort_DcmCommunicationControl_0
            BswMConditionValue: category=TOOL_CONFIGURED
              BswMModeDeclaration: category=TOOL_CONFIGURED, BswMModeValueRef=DCM_ENABLE_RX_DISABLE_TX_NM
          MC_IMM_BswModeNotification_modeNotificationPort_DcmCommunicationControl_0_EQ_DCM_ENABLE_RX_DISABLE_TX_NORM: BswMConditionType=BSWM_EQUALS, BswMConditionMode=MRP_IMM_BswModeNotification_modeNotificationPort_DcmCommunicationControl_0
            BswMConditionValue: category=TOOL_CONFIGURED
              BswMModeDeclaration: category=TOOL_CONFIGURED, BswMModeValueRef=DCM_ENABLE_RX_DISABLE_TX_NORM
          MC_IMM_BswModeNotification_modeNotificationPort_DcmCommunicationControl_0_EQ_DCM_ENABLE_RX_DISABLE_TX_NORM_NM: BswMConditionType=BSWM_EQUALS, BswMConditionMode=MRP_IMM_BswModeNotification_modeNotificationPort_DcmCommunicationControl_0
            BswMConditionValue: category=TOOL_CONFIGURED
              BswMModeDeclaration: category=TOOL_CONFIGURED, BswMModeValueRef=DCM_ENABLE_RX_DISABLE_TX_NORM_NM
          MC_IMM_BswModeNotification_modeNotificationPort_DcmCommunicationControl_0_EQ_DCM_ENABLE_RX_TX_NM: BswMConditionType=BSWM_EQUALS, BswMConditionMode=MRP_IMM_BswModeNotification_modeNotificationPort_DcmCommunicationControl_0
            BswMConditionValue: category=TOOL_CONFIGURED
              BswMModeDeclaration: category=TOOL_CONFIGURED, BswMModeValueRef=DCM_ENABLE_RX_TX_NM
          MC_IMM_BswModeNotification_modeNotificationPort_DcmCommunicationControl_0_EQ_DCM_ENABLE_RX_TX_NORM: BswMConditionType=BSWM_EQUALS, BswMConditionMode=MRP_IMM_BswModeNotification_modeNotificationPort_DcmCommunicationControl_0
            BswMConditionValue: category=TOOL_CONFIGURED
              BswMModeDeclaration: category=TOOL_CONFIGURED, BswMModeValueRef=DCM_ENABLE_RX_TX_NORM
          MC_IMM_BswModeNotification_modeNotificationPort_DcmCommunicationControl_0_EQ_DCM_ENABLE_RX_TX_NORM_NM: BswMConditionType=BSWM_EQUALS, BswMConditionMode=MRP_IMM_BswModeNotification_modeNotificationPort_DcmCommunicationControl_0
            BswMConditionValue: category=TOOL_CONFIGURED
              BswMModeDeclaration: category=TOOL_CONFIGURED, BswMModeValueRef=DCM_ENABLE_RX_TX_NORM_NM
          MC_IMM_BswModeNotification_modeNotificationPort_DcmControlDTCSetting_EQ_DISABLEDTCSETTING: BswMConditionType=BSWM_EQUALS, BswMConditionMode=MRP_IMM_BswModeNotification_modeNotificationPort_DcmControlDTCSetting
            BswMConditionValue: category=TOOL_CONFIGURED
              BswMModeDeclaration: category=TOOL_CONFIGURED, BswMModeValueRef=DISABLEDTCSETTING
          MC_IMM_BswModeNotification_modeNotificationPort_DcmControlDTCSetting_EQ_ENABLEDTCSETTING: BswMConditionType=BSWM_EQUALS, BswMConditionMode=MRP_IMM_BswModeNotification_modeNotificationPort_DcmControlDTCSetting
            BswMConditionValue: category=TOOL_CONFIGURED
              BswMModeDeclaration: category=TOOL_CONFIGURED, BswMModeValueRef=ENABLEDTCSETTING
          MC_IMM_BswModeNotification_modeNotificationPort_DcmDiagnosticSessionControl_EQ_DCM_DEFAULT_SESSION: BswMConditionType=BSWM_EQUALS, BswMConditionMode=MRP_IMM_BswModeNotification_modeNotificationPort_DcmDiagnosticSessionControl
            BswMConditionValue: category=TOOL_CONFIGURED
              BswMModeDeclaration: category=TOOL_CONFIGURED, BswMModeValueRef=DCM_DEFAULT_SESSION
          MC_IMM_BswModeNotification_modeNotificationPort_DcmDiagnosticSessionControl_EQ_DCM_ECU_PROGRAMMING_MODE: BswMConditionType=BSWM_EQUALS, BswMConditionMode=MRP_IMM_BswModeNotification_modeNotificationPort_DcmDiagnosticSessionControl
            BswMConditionValue: category=TOOL_CONFIGURED
              BswMModeDeclaration: category=TOOL_CONFIGURED, BswMModeValueRef=DCM_ECU_PROGRAMMING_MODE
          MC_IMM_BswModeNotification_modeNotificationPort_DcmDiagnosticSessionControl_EQ_DCM_EXTENDED_DIAGNOSTIC_MODE: BswMConditionType=BSWM_EQUALS, BswMConditionMode=MRP_IMM_BswModeNotification_modeNotificationPort_DcmDiagnosticSessionControl
            BswMConditionValue: category=TOOL_CONFIGURED
              BswMModeDeclaration: category=TOOL_CONFIGURED, BswMModeValueRef=DCM_EXTENDED_DIAGNOSTIC_MODE
          MC_IMM_BswModeNotification_modeNotificationPort_DcmDiagnosticSessionControl_EQ_DCM_EXTENDED_DIAGNOSTIC_SESSION: BswMConditionType=BSWM_EQUALS, BswMConditionMode=MRP_IMM_BswModeNotification_modeNotificationPort_DcmDiagnosticSessionControl
            BswMConditionValue: category=TOOL_CONFIGURED
              BswMModeDeclaration: category=TOOL_CONFIGURED, BswMModeValueRef=DCM_EXTENDED_DIAGNOSTIC_SESSION
          MC_IMM_BswModeNotification_modeNotificationPort_DcmDiagnosticSessionControl_EQ_DCM_PROGRAMMING_SESSION: BswMConditionType=BSWM_EQUALS, BswMConditionMode=MRP_IMM_BswModeNotification_modeNotificationPort_DcmDiagnosticSessionControl
            BswMConditionValue: category=TOOL_CONFIGURED
              BswMModeDeclaration: category=TOOL_CONFIGURED, BswMModeValueRef=DCM_PROGRAMMING_SESSION
          MC_IMM_BswModeNotification_modeNotificationPort_DcmDiagnosticSessionControl_EQ_DCM_QUIESCENT_CURRENT_DIAGNOSTIC_MODE_START: BswMConditionType=BSWM_EQUALS, BswMConditionMode=MRP_IMM_BswModeNotification_modeNotificationPort_DcmDiagnosticSessionControl
            BswMConditionValue: category=TOOL_CONFIGURED
              BswMModeDeclaration: category=TOOL_CONFIGURED, BswMModeValueRef=DCM_QUIESCENT_CURRENT_DIAGNOSTIC_MODE_START
          MC_IMM_BswModeNotification_modeNotificationPort_DcmDiagnosticSessionControl_EQ_DCM_SAFETY_SYSTEM_DIAGNOSTIC_SESSION: BswMConditionType=BSWM_EQUALS, BswMConditionMode=MRP_IMM_BswModeNotification_modeNotificationPort_DcmDiagnosticSessionControl
            BswMConditionValue: category=TOOL_CONFIGURED
              BswMModeDeclaration: category=TOOL_CONFIGURED, BswMModeValueRef=DCM_SAFETY_SYSTEM_DIAGNOSTIC_SESSION
          MC_IMM_BswModeNotification_modeNotificationPort_DcmDiagnosticSessionControl_EQ_DCM_SLEEP_MODE_START_REQUEST: BswMConditionType=BSWM_EQUALS, BswMConditionMode=MRP_IMM_BswModeNotification_modeNotificationPort_DcmDiagnosticSessionControl
            BswMConditionValue: category=TOOL_CONFIGURED
              BswMModeDeclaration: category=TOOL_CONFIGURED, BswMModeValueRef=DCM_SLEEP_MODE_START_REQUEST
          MC_IMM_BswModeNotification_modeNotificationPort_DcmEcuReset_EQ_EXECUTE: BswMConditionType=BSWM_EQUALS, BswMConditionMode=MRP_IMM_BswModeNotification_modeNotificationPort_DcmEcuReset
            BswMConditionValue: category=TOOL_CONFIGURED
              BswMModeDeclaration: category=TOOL_CONFIGURED, BswMModeValueRef=EXECUTE
          MC_IMM_BswModeNotification_modeNotificationPort_DcmModeRapidPowerShutDown_EQ_DISABLE_RAPIDPOWERSHUTDOWN: BswMConditionType=BSWM_EQUALS, BswMConditionMode=MRP_IMM_BswModeNotification_modeNotificationPort_DcmModeRapidPowerShutDown
            BswMConditionValue: category=TOOL_CONFIGURED
              BswMModeDeclaration: category=TOOL_CONFIGURED, BswMModeValueRef=DISABLE_RAPIDPOWERSHUTDOWN
          MC_IMM_BswModeNotification_modeNotificationPort_DcmModeRapidPowerShutDown_EQ_ENABLE_RAPIDPOWERSHUTDOWN: BswMConditionType=BSWM_EQUALS, BswMConditionMode=MRP_IMM_BswModeNotification_modeNotificationPort_DcmModeRapidPowerShutDown
            BswMConditionValue: category=TOOL_CONFIGURED
              BswMModeDeclaration: category=TOOL_CONFIGURED, BswMModeValueRef=ENABLE_RAPIDPOWERSHUTDOWN
          MC_IMM_CanSMIndication_Project_EQ_BUS_OFF: BswMConditionType=BSWM_EQUALS, BswMConditionMode=MRP_IMM_CanSMIndication_Project
            BswMConditionValue: category=TOOL_CONFIGURED
              BswMBswMode: category=TOOL_CONFIGURED, BswMBswRequestedMode=CANSM_BSWM_BUS_OFF
          MC_IMM_CanSMIndication_Project_EQ_CHANGE_BAUDRATE: BswMConditionType=BSWM_EQUALS, BswMConditionMode=MRP_IMM_CanSMIndication_Project
            BswMConditionValue: category=TOOL_CONFIGURED
              BswMBswMode: category=TOOL_CONFIGURED, BswMBswRequestedMode=CANSM_BSWM_CHANGE_BAUDRATE
          MC_IMM_CanSMIndication_Project_EQ_FULL_COM: BswMConditionType=BSWM_EQUALS, BswMConditionMode=MRP_IMM_CanSMIndication_Project
            BswMConditionValue: category=TOOL_CONFIGURED
              BswMBswMode: category=TOOL_CONFIGURED, BswMBswRequestedMode=CANSM_BSWM_FULL_COMMUNICATION
          MC_IMM_CanSMIndication_Project_EQ_NO_COM: BswMConditionType=BSWM_EQUALS, BswMConditionMode=MRP_IMM_CanSMIndication_Project
            BswMConditionValue: category=TOOL_CONFIGURED
              BswMBswMode: category=TOOL_CONFIGURED, BswMBswRequestedMode=CANSM_BSWM_NO_COMMUNICATION
          MC_IMM_CanSMIndication_Project_EQ_SILENT_COM: BswMConditionType=BSWM_EQUALS, BswMConditionMode=MRP_IMM_CanSMIndication_Project
            BswMConditionValue: category=TOOL_CONFIGURED
              BswMBswMode: category=TOOL_CONFIGURED, BswMBswRequestedMode=CANSM_BSWM_SILENT_COMMUNICATION
          MC_IMM_ComMIndication_Project_EN_FULL_COM: BswMConditionType=BSWM_EQUALS_NOT, BswMConditionMode=MRP_IMM_ComMIndication_Project
            BswMConditionValue: category=TOOL_CONFIGURED
              BswMBswMode: category=TOOL_CONFIGURED, BswMBswRequestedMode=COMM_FULL_COMMUNICATION
          MC_IMM_ComMIndication_Project_EQ_FULL_COM: BswMConditionType=BSWM_EQUALS, BswMConditionMode=MRP_IMM_ComMIndication_Project
            BswMConditionValue: category=TOOL_CONFIGURED
              BswMBswMode: category=TOOL_CONFIGURED, BswMBswRequestedMode=COMM_FULL_COMMUNICATION
          MC_IMM_ComMIndication_Project_EQ_NO_COM: BswMConditionType=BSWM_EQUALS, BswMConditionMode=MRP_IMM_ComMIndication_Project
            BswMConditionValue: category=TOOL_CONFIGURED
              BswMBswMode: category=TOOL_CONFIGURED, BswMBswRequestedMode=COMM_NO_COMMUNICATION
          MC_IMM_ComMIndication_Project_EQ_SILENT_COM: BswMConditionType=BSWM_EQUALS, BswMConditionMode=MRP_IMM_ComMIndication_Project
            BswMConditionValue: category=TOOL_CONFIGURED
              BswMBswMode: category=TOOL_CONFIGURED, BswMBswRequestedMode=COMM_SILENT_COMMUNICATION
          MC_IMM_DcmComModeRequest_Project_EQ_DISABLE_RX_ENABLE_TX_NORM: BswMConditionType=BSWM_EQUALS, BswMConditionMode=MRP_IMM_DcmComModeRequest_Project
            BswMConditionValue: category=TOOL_CONFIGURED
              BswMBswMode: category=TOOL_CONFIGURED, BswMBswRequestedMode=DCM_DISABLE_RX_ENABLE_TX_NORM
          MC_IMM_DcmComModeRequest_Project_EQ_DISABLE_RX_ENABLE_TX_NORM_NM: BswMConditionType=BSWM_EQUALS, BswMConditionMode=MRP_IMM_DcmComModeRequest_Project
            BswMConditionValue: category=TOOL_CONFIGURED
              BswMBswMode: category=TOOL_CONFIGURED, BswMBswRequestedMode=DCM_DISABLE_RX_ENABLE_TX_NORM_NM
          MC_IMM_DcmComModeRequest_Project_EQ_DISABLE_RX_TX_NORM: BswMConditionType=BSWM_EQUALS, BswMConditionMode=MRP_IMM_DcmComModeRequest_Project
            BswMConditionValue: category=TOOL_CONFIGURED
              BswMBswMode: category=TOOL_CONFIGURED, BswMBswRequestedMode=DCM_DISABLE_RX_TX_NORM
          MC_IMM_DcmComModeRequest_Project_EQ_DISABLE_RX_TX_NORM_NM: BswMConditionType=BSWM_EQUALS, BswMConditionMode=MRP_IMM_DcmComModeRequest_Project
            BswMConditionValue: category=TOOL_CONFIGURED
              BswMBswMode: category=TOOL_CONFIGURED, BswMBswRequestedMode=DCM_DISABLE_RX_TX_NORM_NM
          MC_IMM_DcmComModeRequest_Project_EQ_ENABLE_RX_DISABLE_TX_NORM: BswMConditionType=BSWM_EQUALS, BswMConditionMode=MRP_IMM_DcmComModeRequest_Project
            BswMConditionValue: category=TOOL_CONFIGURED
              BswMBswMode: category=TOOL_CONFIGURED, BswMBswRequestedMode=DCM_ENABLE_RX_DISABLE_TX_NORM
          MC_IMM_DcmComModeRequest_Project_EQ_ENABLE_RX_DISABLE_TX_NORM_NM: BswMConditionType=BSWM_EQUALS, BswMConditionMode=MRP_IMM_DcmComModeRequest_Project
            BswMConditionValue: category=TOOL_CONFIGURED
              BswMBswMode: category=TOOL_CONFIGURED, BswMBswRequestedMode=DCM_ENABLE_RX_DISABLE_TX_NORM_NM
          MC_IMM_DcmComModeRequest_Project_EQ_ENABLE_RX_TX_NORM: BswMConditionType=BSWM_EQUALS, BswMConditionMode=MRP_IMM_DcmComModeRequest_Project
            BswMConditionValue: category=TOOL_CONFIGURED
              BswMBswMode: category=TOOL_CONFIGURED, BswMBswRequestedMode=DCM_ENABLE_RX_TX_NORM
          MC_IMM_DcmComModeRequest_Project_EQ_ENABLE_RX_TX_NORM_NM: BswMConditionType=BSWM_EQUALS, BswMConditionMode=MRP_IMM_DcmComModeRequest_Project
            BswMConditionValue: category=TOOL_CONFIGURED
              BswMBswMode: category=TOOL_CONFIGURED, BswMBswRequestedMode=DCM_ENABLE_RX_TX_NORM_NM
          MC_IMM_EcuMIndication_EQ_STARTUP_TWO: BswMConditionType=BSWM_EQUALS, BswMConditionMode=MRP_IMM_EcuMIndication
            BswMConditionValue: category=TOOL_CONFIGURED
              BswMBswMode: category=TOOL_CONFIGURED, BswMBswRequestedMode=ECUM_STATE_STARTUP_TWO
          MC_IMM_EcuMWakeupSource_CAN1RX_EQ_VALIDATED: BswMConditionType=BSWM_EQUALS, BswMConditionMode=MRP_IMM_EcuMWakeupSource_CAN1RX
            BswMConditionValue: category=TOOL_CONFIGURED
              BswMBswMode: category=TOOL_CONFIGURED, BswMBswRequestedMode=ECUM_WKSTATUS_VALIDATED
          MC_IMM_EcuMWakeupSource_CAN1RX_POLL_EQ_VALIDATED: BswMConditionType=BSWM_EQUALS, BswMConditionMode=MRP_IMM_EcuMWakeupSource_CAN1RX_POLL
            BswMConditionValue: category=TOOL_CONFIGURED
              BswMBswMode: category=TOOL_CONFIGURED, BswMBswRequestedMode=ECUM_WKSTATUS_VALIDATED
          MC_IMM_GenericRequest_CanSMBOR_Project_EQ_COMPLETE: BswMConditionType=BSWM_EQUALS, BswMConditionMode=MRP_IMM_GenericRequest_CanSMBOR_Project
            BswMConditionValue: category=TOOL_CONFIGURED
              BswMBswMode: category=TOOL_CONFIGURED, BswMBswRequestedMode=CANSM_BSWM_BOR_COMPLETE
          MC_IMM_GenericRequest_CanSMBOR_Project_EQ_START: BswMConditionType=BSWM_EQUALS, BswMConditionMode=MRP_IMM_GenericRequest_CanSMBOR_Project
            BswMConditionValue: category=TOOL_CONFIGURED
              BswMBswMode: category=TOOL_CONFIGURED, BswMBswRequestedMode=CANSM_BSWM_BOR_START
          MC_IMM_GenericRequest_EcuState_EQ_ENTRY_OFF: BswMConditionType=BSWM_EQUALS, BswMConditionMode=MRP_IMM_GenericRequest_EcuState
            BswMConditionValue: category=TOOL_CONFIGURED
              BswMBswMode: category=TOOL_CONFIGURED, BswMBswRequestedMode=BSWM_ECUSTATE_ENTRY_OFF
          MC_IMM_GenericRequest_EcuState_EQ_ENTRY_RESET: BswMConditionType=BSWM_EQUALS, BswMConditionMode=MRP_IMM_GenericRequest_EcuState
            BswMConditionValue: category=TOOL_CONFIGURED
              BswMBswMode: category=TOOL_CONFIGURED, BswMBswRequestedMode=BSWM_ECUSTATE_ENTRY_RESET
          MC_IMM_GenericRequest_EcuState_EQ_ENTRY_RUN: BswMConditionType=BSWM_EQUALS, BswMConditionMode=MRP_IMM_GenericRequest_EcuState
            BswMConditionValue: category=TOOL_CONFIGURED
              BswMBswMode: category=TOOL_CONFIGURED, BswMBswRequestedMode=BSWM_ECUSTATE_ENTRY_RUN
          MC_IMM_GenericRequest_EcuState_EQ_ENTRY_SHUTDOWN: BswMConditionType=BSWM_EQUALS, BswMConditionMode=MRP_IMM_GenericRequest_EcuState
            BswMConditionValue: category=TOOL_CONFIGURED
              BswMBswMode: category=TOOL_CONFIGURED, BswMBswRequestedMode=BSWM_ECUSTATE_ENTRY_SHUTDOWN
          MC_IMM_GenericRequest_EcuState_EQ_ENTRY_SLEEP: BswMConditionType=BSWM_EQUALS, BswMConditionMode=MRP_IMM_GenericRequest_EcuState
            BswMConditionValue: category=TOOL_CONFIGURED
              BswMBswMode: category=TOOL_CONFIGURED, BswMBswRequestedMode=BSWM_ECUSTATE_ENTRY_SLEEP
          MC_IMM_GenericRequest_EcuState_EQ_ENTRY_STARTUP_THREE: BswMConditionType=BSWM_EQUALS, BswMConditionMode=MRP_IMM_GenericRequest_EcuState
            BswMConditionValue: category=TOOL_CONFIGURED
              BswMBswMode: category=TOOL_CONFIGURED, BswMBswRequestedMode=BSWM_ECUSTATE_ENTRY_STARTUP_THREE
          MC_IMM_GenericRequest_EcuState_EQ_ENTRY_STARTUP_TWO: BswMConditionType=BSWM_EQUALS, BswMConditionMode=MRP_IMM_GenericRequest_EcuState
            BswMConditionValue: category=TOOL_CONFIGURED
              BswMBswMode: category=TOOL_CONFIGURED, BswMBswRequestedMode=BSWM_ECUSTATE_ENTRY_STARTUP_TWO
          MC_IMM_GenericRequest_EcuState_EQ_EXIT_RUN: BswMConditionType=BSWM_EQUALS, BswMConditionMode=MRP_IMM_GenericRequest_EcuState
            BswMConditionValue: category=TOOL_CONFIGURED
              BswMBswMode: category=TOOL_CONFIGURED, BswMBswRequestedMode=BSWM_ECUSTATE_EXIT_RUN
          MC_IMM_GenericRequest_EcuState_EQ_EXIT_SHUTDOWN: BswMConditionType=BSWM_EQUALS, BswMConditionMode=MRP_IMM_GenericRequest_EcuState
            BswMConditionValue: category=TOOL_CONFIGURED
              BswMBswMode: category=TOOL_CONFIGURED, BswMBswRequestedMode=BSWM_ECUSTATE_EXIT_SHUTDOWN
          MC_IMM_GenericRequest_EcuState_EQ_EXIT_SLEEP: BswMConditionType=BSWM_EQUALS, BswMConditionMode=MRP_IMM_GenericRequest_EcuState
            BswMConditionValue: category=TOOL_CONFIGURED
              BswMBswMode: category=TOOL_CONFIGURED, BswMBswRequestedMode=BSWM_ECUSTATE_EXIT_SLEEP
          MC_IMM_GenericRequest_EcuState_EQ_EXIT_STARTUP_THREE: BswMConditionType=BSWM_EQUALS, BswMConditionMode=MRP_IMM_GenericRequest_EcuState
            BswMConditionValue: category=TOOL_CONFIGURED
              BswMBswMode: category=TOOL_CONFIGURED, BswMBswRequestedMode=BSWM_ECUSTATE_EXIT_STARTUP_THREE
          MC_IMM_GenericRequest_EcuState_EQ_EXIT_STARTUP_TWO: BswMConditionType=BSWM_EQUALS, BswMConditionMode=MRP_IMM_GenericRequest_EcuState
            BswMConditionValue: category=TOOL_CONFIGURED
              BswMBswMode: category=TOOL_CONFIGURED, BswMBswRequestedMode=BSWM_ECUSTATE_EXIT_STARTUP_TWO
          MC_IMM_GenericRequest_NvMLowPower_EQ_ALLOW: BswMConditionType=BSWM_EQUALS, BswMConditionMode=MRP_IMM_GenericRequest_NvMLowPower
            BswMConditionValue: category=TOOL_CONFIGURED
              BswMBswMode: category=TOOL_CONFIGURED, BswMBswRequestedMode=NVM_LOWPOWER_ALLOW
          MC_IMM_GenericRequest_ShutdownTarget_EQ_OFF: BswMConditionType=BSWM_EQUALS, BswMConditionMode=MRP_IMM_GenericRequest_ShutdownTarget
            BswMConditionValue: category=TOOL_CONFIGURED
              BswMBswMode: category=TOOL_CONFIGURED, BswMBswRequestedMode=BSWM_SHUTDOWNTARGET_OFF
          MC_IMM_GenericRequest_ShutdownTarget_EQ_RESET: BswMConditionType=BSWM_EQUALS, BswMConditionMode=MRP_IMM_GenericRequest_ShutdownTarget
            BswMConditionValue: category=TOOL_CONFIGURED
              BswMBswMode: category=TOOL_CONFIGURED, BswMBswRequestedMode=BSWM_SHUTDOWNTARGET_RESET
          MC_IMM_GenericRequest_ShutdownTarget_EQ_RUN: BswMConditionType=BSWM_EQUALS, BswMConditionMode=MRP_IMM_GenericRequest_ShutdownTarget
            BswMConditionValue: category=TOOL_CONFIGURED
              BswMBswMode: category=TOOL_CONFIGURED, BswMBswRequestedMode=BSWM_SHUTDOWNTARGET_RUN
          MC_IMM_GenericRequest_ShutdownTarget_EQ_SLEEP: BswMConditionType=BSWM_EQUALS, BswMConditionMode=MRP_IMM_GenericRequest_ShutdownTarget
            BswMConditionValue: category=TOOL_CONFIGURED
              BswMBswMode: category=TOOL_CONFIGURED, BswMBswRequestedMode=BSWM_SHUTDOWNTARGET_SLEEP
          MC_IMM_NvMJobModeIndication_ReadAll_EQ_BLOCK_SKIPPED: BswMConditionType=BSWM_EQUALS, BswMConditionMode=MRP_IMM_NvMJobModeIndication_ReadAll
            BswMConditionValue: category=TOOL_CONFIGURED
              BswMBswMode: category=TOOL_CONFIGURED, BswMBswRequestedMode=NVM_REQ_BLOCK_SKIPPED
          MC_IMM_NvMJobModeIndication_ReadAll_EQ_CANCELED: BswMConditionType=BSWM_EQUALS, BswMConditionMode=MRP_IMM_NvMJobModeIndication_ReadAll
            BswMConditionValue: category=TOOL_CONFIGURED
              BswMBswMode: category=TOOL_CONFIGURED, BswMBswRequestedMode=NVM_REQ_CANCELED
          MC_IMM_NvMJobModeIndication_ReadAll_EQ_INTEGRITY_FAILED: BswMConditionType=BSWM_EQUALS, BswMConditionMode=MRP_IMM_NvMJobModeIndication_ReadAll
            BswMConditionValue: category=TOOL_CONFIGURED
              BswMBswMode: category=TOOL_CONFIGURED, BswMBswRequestedMode=NVM_REQ_INTEGRITY_FAILED
          MC_IMM_NvMJobModeIndication_ReadAll_EQ_NOT_OK: BswMConditionType=BSWM_EQUALS, BswMConditionMode=MRP_IMM_NvMJobModeIndication_ReadAll
            BswMConditionValue: category=TOOL_CONFIGURED
              BswMBswMode: category=TOOL_CONFIGURED, BswMBswRequestedMode=NVM_REQ_NOT_OK
          MC_IMM_NvMJobModeIndication_ReadAll_EQ_NV_INVALIDATED: BswMConditionType=BSWM_EQUALS, BswMConditionMode=MRP_IMM_NvMJobModeIndication_ReadAll
            BswMConditionValue: category=TOOL_CONFIGURED
              BswMBswMode: category=TOOL_CONFIGURED, BswMBswRequestedMode=NVM_REQ_NV_INVALIDATED
          MC_IMM_NvMJobModeIndication_ReadAll_EQ_OK: BswMConditionType=BSWM_EQUALS, BswMConditionMode=MRP_IMM_NvMJobModeIndication_ReadAll
            BswMConditionValue: category=TOOL_CONFIGURED
              BswMBswMode: category=TOOL_CONFIGURED, BswMBswRequestedMode=NVM_REQ_OK
          MC_IMM_NvMJobModeIndication_ReadAll_EQ_REDUNDANCY_FAILED: BswMConditionType=BSWM_EQUALS, BswMConditionMode=MRP_IMM_NvMJobModeIndication_ReadAll
            BswMConditionValue: category=TOOL_CONFIGURED
              BswMBswMode: category=TOOL_CONFIGURED, BswMBswRequestedMode=NVM_REQ_REDUNDANCY_FAILED
          MC_IMM_NvMJobModeIndication_ReadAll_EQ_RESTORED_FROM_ROM: BswMConditionType=BSWM_EQUALS, BswMConditionMode=MRP_IMM_NvMJobModeIndication_ReadAll
            BswMConditionValue: category=TOOL_CONFIGURED
              BswMBswMode: category=TOOL_CONFIGURED, BswMBswRequestedMode=NVM_REQ_RESTORED_FROM_ROM
          MC_IMM_NvMJobModeIndication_WriteAll_EQ_BLOCK_SKIPPED: BswMConditionType=BSWM_EQUALS, BswMConditionMode=MRP_IMM_NvMJobModeIndication_WriteAll
            BswMConditionValue: category=TOOL_CONFIGURED
              BswMBswMode: category=TOOL_CONFIGURED, BswMBswRequestedMode=NVM_REQ_BLOCK_SKIPPED
          MC_IMM_NvMJobModeIndication_WriteAll_EQ_CANCELED: BswMConditionType=BSWM_EQUALS, BswMConditionMode=MRP_IMM_NvMJobModeIndication_WriteAll
            BswMConditionValue: category=TOOL_CONFIGURED
              BswMBswMode: category=TOOL_CONFIGURED, BswMBswRequestedMode=NVM_REQ_CANCELED
          MC_IMM_NvMJobModeIndication_WriteAll_EQ_INTEGRITY_FAILED: BswMConditionType=BSWM_EQUALS, BswMConditionMode=MRP_IMM_NvMJobModeIndication_WriteAll
            BswMConditionValue: category=TOOL_CONFIGURED
              BswMBswMode: category=TOOL_CONFIGURED, BswMBswRequestedMode=NVM_REQ_INTEGRITY_FAILED
          MC_IMM_NvMJobModeIndication_WriteAll_EQ_NOT_OK: BswMConditionType=BSWM_EQUALS, BswMConditionMode=MRP_IMM_NvMJobModeIndication_WriteAll
            BswMConditionValue: category=TOOL_CONFIGURED
              BswMBswMode: category=TOOL_CONFIGURED, BswMBswRequestedMode=NVM_REQ_NOT_OK
          MC_IMM_NvMJobModeIndication_WriteAll_EQ_NV_INVALIDATED: BswMConditionType=BSWM_EQUALS, BswMConditionMode=MRP_IMM_NvMJobModeIndication_WriteAll
            BswMConditionValue: category=TOOL_CONFIGURED
              BswMBswMode: category=TOOL_CONFIGURED, BswMBswRequestedMode=NVM_REQ_NV_INVALIDATED
          MC_IMM_NvMJobModeIndication_WriteAll_EQ_OK: BswMConditionType=BSWM_EQUALS, BswMConditionMode=MRP_IMM_NvMJobModeIndication_WriteAll
            BswMConditionValue: category=TOOL_CONFIGURED
              BswMBswMode: category=TOOL_CONFIGURED, BswMBswRequestedMode=NVM_REQ_OK
          MC_IMM_NvMJobModeIndication_WriteAll_EQ_REDUNDANCY_FAILED: BswMConditionType=BSWM_EQUALS, BswMConditionMode=MRP_IMM_NvMJobModeIndication_WriteAll
            BswMConditionValue: category=TOOL_CONFIGURED
              BswMBswMode: category=TOOL_CONFIGURED, BswMBswRequestedMode=NVM_REQ_REDUNDANCY_FAILED
          MC_IMM_NvMJobModeIndication_WriteAll_EQ_RESTORED_FROM_ROM: BswMConditionType=BSWM_EQUALS, BswMConditionMode=MRP_IMM_NvMJobModeIndication_WriteAll
            BswMConditionValue: category=TOOL_CONFIGURED
              BswMBswMode: category=TOOL_CONFIGURED, BswMBswRequestedMode=NVM_REQ_RESTORED_FROM_ROM
          MC_IMM_SwcModeRequest_AppMode_EQ_APP_MODE_ACTIVE: BswMConditionType=BSWM_EQUALS, BswMConditionMode=MRP_IMM_SwcModeRequest_AppMode
            BswMConditionValue: category=TOOL_CONFIGURED
              BswMBswMode: category=TOOL_CONFIGURED, BswMBswRequestedMode=APP_MODE_ACTIVE
          MC_IMM_SwcModeRequest_AppMode_EQ_APP_MODE_INACTIVE_OFF: BswMConditionType=BSWM_EQUALS, BswMConditionMode=MRP_IMM_SwcModeRequest_AppMode
            BswMConditionValue: category=TOOL_CONFIGURED
              BswMBswMode: category=TOOL_CONFIGURED, BswMBswRequestedMode=APP_MODE_INACTIVE_OFF
          MC_IMM_SwcModeRequest_AppMode_EQ_APP_MODE_INACTIVE_RESET: BswMConditionType=BSWM_EQUALS, BswMConditionMode=MRP_IMM_SwcModeRequest_AppMode
            BswMConditionValue: category=TOOL_CONFIGURED
              BswMBswMode: category=TOOL_CONFIGURED, BswMBswRequestedMode=APP_MODE_INACTIVE_RESET
          MC_IMM_SwcModeRequest_AppMode_EQ_APP_MODE_INACTIVE_SLEEP: BswMConditionType=BSWM_EQUALS, BswMConditionMode=MRP_IMM_SwcModeRequest_AppMode
            BswMConditionValue: category=TOOL_CONFIGURED
              BswMBswMode: category=TOOL_CONFIGURED, BswMBswRequestedMode=APP_MODE_INACTIVE_SLEEP
          MC_IMM_SwcModeRequest_ComMMode_Project_EQ_COMM_MODE_FULL_COM: BswMConditionType=BSWM_EQUALS, BswMConditionMode=MRP_IMM_SwcModeRequest_ComMMode_Project
            BswMConditionValue: category=TOOL_CONFIGURED
              BswMBswMode: category=TOOL_CONFIGURED, BswMBswRequestedMode=COMM_MODE_FULL_COM
          MC_IMM_SwcModeRequest_ComMMode_Project_EQ_COMM_MODE_NO_COM: BswMConditionType=BSWM_EQUALS, BswMConditionMode=MRP_IMM_SwcModeRequest_ComMMode_Project
            BswMConditionValue: category=TOOL_CONFIGURED
              BswMBswMode: category=TOOL_CONFIGURED, BswMBswRequestedMode=COMM_MODE_NO_COM
        80 x BswMLogicalExpression, all with category=TOOL_CONFIGURED:
          LE_ComMIndication_ALL_FULL_COM: BswMArgumentRef=MC_IMM_ComMIndication_Project_EQ_FULL_COM
          LE_ComMIndication_ALL_NO_COM: BswMArgumentRef=MC_IMM_ComMIndication_Project_EQ_NO_COM
          LE_EcuGoDownTypes: BswMLogicalOperator=BSWM_OR, BswMArgumentRef=MC_IMM_GenericRequest_ShutdownTarget_EQ_OFF, BswMArgumentRef=MC_IMM_GenericRequest_ShutdownTarget_EQ_RESET
          LE_EcuResetTypes: BswMLogicalOperator=BSWM_OR, BswMArgumentRef=MC_IMM_BswModeNotification_modeNotificationPort_DcmEcuReset_EQ_EXECUTE, BswMArgumentRef=MC_IMM_SwcModeRequest_AppMode_EQ_APP_MODE_INACTIVE_RESET
          LE_EcuSleepAllowed: BswMLogicalOperator=BSWM_AND, BswMArgumentRef=LE_ComMIndication_ALL_NO_COM, BswMArgumentRef=MC_IMM_GenericRequest_NvMLowPower_EQ_ALLOW
          LE_NvMReadAllCompleted: BswMLogicalOperator=BSWM_OR, BswMArgumentRef=MC_IMM_NvMJobModeIndication_ReadAll_EQ_BLOCK_SKIPPED, BswMArgumentRef=MC_IMM_NvMJobModeIndication_ReadAll_EQ_CANCELED, BswMArgumentRef=MC_IMM_NvMJobModeIndication_ReadAll_EQ_INTEGRITY_FAILED, BswMArgumentRef=MC_IMM_NvMJobModeIndication_ReadAll_EQ_NOT_OK, BswMArgumentRef=MC_IMM_NvMJobModeIndication_ReadAll_EQ_NV_INVALIDATED, BswMArgumentRef=MC_IMM_NvMJobModeIndication_ReadAll_EQ_OK, BswMArgumentRef=MC_IMM_NvMJobModeIndication_ReadAll_EQ_REDUNDANCY_FAILED, BswMArgumentRef=MC_IMM_NvMJobModeIndication_ReadAll_EQ_RESTORED_FROM_ROM
          LE_NvMWriteAllCompleted: BswMLogicalOperator=BSWM_OR, BswMArgumentRef=MC_IMM_NvMJobModeIndication_WriteAll_EQ_BLOCK_SKIPPED, BswMArgumentRef=MC_IMM_NvMJobModeIndication_WriteAll_EQ_CANCELED, BswMArgumentRef=MC_IMM_NvMJobModeIndication_WriteAll_EQ_INTEGRITY_FAILED, BswMArgumentRef=MC_IMM_NvMJobModeIndication_WriteAll_EQ_NOT_OK, BswMArgumentRef=MC_IMM_NvMJobModeIndication_WriteAll_EQ_NV_INVALIDATED, BswMArgumentRef=MC_IMM_NvMJobModeIndication_WriteAll_EQ_OK, BswMArgumentRef=MC_IMM_NvMJobModeIndication_WriteAll_EQ_REDUNDANCY_FAILED, BswMArgumentRef=MC_IMM_NvMJobModeIndication_WriteAll_EQ_RESTORED_FROM_ROM
          LE_Project_COMM_DISABLE_DM: BswMArgumentRef=MC_IMM_ComMIndication_Project_EN_FULL_COM
          LE_Project_COMM_DISABLE_RX: BswMArgumentRef=MC_IMM_ComMIndication_Project_EQ_NO_COM
          LE_Project_COMM_DISABLE_TX: BswMLogicalOperator=BSWM_OR, BswMArgumentRef=MC_IMM_ComMIndication_Project_EQ_NO_COM, BswMArgumentRef=MC_IMM_ComMIndication_Project_EQ_SILENT_COM
          LE_Project_COMM_ENABLE_DM: BswMArgumentRef=MC_IMM_ComMIndication_Project_EQ_FULL_COM
          LE_Project_COMM_ENABLE_RX: BswMLogicalOperator=BSWM_OR, BswMArgumentRef=MC_IMM_ComMIndication_Project_EQ_FULL_COM, BswMArgumentRef=MC_IMM_ComMIndication_Project_EQ_SILENT_COM
          LE_Project_COMM_ENABLE_TX: BswMArgumentRef=MC_IMM_ComMIndication_Project_EQ_FULL_COM
          LE_Project_DCM_DISABLE_RX: BswMLogicalOperator=BSWM_OR, BswMArgumentRef=MC_IMM_DcmComModeRequest_Project_EQ_DISABLE_RX_ENABLE_TX_NORM, BswMArgumentRef=MC_IMM_DcmComModeRequest_Project_EQ_DISABLE_RX_ENABLE_TX_NORM_NM, BswMArgumentRef=MC_IMM_DcmComModeRequest_Project_EQ_DISABLE_RX_TX_NORM, BswMArgumentRef=MC_IMM_DcmComModeRequest_Project_EQ_DISABLE_RX_TX_NORM_NM
          LE_Project_DCM_DISABLE_TX: BswMLogicalOperator=BSWM_OR, BswMArgumentRef=MC_IMM_DcmComModeRequest_Project_EQ_DISABLE_RX_TX_NORM, BswMArgumentRef=MC_IMM_DcmComModeRequest_Project_EQ_DISABLE_RX_TX_NORM_NM, BswMArgumentRef=MC_IMM_DcmComModeRequest_Project_EQ_ENABLE_RX_DISABLE_TX_NORM, BswMArgumentRef=MC_IMM_DcmComModeRequest_Project_EQ_ENABLE_RX_DISABLE_TX_NORM_NM
          LE_Project_DCM_ENABLE_RX: BswMLogicalOperator=BSWM_OR, BswMArgumentRef=MC_IMM_DcmComModeRequest_Project_EQ_ENABLE_RX_DISABLE_TX_NORM, BswMArgumentRef=MC_IMM_DcmComModeRequest_Project_EQ_ENABLE_RX_DISABLE_TX_NORM_NM, BswMArgumentRef=MC_IMM_DcmComModeRequest_Project_EQ_ENABLE_RX_TX_NORM, BswMArgumentRef=MC_IMM_DcmComModeRequest_Project_EQ_ENABLE_RX_TX_NORM_NM
          LE_Project_DCM_ENABLE_TX: BswMLogicalOperator=BSWM_OR, BswMArgumentRef=MC_IMM_DcmComModeRequest_Project_EQ_DISABLE_RX_ENABLE_TX_NORM, BswMArgumentRef=MC_IMM_DcmComModeRequest_Project_EQ_DISABLE_RX_ENABLE_TX_NORM_NM, BswMArgumentRef=MC_IMM_DcmComModeRequest_Project_EQ_ENABLE_RX_TX_NORM, BswMArgumentRef=MC_IMM_DcmComModeRequest_Project_EQ_ENABLE_RX_TX_NORM_NM
          RuleLE_CanBorNotification_Project_COMPLETE: BswMArgumentRef=MC_IMM_GenericRequest_CanSMBOR_Project_EQ_COMPLETE
          RuleLE_CanBorNotification_Project_START: BswMArgumentRef=MC_IMM_GenericRequest_CanSMBOR_Project_EQ_START
          RuleLE_CanStateNotification_Project_BUS_OFF: BswMArgumentRef=MC_IMM_CanSMIndication_Project_EQ_BUS_OFF
          RuleLE_CanStateNotification_Project_CHANGE_BAUDRATE: BswMArgumentRef=MC_IMM_CanSMIndication_Project_EQ_CHANGE_BAUDRATE
          RuleLE_CanStateNotification_Project_FULL_COM: BswMArgumentRef=MC_IMM_CanSMIndication_Project_EQ_FULL_COM
          RuleLE_CanStateNotification_Project_NO_COM: BswMArgumentRef=MC_IMM_CanSMIndication_Project_EQ_NO_COM
          RuleLE_CanStateNotification_Project_SILENT_COM: BswMArgumentRef=MC_IMM_CanSMIndication_Project_EQ_SILENT_COM
          RuleLE_ComControl_Project_DISABLE_DM: BswMArgumentRef=LE_Project_COMM_DISABLE_DM
          RuleLE_ComControl_Project_DISABLE_RX: BswMLogicalOperator=BSWM_OR, BswMArgumentRef=LE_Project_COMM_DISABLE_RX, BswMArgumentRef=LE_Project_DCM_DISABLE_RX
          RuleLE_ComControl_Project_DISABLE_TX: BswMLogicalOperator=BSWM_OR, BswMArgumentRef=LE_Project_COMM_DISABLE_TX, BswMArgumentRef=LE_Project_DCM_DISABLE_TX
          RuleLE_ComControl_Project_ENABLE_DM: BswMArgumentRef=LE_Project_COMM_ENABLE_DM
          RuleLE_ComControl_Project_ENABLE_RX: BswMLogicalOperator=BSWM_AND, BswMArgumentRef=LE_Project_COMM_ENABLE_RX, BswMArgumentRef=LE_Project_DCM_ENABLE_RX
          RuleLE_ComControl_Project_ENABLE_TX: BswMLogicalOperator=BSWM_AND, BswMArgumentRef=LE_Project_COMM_ENABLE_TX, BswMArgumentRef=LE_Project_DCM_ENABLE_TX
          RuleLE_ComModeNotification_Project_FULL_COM: BswMArgumentRef=MC_IMM_ComMIndication_Project_EQ_FULL_COM
          RuleLE_ComModeNotification_Project_NO_COM: BswMArgumentRef=MC_IMM_ComMIndication_Project_EQ_NO_COM
          RuleLE_ComModeNotification_Project_SILENT_COM: BswMArgumentRef=MC_IMM_ComMIndication_Project_EQ_SILENT_COM
          RuleLE_ComModeRequest_Project_FULL_COM: BswMArgumentRef=MC_IMM_SwcModeRequest_ComMMode_Project_EQ_COMM_MODE_FULL_COM
          RuleLE_ComModeRequest_Project_NO_COM: BswMArgumentRef=MC_IMM_SwcModeRequest_ComMMode_Project_EQ_COMM_MODE_NO_COM
          RuleLE_DcmCommunicationControl_0_DCM_DISABLE_RX_DISABLE_TX_NM: BswMArgumentRef=MC_IMM_BswModeNotification_modeNotificationPort_DcmCommunicationControl_0_EQ_DCM_DISABLE_RX_DISABLE_TX_NM
          RuleLE_DcmCommunicationControl_0_DCM_DISABLE_RX_ENABLE_TX_NORM: BswMArgumentRef=MC_IMM_BswModeNotification_modeNotificationPort_DcmCommunicationControl_0_EQ_DCM_DISABLE_RX_ENABLE_TX_NORM
          RuleLE_DcmCommunicationControl_0_DCM_DISABLE_RX_ENABLE_TX_NORM_NM: BswMArgumentRef=MC_IMM_BswModeNotification_modeNotificationPort_DcmCommunicationControl_0_EQ_DCM_DISABLE_RX_ENABLE_TX_NORM_NM
          RuleLE_DcmCommunicationControl_0_DCM_DISABLE_RX_TX_NM: BswMArgumentRef=MC_IMM_BswModeNotification_modeNotificationPort_DcmCommunicationControl_0_EQ_DCM_DISABLE_RX_TX_NM
          RuleLE_DcmCommunicationControl_0_DCM_DISABLE_RX_TX_NORMAL: BswMArgumentRef=MC_IMM_BswModeNotification_modeNotificationPort_DcmCommunicationControl_0_EQ_DCM_DISABLE_RX_TX_NORMAL
          RuleLE_DcmCommunicationControl_0_DCM_DISABLE_RX_TX_NORM_NM: BswMArgumentRef=MC_IMM_BswModeNotification_modeNotificationPort_DcmCommunicationControl_0_EQ_DCM_DISABLE_RX_TX_NORM_NM
          RuleLE_DcmCommunicationControl_0_DCM_ENABLE_RX_DISABLE_TX_NM: BswMArgumentRef=MC_IMM_BswModeNotification_modeNotificationPort_DcmCommunicationControl_0_EQ_DCM_ENABLE_RX_DISABLE_TX_NM
          RuleLE_DcmCommunicationControl_0_DCM_ENABLE_RX_DISABLE_TX_NORM: BswMArgumentRef=MC_IMM_BswModeNotification_modeNotificationPort_DcmCommunicationControl_0_EQ_DCM_ENABLE_RX_DISABLE_TX_NORM
          RuleLE_DcmCommunicationControl_0_DCM_ENABLE_RX_DISABLE_TX_NORM_NM: BswMArgumentRef=MC_IMM_BswModeNotification_modeNotificationPort_DcmCommunicationControl_0_EQ_DCM_ENABLE_RX_DISABLE_TX_NORM_NM
          RuleLE_DcmCommunicationControl_0_DCM_ENABLE_RX_TX_NM: BswMArgumentRef=MC_IMM_BswModeNotification_modeNotificationPort_DcmCommunicationControl_0_EQ_DCM_ENABLE_RX_TX_NM
          RuleLE_DcmCommunicationControl_0_DCM_ENABLE_RX_TX_NORM: BswMArgumentRef=MC_IMM_BswModeNotification_modeNotificationPort_DcmCommunicationControl_0_EQ_DCM_ENABLE_RX_TX_NORM
          RuleLE_DcmCommunicationControl_0_DCM_ENABLE_RX_TX_NORM_NM: BswMArgumentRef=MC_IMM_BswModeNotification_modeNotificationPort_DcmCommunicationControl_0_EQ_DCM_ENABLE_RX_TX_NORM_NM
          RuleLE_DcmControlDTCSetting_DISABLEDTCSETTING: BswMArgumentRef=MC_IMM_BswModeNotification_modeNotificationPort_DcmControlDTCSetting_EQ_DISABLEDTCSETTING
          RuleLE_DcmControlDTCSetting_ENABLEDTCSETTING: BswMArgumentRef=MC_IMM_BswModeNotification_modeNotificationPort_DcmControlDTCSetting_EQ_ENABLEDTCSETTING
          RuleLE_DcmModeRapidPowerShutDown_DISABLE_RAPIDPOWERSHUTDOWN: BswMArgumentRef=MC_IMM_BswModeNotification_modeNotificationPort_DcmModeRapidPowerShutDown_EQ_DISABLE_RAPIDPOWERSHUTDOWN
          RuleLE_DcmModeRapidPowerShutDown_ENABLE_RAPIDPOWERSHUTDOWN: BswMArgumentRef=MC_IMM_BswModeNotification_modeNotificationPort_DcmModeRapidPowerShutDown_EQ_ENABLE_RAPIDPOWERSHUTDOWN
          RuleLE_DiagnosticSessionNotification_DEFAULT_SESSION: BswMArgumentRef=MC_IMM_BswModeNotification_modeNotificationPort_DcmDiagnosticSessionControl_EQ_DCM_DEFAULT_SESSION
          RuleLE_DiagnosticSessionNotification_ECU_PROGRAMMING_MODE: BswMArgumentRef=MC_IMM_BswModeNotification_modeNotificationPort_DcmDiagnosticSessionControl_EQ_DCM_ECU_PROGRAMMING_MODE
          RuleLE_DiagnosticSessionNotification_EXTENDED_DIAGNOSTIC_MODE: BswMArgumentRef=MC_IMM_BswModeNotification_modeNotificationPort_DcmDiagnosticSessionControl_EQ_DCM_EXTENDED_DIAGNOSTIC_MODE
          RuleLE_DiagnosticSessionNotification_EXTENDED_DIAGNOSTIC_SESSION: BswMArgumentRef=MC_IMM_BswModeNotification_modeNotificationPort_DcmDiagnosticSessionControl_EQ_DCM_EXTENDED_DIAGNOSTIC_SESSION
          RuleLE_DiagnosticSessionNotification_PROGRAMMING_SESSION: BswMArgumentRef=MC_IMM_BswModeNotification_modeNotificationPort_DcmDiagnosticSessionControl_EQ_DCM_PROGRAMMING_SESSION
          RuleLE_DiagnosticSessionNotification_QUIESCENT_CURRENT_DIAGNOSTIC_MODE_START: BswMArgumentRef=MC_IMM_BswModeNotification_modeNotificationPort_DcmDiagnosticSessionControl_EQ_DCM_QUIESCENT_CURRENT_DIAGNOSTIC_MODE_START
          RuleLE_DiagnosticSessionNotification_SAFETY_SYSTEM_DIAGNOSTIC_SESSION: BswMArgumentRef=MC_IMM_BswModeNotification_modeNotificationPort_DcmDiagnosticSessionControl_EQ_DCM_SAFETY_SYSTEM_DIAGNOSTIC_SESSION
          RuleLE_DiagnosticSessionNotification_SLEEP_MODE_START_REQUEST: BswMArgumentRef=MC_IMM_BswModeNotification_modeNotificationPort_DcmDiagnosticSessionControl_EQ_DCM_SLEEP_MODE_START_REQUEST
          RuleLE_EcuStateTo_OFF: BswMLogicalOperator=BSWM_AND, BswMArgumentRef=LE_NvMWriteAllCompleted, BswMArgumentRef=MC_IMM_GenericRequest_EcuState_EQ_EXIT_SHUTDOWN, BswMArgumentRef=MC_IMM_GenericRequest_ShutdownTarget_EQ_OFF
          RuleLE_EcuStateTo_RESET: BswMLogicalOperator=BSWM_AND, BswMArgumentRef=LE_NvMWriteAllCompleted, BswMArgumentRef=MC_IMM_GenericRequest_EcuState_EQ_EXIT_SHUTDOWN, BswMArgumentRef=MC_IMM_GenericRequest_ShutdownTarget_EQ_RESET
          RuleLE_EcuStateTo_RUN_From_SLEEP: BswMLogicalOperator=BSWM_AND, BswMArgumentRef=MC_IMM_GenericRequest_EcuState_EQ_EXIT_SLEEP, BswMArgumentRef=MC_IMM_GenericRequest_ShutdownTarget_EQ_RUN
          RuleLE_EcuStateTo_RUN_From_STARTUP: BswMLogicalOperator=BSWM_AND, BswMArgumentRef=MC_IMM_GenericRequest_EcuState_EQ_EXIT_STARTUP_THREE, BswMArgumentRef=MC_IMM_GenericRequest_ShutdownTarget_EQ_RUN
          RuleLE_EcuStateTo_SHUTDOWN: BswMLogicalOperator=BSWM_AND, BswMArgumentRef=LE_EcuGoDownTypes, BswMArgumentRef=MC_IMM_GenericRequest_EcuState_EQ_EXIT_RUN
          RuleLE_EcuStateTo_SLEEP: BswMLogicalOperator=BSWM_AND, BswMArgumentRef=LE_EcuSleepAllowed, BswMArgumentRef=MC_IMM_GenericRequest_EcuState_EQ_EXIT_RUN, BswMArgumentRef=MC_IMM_GenericRequest_ShutdownTarget_EQ_SLEEP
          RuleLE_EcuStateTo_STARTUP_THREE: BswMLogicalOperator=BSWM_AND, BswMArgumentRef=LE_NvMReadAllCompleted, BswMArgumentRef=MC_IMM_GenericRequest_EcuState_EQ_EXIT_STARTUP_TWO
          RuleLE_EcuStateTo_STARTUP_TWO: BswMArgumentRef=MC_IMM_EcuMIndication_EQ_STARTUP_TWO
          RuleLE_EcuState_OFF: BswMArgumentRef=MC_IMM_GenericRequest_EcuState_EQ_ENTRY_OFF
          RuleLE_EcuState_RESET: BswMArgumentRef=MC_IMM_GenericRequest_EcuState_EQ_ENTRY_RESET
          RuleLE_EcuState_RUN: BswMArgumentRef=MC_IMM_GenericRequest_EcuState_EQ_ENTRY_RUN
          RuleLE_EcuState_SHUTDOWN: BswMArgumentRef=MC_IMM_GenericRequest_EcuState_EQ_ENTRY_SHUTDOWN
          RuleLE_EcuState_SLEEP: BswMArgumentRef=MC_IMM_GenericRequest_EcuState_EQ_ENTRY_SLEEP
          RuleLE_EcuState_STARTUP_THREE: BswMArgumentRef=MC_IMM_GenericRequest_EcuState_EQ_ENTRY_STARTUP_THREE
          RuleLE_EcuState_STARTUP_TWO: BswMArgumentRef=MC_IMM_GenericRequest_EcuState_EQ_ENTRY_STARTUP_TWO
          RuleLE_ShutdownTargetTo_OFF: BswMLogicalOperator=BSWM_AND, BswMArgumentRef=MC_IMM_GenericRequest_ShutdownTarget_EQ_RUN, BswMArgumentRef=MC_IMM_SwcModeRequest_AppMode_EQ_APP_MODE_INACTIVE_OFF
          RuleLE_ShutdownTargetTo_RESET: BswMLogicalOperator=BSWM_AND, BswMArgumentRef=LE_EcuResetTypes, BswMArgumentRef=MC_IMM_GenericRequest_ShutdownTarget_EQ_RUN
          RuleLE_ShutdownTargetTo_RUN: BswMLogicalOperator=BSWM_AND, BswMArgumentRef=MC_IMM_GenericRequest_ShutdownTarget_EQ_SLEEP, BswMArgumentRef=MC_IMM_SwcModeRequest_AppMode_EQ_APP_MODE_ACTIVE
          RuleLE_ShutdownTargetTo_SLEEP: BswMLogicalOperator=BSWM_AND, BswMArgumentRef=MC_IMM_GenericRequest_ShutdownTarget_EQ_RUN, BswMArgumentRef=MC_IMM_SwcModeRequest_AppMode_EQ_APP_MODE_INACTIVE_SLEEP
          RuleLE_WakeupEventNotification_CAN1RX: BswMArgumentRef=MC_IMM_EcuMWakeupSource_CAN1RX_EQ_VALIDATED
          RuleLE_WakeupEventNotification_CAN1RX_POLL: BswMArgumentRef=MC_IMM_EcuMWakeupSource_CAN1RX_POLL_EQ_VALIDATED
        40 x BswMRule, all with category=TOOL_CONFIGURED, BswMNestedExecutionOnly=0:
          Rule_ComControl_Project_DISABLE_DM: BswMRuleInitState=BSWM_FALSE, BswMRuleExpressionRef=RuleLE_ComControl_Project_DISABLE_DM, BswMRuleTrueActionList=TrueAL_ComControl_Project_DISABLE_DM
          Rule_ComControl_Project_DISABLE_RX: BswMRuleInitState=BSWM_TRUE, BswMRuleExpressionRef=RuleLE_ComControl_Project_DISABLE_RX, BswMRuleTrueActionList=TrueAL_ComControl_Project_DISABLE_RX
          Rule_ComControl_Project_DISABLE_TX: BswMRuleInitState=BSWM_TRUE, BswMRuleExpressionRef=RuleLE_ComControl_Project_DISABLE_TX, BswMRuleTrueActionList=TrueAL_ComControl_Project_DISABLE_TX
          Rule_ComControl_Project_ENABLE_DM: BswMRuleInitState=BSWM_FALSE, BswMRuleExpressionRef=RuleLE_ComControl_Project_ENABLE_DM, BswMRuleTrueActionList=TrueAL_ComControl_Project_ENABLE_DM
          Rule_ComControl_Project_ENABLE_RX: BswMRuleInitState=BSWM_FALSE, BswMRuleExpressionRef=RuleLE_ComControl_Project_ENABLE_RX, BswMRuleTrueActionList=TrueAL_ComControl_Project_ENABLE_RX
          Rule_ComControl_Project_ENABLE_TX: BswMRuleInitState=BSWM_FALSE, BswMRuleExpressionRef=RuleLE_ComControl_Project_ENABLE_TX, BswMRuleTrueActionList=TrueAL_ComControl_Project_ENABLE_TX
          Rule_ComModeNotification_Project_FULL_COM: BswMRuleInitState=BSWM_FALSE, BswMRuleExpressionRef=RuleLE_ComModeNotification_Project_FULL_COM, BswMRuleTrueActionList=TrueAL_ComModeNotification_Project_FULL_COM
          Rule_ComModeNotification_Project_NO_COM: BswMRuleInitState=BSWM_FALSE, BswMRuleExpressionRef=RuleLE_ComModeNotification_Project_NO_COM, BswMRuleTrueActionList=TrueAL_ComModeNotification_Project_NO_COM
          Rule_ComModeNotification_Project_SILENT_COM: BswMRuleInitState=BSWM_FALSE, BswMRuleExpressionRef=RuleLE_ComModeNotification_Project_SILENT_COM, BswMRuleTrueActionList=TrueAL_ComModeNotification_Project_SILENT_COM
          Rule_ComModeRequest_Project_FULL_COM: BswMRuleInitState=BSWM_FALSE, BswMRuleExpressionRef=RuleLE_ComModeRequest_Project_FULL_COM, BswMRuleTrueActionList=TrueAL_ComModeRequest_Project_FULL_COM
          Rule_ComModeRequest_Project_NO_COM: BswMRuleInitState=BSWM_FALSE, BswMRuleExpressionRef=RuleLE_ComModeRequest_Project_NO_COM, BswMRuleTrueActionList=TrueAL_ComModeRequest_Project_NO_COM
          Rule_DiagnosticSessionNotification_DEFAULT_SESSION: BswMRuleInitState=BSWM_FALSE, BswMRuleExpressionRef=RuleLE_DiagnosticSessionNotification_DEFAULT_SESSION, BswMRuleTrueActionList=TrueAL_DiagnosticSessionNotification_DEFAULT_SESSION
          Rule_DiagnosticSessionNotification_ECU_PROGRAMMING_MODE: BswMRuleInitState=BSWM_FALSE, BswMRuleExpressionRef=RuleLE_DiagnosticSessionNotification_ECU_PROGRAMMING_MODE, BswMRuleTrueActionList=TrueAL_DiagnosticSessionNotification_ECU_PROGRAMMING_MODE
          Rule_DiagnosticSessionNotification_EXTENDED_DIAGNOSTIC_MODE: BswMRuleInitState=BSWM_FALSE, BswMRuleExpressionRef=RuleLE_DiagnosticSessionNotification_EXTENDED_DIAGNOSTIC_MODE, BswMRuleTrueActionList=TrueAL_DiagnosticSessionNotification_EXTENDED_DIAGNOSTIC_MODE
          Rule_DiagnosticSessionNotification_EXTENDED_DIAGNOSTIC_SESSION: BswMRuleInitState=BSWM_FALSE, BswMRuleExpressionRef=RuleLE_DiagnosticSessionNotification_EXTENDED_DIAGNOSTIC_SESSION, BswMRuleTrueActionList=TrueAL_DiagnosticSessionNotification_EXTENDED_DIAGNOSTIC_SESSION
          Rule_DiagnosticSessionNotification_PROGRAMMING_SESSION: BswMRuleInitState=BSWM_FALSE, BswMRuleExpressionRef=RuleLE_DiagnosticSessionNotification_PROGRAMMING_SESSION, BswMRuleTrueActionList=TrueAL_DiagnosticSessionNotification_PROGRAMMING_SESSION
          Rule_DiagnosticSessionNotification_QUIESCENT_CURRENT_DIAGNOSTIC_MODE_START: BswMRuleInitState=BSWM_FALSE, BswMRuleExpressionRef=RuleLE_DiagnosticSessionNotification_QUIESCENT_CURRENT_DIAGNOSTIC_MODE_START, BswMRuleTrueActionList=TrueAL_DiagnosticSessionNotification_QUIESCENT_CURRENT_DIAGNOSTIC_MODE_START
          Rule_DiagnosticSessionNotification_SAFETY_SYSTEM_DIAGNOSTIC_SESSION: BswMRuleInitState=BSWM_FALSE, BswMRuleExpressionRef=RuleLE_DiagnosticSessionNotification_SAFETY_SYSTEM_DIAGNOSTIC_SESSION, BswMRuleTrueActionList=TrueAL_DiagnosticSessionNotification_SAFETY_SYSTEM_DIAGNOSTIC_SESSION
          Rule_DiagnosticSessionNotification_SLEEP_MODE_START_REQUEST: BswMRuleInitState=BSWM_FALSE, BswMRuleExpressionRef=RuleLE_DiagnosticSessionNotification_SLEEP_MODE_START_REQUEST, BswMRuleTrueActionList=TrueAL_DiagnosticSessionNotification_SLEEP_MODE_START_REQUEST
          Rule_EcuStateTo_OFF: BswMRuleInitState=BSWM_FALSE, BswMRuleExpressionRef=RuleLE_EcuStateTo_OFF, BswMRuleTrueActionList=TrueAL_EcuStateTo_OFF
          Rule_EcuStateTo_RESET: BswMRuleInitState=BSWM_FALSE, BswMRuleExpressionRef=RuleLE_EcuStateTo_RESET, BswMRuleTrueActionList=TrueAL_EcuStateTo_RESET
          Rule_EcuStateTo_RUN_From_SLEEP: BswMRuleInitState=BSWM_FALSE, BswMRuleExpressionRef=RuleLE_EcuStateTo_RUN_From_SLEEP, BswMRuleTrueActionList=TrueAL_EcuStateTo_RUN_From_SLEEP
          Rule_EcuStateTo_RUN_From_STARTUP: BswMRuleInitState=BSWM_FALSE, BswMRuleExpressionRef=RuleLE_EcuStateTo_RUN_From_STARTUP, BswMRuleTrueActionList=TrueAL_EcuStateTo_RUN_From_STARTUP
          Rule_EcuStateTo_SHUTDOWN: BswMRuleInitState=BSWM_FALSE, BswMRuleExpressionRef=RuleLE_EcuStateTo_SHUTDOWN, BswMRuleTrueActionList=TrueAL_EcuStateTo_SHUTDOWN
          Rule_EcuStateTo_SLEEP: BswMRuleInitState=BSWM_FALSE, BswMRuleExpressionRef=RuleLE_EcuStateTo_SLEEP, BswMRuleTrueActionList=TrueAL_EcuStateTo_SLEEP
          Rule_EcuStateTo_STARTUP_THREE: BswMRuleInitState=BSWM_FALSE, BswMRuleExpressionRef=RuleLE_EcuStateTo_STARTUP_THREE, BswMRuleTrueActionList=TrueAL_EcuStateTo_STARTUP_THREE
          Rule_EcuStateTo_STARTUP_TWO: BswMRuleInitState=BSWM_FALSE, BswMRuleExpressionRef=RuleLE_EcuStateTo_STARTUP_TWO, BswMRuleTrueActionList=TrueAL_EcuStateTo_STARTUP_TWO
          Rule_EcuState_OFF: BswMRuleInitState=BSWM_FALSE, BswMRuleExpressionRef=RuleLE_EcuState_OFF, BswMRuleTrueActionList=TrueAL_EcuState_OFF
          Rule_EcuState_RESET: BswMRuleInitState=BSWM_FALSE, BswMRuleExpressionRef=RuleLE_EcuState_RESET, BswMRuleTrueActionList=TrueAL_EcuState_RESET
          Rule_EcuState_RUN: BswMRuleInitState=BSWM_FALSE, BswMRuleExpressionRef=RuleLE_EcuState_RUN, BswMRuleTrueActionList=TrueAL_EcuState_RUN
          Rule_EcuState_SHUTDOWN: BswMRuleInitState=BSWM_FALSE, BswMRuleExpressionRef=RuleLE_EcuState_SHUTDOWN, BswMRuleTrueActionList=TrueAL_EcuState_SHUTDOWN
          Rule_EcuState_SLEEP: BswMRuleInitState=BSWM_FALSE, BswMRuleExpressionRef=RuleLE_EcuState_SLEEP, BswMRuleTrueActionList=TrueAL_EcuState_SLEEP
          Rule_EcuState_STARTUP_THREE: BswMRuleInitState=BSWM_FALSE, BswMRuleExpressionRef=RuleLE_EcuState_STARTUP_THREE, BswMRuleTrueActionList=TrueAL_EcuState_STARTUP_THREE
          Rule_EcuState_STARTUP_TWO: BswMRuleInitState=BSWM_FALSE, BswMRuleExpressionRef=RuleLE_EcuState_STARTUP_TWO, BswMRuleTrueActionList=TrueAL_EcuState_STARTUP_TWO
          Rule_ShutdownTargetTo_OFF: BswMRuleInitState=BSWM_FALSE, BswMRuleExpressionRef=RuleLE_ShutdownTargetTo_OFF, BswMRuleTrueActionList=TrueAL_ShutdownTargetTo_OFF
          Rule_ShutdownTargetTo_RESET: BswMRuleInitState=BSWM_FALSE, BswMRuleExpressionRef=RuleLE_ShutdownTargetTo_RESET, BswMRuleTrueActionList=TrueAL_ShutdownTargetTo_RESET
          Rule_ShutdownTargetTo_RUN: BswMRuleInitState=BSWM_FALSE, BswMRuleExpressionRef=RuleLE_ShutdownTargetTo_RUN, BswMRuleTrueActionList=TrueAL_ShutdownTargetTo_RUN
          Rule_ShutdownTargetTo_SLEEP: BswMRuleInitState=BSWM_FALSE, BswMRuleExpressionRef=RuleLE_ShutdownTargetTo_SLEEP, BswMRuleTrueActionList=TrueAL_ShutdownTargetTo_SLEEP
          Rule_WakeupEventNotification_CAN1RX: BswMRuleInitState=BSWM_FALSE, BswMRuleExpressionRef=RuleLE_WakeupEventNotification_CAN1RX, BswMRuleTrueActionList=TrueAL_WakeupEventNotification_CAN1RX
          Rule_WakeupEventNotification_CAN1RX_POLL: BswMRuleInitState=BSWM_FALSE, BswMRuleExpressionRef=RuleLE_WakeupEventNotification_CAN1RX_POLL, BswMRuleTrueActionList=TrueAL_WakeupEventNotification_CAN1RX_POLL
      BswMModeControl: category=TOOL_CONFIGURED
        69 x BswMAction, all with category=TOOL_CONFIGURED:
          AC_ComMAllowCom_Project_FALSE
            BswMAvailableActions: category=TOOL_CONFIGURED
              BswMComMAllowCom: category=TOOL_CONFIGURED, BswMComAllowed=0, BswMComMAllowChannelRef=ComMChannel_Project
          AC_ComMAllowCom_Project_TRUE
            BswMAvailableActions: category=TOOL_CONFIGURED
              BswMComMAllowCom: category=TOOL_CONFIGURED, BswMComAllowed=1, BswMComMAllowChannelRef=ComMChannel_Project
          AC_ComMModeSwitch_Project_FULL_COM
            BswMAvailableActions: category=TOOL_CONFIGURED
              BswMComMModeSwitch: category=TOOL_CONFIGURED, BswMComMRequestedMode=BSWM_FULL_COM, BswMComMUserRef=ComMUser_Project
          AC_ComMModeSwitch_Project_NO_COM
            BswMAvailableActions: category=TOOL_CONFIGURED
              BswMComMModeSwitch: category=TOOL_CONFIGURED, BswMComMRequestedMode=BSWM_NO_COM, BswMComMUserRef=ComMUser_Project
          AC_DeadlineMonitoringControl_Rx_ECU1_Project_DISABLE
            BswMAvailableActions: category=TOOL_CONFIGURED
              BswMDeadlineMonitoringControl: category=TOOL_CONFIGURED, BswMDisabledDMPduGroupRef=ComIPduGroupRx_ECU1_Project
          AC_DeadlineMonitoringControl_Rx_ECU1_Project_ENABLE
            BswMAvailableActions: category=TOOL_CONFIGURED
              BswMDeadlineMonitoringControl: category=TOOL_CONFIGURED, BswMEnabledDMPduGroupRef=ComIPduGroupRx_ECU1_Project
          AC_EcuMGoDown_BSWM
            BswMAvailableActions: category=TOOL_CONFIGURED
              BswMEcuMGoDown: category=TOOL_CONFIGURED, BswMEcuMUserIdRef=ECUM_USER_BSWM
          AC_EcuMSelectShutdownTarget_OFF
            BswMAvailableActions: category=TOOL_CONFIGURED
              BswMEcuMSelectShutdownTarget: category=TOOL_CONFIGURED, BswMEcuMShutdownTarget=ECUM_STATE_OFF
          AC_EcuMSelectShutdownTarget_RESET_MCU
            BswMAvailableActions: category=TOOL_CONFIGURED
              BswMEcuMSelectShutdownTarget: category=TOOL_CONFIGURED, BswMEcuMShutdownTarget=ECUM_STATE_RESET, BswMEcuMResetModeRef=ECUM_RESET_MCU
          AC_PduGroupSwitch_Rx_ECU1_Project_DISABLE_REINIT
            BswMAvailableActions: category=TOOL_CONFIGURED
              BswMPduGroupSwitch: category=TOOL_CONFIGURED, BswMPduGroupSwitchReinit=1, BswMDisabledPduGroupRef=ComIPduGroupRx_ECU1_Project
          AC_PduGroupSwitch_Rx_ECU1_Project_ENABLE_REINIT
            BswMAvailableActions: category=TOOL_CONFIGURED
              BswMPduGroupSwitch: category=TOOL_CONFIGURED, BswMPduGroupSwitchReinit=1, BswMEnabledPduGroupRef=ComIPduGroupRx_ECU1_Project
          AC_PduGroupSwitch_Tx_ECU1_Project_DISABLE_REINIT
            BswMAvailableActions: category=TOOL_CONFIGURED
              BswMPduGroupSwitch: category=TOOL_CONFIGURED, BswMPduGroupSwitchReinit=1, BswMDisabledPduGroupRef=ComIPduGroupTx_ECU1_Project
          AC_PduGroupSwitch_Tx_ECU1_Project_ENABLE_REINIT
            BswMAvailableActions: category=TOOL_CONFIGURED
              BswMPduGroupSwitch: category=TOOL_CONFIGURED, BswMPduGroupSwitchReinit=1, BswMEnabledPduGroupRef=ComIPduGroupTx_ECU1_Project
          AC_RteSwitch_ComMMode_Project_FULL_COM
            BswMAvailableActions: category=TOOL_CONFIGURED
              BswMRteSwitch: category=TOOL_CONFIGURED, BswMRteSwitchPortRef=ComMMode_Project, BswMSwitchedMode=FULL_COM
          AC_RteSwitch_ComMMode_Project_NO_COM
            BswMAvailableActions: category=TOOL_CONFIGURED
              BswMRteSwitch: category=TOOL_CONFIGURED, BswMRteSwitchPortRef=ComMMode_Project, BswMSwitchedMode=NO_COM
          AC_RteSwitch_ComMMode_Project_SILENT_COM
            BswMAvailableActions: category=TOOL_CONFIGURED
              BswMRteSwitch: category=TOOL_CONFIGURED, BswMRteSwitchPortRef=ComMMode_Project, BswMSwitchedMode=SILENT_COM
          AC_RteSwitch_DcmDiagnosticSessionControl_DCM_DEFAULT_SESSION
            BswMAvailableActions: category=TOOL_CONFIGURED
              BswMRteSwitch: category=TOOL_CONFIGURED, BswMRteSwitchPortRef=DcmDiagnosticSessionControl, BswMSwitchedMode=DCM_DEFAULT_SESSION
          AC_RteSwitch_DcmDiagnosticSessionControl_DCM_ECU_PROGRAMMING_MODE
            BswMAvailableActions: category=TOOL_CONFIGURED
              BswMRteSwitch: category=TOOL_CONFIGURED, BswMRteSwitchPortRef=DcmDiagnosticSessionControl, BswMSwitchedMode=DCM_ECU_PROGRAMMING_MODE
          AC_RteSwitch_DcmDiagnosticSessionControl_DCM_EXTENDED_DIAGNOSTIC_MODE
            BswMAvailableActions: category=TOOL_CONFIGURED
              BswMRteSwitch: category=TOOL_CONFIGURED, BswMRteSwitchPortRef=DcmDiagnosticSessionControl, BswMSwitchedMode=DCM_EXTENDED_DIAGNOSTIC_MODE
          AC_RteSwitch_DcmDiagnosticSessionControl_DCM_EXTENDED_DIAGNOSTIC_SESSION
            BswMAvailableActions: category=TOOL_CONFIGURED
              BswMRteSwitch: category=TOOL_CONFIGURED, BswMRteSwitchPortRef=DcmDiagnosticSessionControl, BswMSwitchedMode=DCM_EXTENDED_DIAGNOSTIC_SESSION
          AC_RteSwitch_DcmDiagnosticSessionControl_DCM_PROGRAMMING_SESSION
            BswMAvailableActions: category=TOOL_CONFIGURED
              BswMRteSwitch: category=TOOL_CONFIGURED, BswMRteSwitchPortRef=DcmDiagnosticSessionControl, BswMSwitchedMode=DCM_PROGRAMMING_SESSION
          AC_RteSwitch_DcmDiagnosticSessionControl_DCM_QUIESCENT_CURRENT_DIAGNOSTIC_MODE_START
            BswMAvailableActions: category=TOOL_CONFIGURED
              BswMRteSwitch: category=TOOL_CONFIGURED, BswMRteSwitchPortRef=DcmDiagnosticSessionControl, BswMSwitchedMode=DCM_QUIESCENT_CURRENT_DIAGNOSTIC_MODE_START
          AC_RteSwitch_DcmDiagnosticSessionControl_DCM_SAFETY_SYSTEM_DIAGNOSTIC_SESSION
            BswMAvailableActions: category=TOOL_CONFIGURED
              BswMRteSwitch: category=TOOL_CONFIGURED, BswMRteSwitchPortRef=DcmDiagnosticSessionControl, BswMSwitchedMode=DCM_SAFETY_SYSTEM_DIAGNOSTIC_SESSION
          AC_RteSwitch_DcmDiagnosticSessionControl_DCM_SLEEP_MODE_START_REQUEST
            BswMAvailableActions: category=TOOL_CONFIGURED
              BswMRteSwitch: category=TOOL_CONFIGURED, BswMRteSwitchPortRef=DcmDiagnosticSessionControl, BswMSwitchedMode=DCM_SLEEP_MODE_START_REQUEST
          AC_RteSwitch_EcuMode_ECUM_STATE_RUN
            BswMAvailableActions: category=TOOL_CONFIGURED
              BswMRteSwitch: category=TOOL_CONFIGURED, BswMRteSwitchPortRef=EcuMode, BswMSwitchedMode=ECUM_STATE_RUN
          AC_RteSwitch_EcuMode_ECUM_STATE_SHUTDOWN
            BswMAvailableActions: category=TOOL_CONFIGURED
              BswMRteSwitch: category=TOOL_CONFIGURED, BswMRteSwitchPortRef=EcuMode, BswMSwitchedMode=ECUM_STATE_SHUTDOWN
          AC_RteSwitch_EcuMode_ECUM_STATE_SLEEP
            BswMAvailableActions: category=TOOL_CONFIGURED
              BswMRteSwitch: category=TOOL_CONFIGURED, BswMRteSwitchPortRef=EcuMode, BswMSwitchedMode=ECUM_STATE_SLEEP
          AC_RteSwitch_InitState_COMPLETE
            BswMAvailableActions: category=TOOL_CONFIGURED
              BswMRteSwitch: category=TOOL_CONFIGURED, BswMRteSwitchPortRef=InitState, BswMSwitchedMode=COMPLETE
          AC_RteSwitch_PduGroupRx_Project_START
            BswMAvailableActions: category=TOOL_CONFIGURED
              BswMRteSwitch: category=TOOL_CONFIGURED, BswMRteSwitchPortRef=PduGroupRx_Project, BswMSwitchedMode=START
          AC_RteSwitch_PduGroupRx_Project_STOP
            BswMAvailableActions: category=TOOL_CONFIGURED
              BswMRteSwitch: category=TOOL_CONFIGURED, BswMRteSwitchPortRef=PduGroupRx_Project, BswMSwitchedMode=STOP
          AC_RteSwitch_PduGroupTx_Project_START
            BswMAvailableActions: category=TOOL_CONFIGURED
              BswMRteSwitch: category=TOOL_CONFIGURED, BswMRteSwitchPortRef=PduGroupTx_Project, BswMSwitchedMode=START
          AC_RteSwitch_PduGroupTx_Project_STOP
            BswMAvailableActions: category=TOOL_CONFIGURED
              BswMRteSwitch: category=TOOL_CONFIGURED, BswMRteSwitchPortRef=PduGroupTx_Project, BswMSwitchedMode=STOP
          AC_RteSwitch_WakeupEvent_CAN1RX
            BswMAvailableActions: category=TOOL_CONFIGURED
              BswMRteSwitch: category=TOOL_CONFIGURED, BswMRteSwitchPortRef=WakeupEvent, BswMSwitchedMode=CAN1RX
          AC_RteSwitch_WakeupEvent_CAN1RX_POLL
            BswMAvailableActions: category=TOOL_CONFIGURED
              BswMRteSwitch: category=TOOL_CONFIGURED, BswMRteSwitchPortRef=WakeupEvent, BswMSwitchedMode=CAN1RX_POLL
          AC_SchMSwitch_EcuMode_ECUM_STATE_OFF
            BswMAvailableActions: category=TOOL_CONFIGURED
              BswMSchMSwitch: category=TOOL_CONFIGURED, BswMSchMModeDeclarationGroupRef=EcuMode, BswMSchMSwitchedMode=ECUM_STATE_OFF
          AC_SchMSwitch_EcuMode_ECUM_STATE_RESET
            BswMAvailableActions: category=TOOL_CONFIGURED
              BswMSchMSwitch: category=TOOL_CONFIGURED, BswMSchMModeDeclarationGroupRef=EcuMode, BswMSchMSwitchedMode=ECUM_STATE_RESET
          AC_SchMSwitch_EcuMode_ECUM_STATE_RUN
            BswMAvailableActions: category=TOOL_CONFIGURED
              BswMSchMSwitch: category=TOOL_CONFIGURED, BswMSchMModeDeclarationGroupRef=EcuMode, BswMSchMSwitchedMode=ECUM_STATE_RUN
          AC_SchMSwitch_EcuMode_ECUM_STATE_SHUTDOWN
            BswMAvailableActions: category=TOOL_CONFIGURED
              BswMSchMSwitch: category=TOOL_CONFIGURED, BswMSchMModeDeclarationGroupRef=EcuMode, BswMSchMSwitchedMode=ECUM_STATE_SHUTDOWN
          AC_SchMSwitch_EcuMode_ECUM_STATE_SLEEP
            BswMAvailableActions: category=TOOL_CONFIGURED
              BswMSchMSwitch: category=TOOL_CONFIGURED, BswMSchMModeDeclarationGroupRef=EcuMode, BswMSchMSwitchedMode=ECUM_STATE_SLEEP
          AC_SchMSwitch_EcuMode_ECUM_STATE_STARTUP_THREE
            BswMAvailableActions: category=TOOL_CONFIGURED
              BswMSchMSwitch: category=TOOL_CONFIGURED, BswMSchMModeDeclarationGroupRef=EcuMode, BswMSchMSwitchedMode=ECUM_STATE_STARTUP_THREE
          AC_SchMSwitch_EcuMode_ECUM_STATE_STARTUP_TWO
            BswMAvailableActions: category=TOOL_CONFIGURED
              BswMSchMSwitch: category=TOOL_CONFIGURED, BswMSchMModeDeclarationGroupRef=EcuMode, BswMSchMSwitchedMode=ECUM_STATE_STARTUP_TWO
          AC_UserCallout_ComM_DeInit
            BswMAvailableActions: category=TOOL_CONFIGURED
              ComM_DeInit (BswMUserCallout): category=TOOL_CONFIGURED, BswMUserCalloutFunction=ComM_DeInit()
          AC_UserCallout_Com_DeInit
            BswMAvailableActions: category=TOOL_CONFIGURED
              Com_DeInit (BswMUserCallout): category=TOOL_CONFIGURED, BswMUserCalloutFunction=Com_DeInit()
          AC_UserCallout_Dcm_Init
            BswMAvailableActions: category=TOOL_CONFIGURED
              Dcm_Init (BswMUserCallout): category=TOOL_CONFIGURED, BswMUserCalloutFunction=Dcm_Init(NULL_PTR)
          AC_UserCallout_Dem_Init
            BswMAvailableActions: category=TOOL_CONFIGURED
              Dem_Init (BswMUserCallout): category=TOOL_CONFIGURED, BswMUserCalloutFunction=Dem_Init()
          AC_UserCallout_Dem_Shutdown
            BswMAvailableActions: category=TOOL_CONFIGURED
              Dem_Shutdown (BswMUserCallout): category=TOOL_CONFIGURED, BswMUserCalloutFunction=Dem_Shutdown()
          AC_UserCallout_EcuM_GoHalt
            BswMAvailableActions: category=TOOL_CONFIGURED
              EcuM_GoHalt (BswMUserCallout): category=TOOL_CONFIGURED, BswMUserCalloutFunction=EcuM_GoHalt()
          AC_UserCallout_EcuState_ENTRY_OFF
            BswMAvailableActions: category=TOOL_CONFIGURED
              EcuState_ENTRY_OFF (BswMUserCallout): category=TOOL_CONFIGURED, BswMUserCalloutFunction=BswM_RequestMode((BswM_UserType)0x2A, (BswM_ModeType)BSWM_ECUSTATE_ENTRY_OFF)
          AC_UserCallout_EcuState_ENTRY_RESET
            BswMAvailableActions: category=TOOL_CONFIGURED
              EcuState_ENTRY_RESET (BswMUserCallout): category=TOOL_CONFIGURED, BswMUserCalloutFunction=BswM_RequestMode((BswM_UserType)0x2A, (BswM_ModeType)BSWM_ECUSTATE_ENTRY_RESET)
          AC_UserCallout_EcuState_ENTRY_RUN
            BswMAvailableActions: category=TOOL_CONFIGURED
              EcuState_ENTRY_RUN (BswMUserCallout): category=TOOL_CONFIGURED, BswMUserCalloutFunction=BswM_RequestMode((BswM_UserType)0x2A, (BswM_ModeType)BSWM_ECUSTATE_ENTRY_RUN)
          AC_UserCallout_EcuState_ENTRY_SHUTDOWN
            BswMAvailableActions: category=TOOL_CONFIGURED
              EcuState_ENTRY_SHUTDOWN (BswMUserCallout): category=TOOL_CONFIGURED, BswMUserCalloutFunction=BswM_RequestMode((BswM_UserType)0x2A, (BswM_ModeType)BSWM_ECUSTATE_ENTRY_SHUTDOWN)
          AC_UserCallout_EcuState_ENTRY_SLEEP
            BswMAvailableActions: category=TOOL_CONFIGURED
              EcuState_ENTRY_SLEEP (BswMUserCallout): category=TOOL_CONFIGURED, BswMUserCalloutFunction=BswM_RequestMode((BswM_UserType)0x2A, (BswM_ModeType)BSWM_ECUSTATE_ENTRY_SLEEP)
          AC_UserCallout_EcuState_ENTRY_STARTUP_THREE
            BswMAvailableActions: category=TOOL_CONFIGURED
              EcuState_ENTRY_STARTUP_THREE (BswMUserCallout): category=TOOL_CONFIGURED, BswMUserCalloutFunction=BswM_RequestMode((BswM_UserType)0x2A, (BswM_ModeType)BSWM_ECUSTATE_ENTRY_STARTUP_THREE)
          AC_UserCallout_EcuState_ENTRY_STARTUP_TWO
            BswMAvailableActions: category=TOOL_CONFIGURED
              EcuState_ENTRY_STARTUP_TWO (BswMUserCallout): category=TOOL_CONFIGURED, BswMUserCalloutFunction=BswM_RequestMode((BswM_UserType)0x2A, (BswM_ModeType)BSWM_ECUSTATE_ENTRY_STARTUP_TWO)
          AC_UserCallout_EcuState_EXIT_RUN
            BswMAvailableActions: category=TOOL_CONFIGURED
              EcuState_EXIT_RUN (BswMUserCallout): category=TOOL_CONFIGURED, BswMUserCalloutFunction=BswM_RequestMode((BswM_UserType)0x2A, (BswM_ModeType)BSWM_ECUSTATE_EXIT_RUN)
          AC_UserCallout_EcuState_EXIT_SHUTDOWN
            BswMAvailableActions: category=TOOL_CONFIGURED
              EcuState_EXIT_SHUTDOWN (BswMUserCallout): category=TOOL_CONFIGURED, BswMUserCalloutFunction=BswM_RequestMode((BswM_UserType)0x2A, (BswM_ModeType)BSWM_ECUSTATE_EXIT_SHUTDOWN)
          AC_UserCallout_EcuState_EXIT_SLEEP
            BswMAvailableActions: category=TOOL_CONFIGURED
              EcuState_EXIT_SLEEP (BswMUserCallout): category=TOOL_CONFIGURED, BswMUserCalloutFunction=BswM_RequestMode((BswM_UserType)0x2A, (BswM_ModeType)BSWM_ECUSTATE_EXIT_SLEEP)
          AC_UserCallout_EcuState_EXIT_STARTUP_THREE
            BswMAvailableActions: category=TOOL_CONFIGURED
              EcuState_EXIT_STARTUP_THREE (BswMUserCallout): category=TOOL_CONFIGURED, BswMUserCalloutFunction=BswM_RequestMode((BswM_UserType)0x2A, (BswM_ModeType)BSWM_ECUSTATE_EXIT_STARTUP_THREE)
          AC_UserCallout_EcuState_EXIT_STARTUP_TWO
            BswMAvailableActions: category=TOOL_CONFIGURED
              EcuState_EXIT_STARTUP_TWO (BswMUserCallout): category=TOOL_CONFIGURED, BswMUserCalloutFunction=BswM_RequestMode((BswM_UserType)0x2A, (BswM_ModeType)BSWM_ECUSTATE_EXIT_STARTUP_TWO)
          AC_UserCallout_FiM_Init
            BswMAvailableActions: category=TOOL_CONFIGURED
              FiM_Init (BswMUserCallout): category=TOOL_CONFIGURED, BswMUserCalloutFunction=FiM_Init(NULL_PTR)
          AC_UserCallout_Mem_Driver_ShutDown
            BswMAvailableActions: category=TOOL_CONFIGURED
              Mem_Driver_ShutDown (BswMUserCallout): category=TOOL_CONFIGURED, BswMUserCalloutFunction=Mem_Driver_ShutDown()
          AC_UserCallout_Mem_Driver_StartUp
            BswMAvailableActions: category=TOOL_CONFIGURED
              Mem_Driver_StartUp (BswMUserCallout): category=TOOL_CONFIGURED, BswMUserCalloutFunction=Mem_Driver_StartUp()
          AC_UserCallout_Rte_Start_Main
            BswMAvailableActions: category=TOOL_CONFIGURED
              Rte_Start_Main (BswMUserCallout): category=TOOL_CONFIGURED, BswMUserCalloutFunction=(void)Rte_Start()
          AC_UserCallout_Rte_Stop_Main
            BswMAvailableActions: category=TOOL_CONFIGURED
              Rte_Stop_Main (BswMUserCallout): category=TOOL_CONFIGURED, BswMUserCalloutFunction=(void)Rte_Stop()
          AC_UserCallout_ShutdownTargetTo_OFF
            BswMAvailableActions: category=TOOL_CONFIGURED
              ShutdownTargetTo_OFF (BswMUserCallout): category=TOOL_CONFIGURED, BswMUserCalloutFunction=BswM_RequestMode((BswM_UserType)0x12A, (BswM_ModeType)BSWM_SHUTDOWNTARGET_OFF)
          AC_UserCallout_ShutdownTargetTo_RESET
            BswMAvailableActions: category=TOOL_CONFIGURED
              ShutdownTargetTo_RESET (BswMUserCallout): category=TOOL_CONFIGURED, BswMUserCalloutFunction=BswM_RequestMode((BswM_UserType)0x12A, (BswM_ModeType)BSWM_SHUTDOWNTARGET_RESET)
          AC_UserCallout_ShutdownTargetTo_RUN
            BswMAvailableActions: category=TOOL_CONFIGURED
              ShutdownTargetTo_RUN (BswMUserCallout): category=TOOL_CONFIGURED, BswMUserCalloutFunction=BswM_RequestMode((BswM_UserType)0x12A, (BswM_ModeType)BSWM_SHUTDOWNTARGET_RUN)
          AC_UserCallout_ShutdownTargetTo_SLEEP
            BswMAvailableActions: category=TOOL_CONFIGURED
              ShutdownTargetTo_SLEEP (BswMUserCallout): category=TOOL_CONFIGURED, BswMUserCalloutFunction=BswM_RequestMode((BswM_UserType)0x12A, (BswM_ModeType)BSWM_SHUTDOWNTARGET_SLEEP)
          AC_UserCallout_WdgM_DeInit
            BswMAvailableActions: category=TOOL_CONFIGURED
              WdgM_DeInit (BswMUserCallout): category=TOOL_CONFIGURED, BswMUserCalloutFunction=WdgM_DeInit()
        50 x BswMActionList, all with category=TOOL_CONFIGURED:
          AL_ComModeAllow_ALL_FALSE: BswMActionListExecution=BSWM_TRIGGER
            AC_ComMAllowCom_Project_FALSE (BswMActionListItem): category=TOOL_CONFIGURED, BswMAbortOnFail=0, BswMActionListItemIndex=10, BswMActionListItemRef=BswMModeControl/AC_ComMAllowCom_Project_FALSE
          AL_ComModeAllow_ALL_TRUE: BswMActionListExecution=BSWM_TRIGGER
            AC_ComMAllowCom_Project_TRUE (BswMActionListItem): category=TOOL_CONFIGURED, BswMAbortOnFail=0, BswMActionListItemIndex=10, BswMActionListItemRef=BswMModeControl/AC_ComMAllowCom_Project_TRUE
          AL_ComModeRequest_ALL_FULL_COM: BswMActionListExecution=BSWM_TRIGGER
            AC_ComMModeSwitch_Project_FULL_COM (BswMActionListItem): category=TOOL_CONFIGURED, BswMAbortOnFail=0, BswMActionListItemIndex=10, BswMActionListItemRef=BswMModeControl/AC_ComMModeSwitch_Project_FULL_COM
          AL_ComModeRequest_ALL_NO_COM: BswMActionListExecution=BSWM_TRIGGER
            AC_ComMModeSwitch_Project_NO_COM (BswMActionListItem): category=TOOL_CONFIGURED, BswMAbortOnFail=0, BswMActionListItemIndex=10, BswMActionListItemRef=BswMModeControl/AC_ComMModeSwitch_Project_NO_COM
          AL_DriverDeinit: BswMActionListExecution=BSWM_TRIGGER
            4 x BswMActionListItem, all with category=TOOL_CONFIGURED, BswMAbortOnFail=0:
              AC_UserCallout_WdgM_DeInit: BswMActionListItemIndex=10, BswMActionListItemRef=BswMModeControl/AC_UserCallout_WdgM_DeInit
              AC_UserCallout_Com_DeInit: BswMActionListItemIndex=20, BswMActionListItemRef=BswMModeControl/AC_UserCallout_Com_DeInit
              AC_UserCallout_ComM_DeInit: BswMActionListItemIndex=30, BswMActionListItemRef=BswMModeControl/AC_UserCallout_ComM_DeInit
              AC_UserCallout_Mem_Driver_ShutDown: BswMActionListItemIndex=40, BswMActionListItemRef=BswMModeControl/AC_UserCallout_Mem_Driver_ShutDown
          AL_DriverInitThree: BswMActionListExecution=BSWM_TRIGGER
            AC_UserCallout_FiM_Init (BswMActionListItem): category=TOOL_CONFIGURED, BswMAbortOnFail=0, BswMActionListItemIndex=10, BswMActionListItemRef=BswMModeControl/AC_UserCallout_FiM_Init
            AC_UserCallout_Dem_Init (BswMActionListItem): category=TOOL_CONFIGURED, BswMAbortOnFail=0, BswMActionListItemIndex=20, BswMActionListItemRef=BswMModeControl/AC_UserCallout_Dem_Init
          AL_DriverInitTwo: BswMActionListExecution=BSWM_TRIGGER
            AC_UserCallout_Dcm_Init (BswMActionListItem): category=TOOL_CONFIGURED, BswMAbortOnFail=0, BswMActionListItemIndex=10, BswMActionListItemRef=BswMModeControl/AC_UserCallout_Dcm_Init
            AC_UserCallout_Mem_Driver_StartUp (BswMActionListItem): category=TOOL_CONFIGURED, BswMAbortOnFail=0, BswMActionListItemIndex=20, BswMActionListItemRef=BswMModeControl/AC_UserCallout_Mem_Driver_StartUp
          AL_DriverPreDeinit: BswMActionListExecution=BSWM_TRIGGER
            AC_UserCallout_Dem_Shutdown (BswMActionListItem): category=TOOL_CONFIGURED, BswMAbortOnFail=0, BswMActionListItemIndex=10, BswMActionListItemRef=BswMModeControl/AC_UserCallout_Dem_Shutdown
          AL_RteStart: BswMActionListExecution=BSWM_TRIGGER
            AC_UserCallout_Rte_Start_Main (BswMActionListItem): category=TOOL_CONFIGURED, BswMAbortOnFail=0, BswMActionListItemIndex=10, BswMActionListItemRef=BswMModeControl/AC_UserCallout_Rte_Start_Main
          AL_RteStop: BswMActionListExecution=BSWM_TRIGGER
            AC_UserCallout_Rte_Stop_Main (BswMActionListItem): category=TOOL_CONFIGURED, BswMAbortOnFail=0, BswMActionListItemIndex=10, BswMActionListItemRef=BswMModeControl/AC_UserCallout_Rte_Stop_Main
          TrueAL_ComControl_Project_DISABLE_DM: BswMActionListExecution=BSWM_CONDITION
            AC_DeadlineMonitoringControl_Rx_ECU1_Project_DISABLE (BswMActionListItem):
              category = TOOL_CONFIGURED
              BswMAbortOnFail = 0
              BswMActionListItemIndex = 10
              BswMActionListItemRef = BswMModeControl/AC_DeadlineMonitoringControl_Rx_ECU1_Project_DISABLE
          TrueAL_ComControl_Project_DISABLE_RX: BswMActionListExecution=BSWM_TRIGGER
            AC_PduGroupSwitch_Rx_ECU1_Project_DISABLE_REINIT (BswMActionListItem):
              category = TOOL_CONFIGURED
              BswMAbortOnFail = 0
              BswMActionListItemIndex = 10
              BswMActionListItemRef = BswMModeControl/AC_PduGroupSwitch_Rx_ECU1_Project_DISABLE_REINIT
            AC_RteSwitch_PduGroupRx_Project_STOP (BswMActionListItem):
              category = TOOL_CONFIGURED
              BswMAbortOnFail = 0
              BswMActionListItemIndex = 20
              BswMActionListItemRef = BswMModeControl/AC_RteSwitch_PduGroupRx_Project_STOP
          TrueAL_ComControl_Project_DISABLE_TX: BswMActionListExecution=BSWM_TRIGGER
            AC_PduGroupSwitch_Tx_ECU1_Project_DISABLE_REINIT (BswMActionListItem):
              category = TOOL_CONFIGURED
              BswMAbortOnFail = 0
              BswMActionListItemIndex = 10
              BswMActionListItemRef = BswMModeControl/AC_PduGroupSwitch_Tx_ECU1_Project_DISABLE_REINIT
            AC_RteSwitch_PduGroupTx_Project_STOP (BswMActionListItem):
              category = TOOL_CONFIGURED
              BswMAbortOnFail = 0
              BswMActionListItemIndex = 20
              BswMActionListItemRef = BswMModeControl/AC_RteSwitch_PduGroupTx_Project_STOP
          TrueAL_ComControl_Project_ENABLE_DM: BswMActionListExecution=BSWM_TRIGGER
            AC_DeadlineMonitoringControl_Rx_ECU1_Project_ENABLE (BswMActionListItem):
              category = TOOL_CONFIGURED
              BswMAbortOnFail = 0
              BswMActionListItemIndex = 10
              BswMActionListItemRef = BswMModeControl/AC_DeadlineMonitoringControl_Rx_ECU1_Project_ENABLE
          TrueAL_ComControl_Project_ENABLE_RX: BswMActionListExecution=BSWM_TRIGGER
            AC_PduGroupSwitch_Rx_ECU1_Project_ENABLE_REINIT (BswMActionListItem):
              category = TOOL_CONFIGURED
              BswMAbortOnFail = 0
              BswMActionListItemIndex = 10
              BswMActionListItemRef = BswMModeControl/AC_PduGroupSwitch_Rx_ECU1_Project_ENABLE_REINIT
            AC_RteSwitch_PduGroupRx_Project_START (BswMActionListItem):
              category = TOOL_CONFIGURED
              BswMAbortOnFail = 0
              BswMActionListItemIndex = 20
              BswMActionListItemRef = BswMModeControl/AC_RteSwitch_PduGroupRx_Project_START
          TrueAL_ComControl_Project_ENABLE_TX: BswMActionListExecution=BSWM_TRIGGER
            AC_PduGroupSwitch_Tx_ECU1_Project_ENABLE_REINIT (BswMActionListItem):
              category = TOOL_CONFIGURED
              BswMAbortOnFail = 0
              BswMActionListItemIndex = 10
              BswMActionListItemRef = BswMModeControl/AC_PduGroupSwitch_Tx_ECU1_Project_ENABLE_REINIT
            AC_RteSwitch_PduGroupTx_Project_START (BswMActionListItem):
              category = TOOL_CONFIGURED
              BswMAbortOnFail = 0
              BswMActionListItemIndex = 20
              BswMActionListItemRef = BswMModeControl/AC_RteSwitch_PduGroupTx_Project_START
          TrueAL_ComModeNotification_Project_FULL_COM: BswMActionListExecution=BSWM_TRIGGER
            AC_RteSwitch_ComMMode_Project_FULL_COM (BswMActionListItem):
              category = TOOL_CONFIGURED
              BswMAbortOnFail = 0
              BswMActionListItemIndex = 10
              BswMActionListItemRef = BswMModeControl/AC_RteSwitch_ComMMode_Project_FULL_COM
          TrueAL_ComModeNotification_Project_NO_COM: BswMActionListExecution=BSWM_TRIGGER
            AC_RteSwitch_ComMMode_Project_NO_COM (BswMActionListItem):
              category = TOOL_CONFIGURED
              BswMAbortOnFail = 0
              BswMActionListItemIndex = 10
              BswMActionListItemRef = BswMModeControl/AC_RteSwitch_ComMMode_Project_NO_COM
          TrueAL_ComModeNotification_Project_SILENT_COM: BswMActionListExecution=BSWM_TRIGGER
            AC_RteSwitch_ComMMode_Project_SILENT_COM (BswMActionListItem):
              category = TOOL_CONFIGURED
              BswMAbortOnFail = 0
              BswMActionListItemIndex = 10
              BswMActionListItemRef = BswMModeControl/AC_RteSwitch_ComMMode_Project_SILENT_COM
          TrueAL_ComModeRequest_Project_FULL_COM: BswMActionListExecution=BSWM_TRIGGER
            AC_ComMModeSwitch_Project_FULL_COM (BswMActionListItem): category=TOOL_CONFIGURED, BswMAbortOnFail=0, BswMActionListItemIndex=10, BswMActionListItemRef=BswMModeControl/AC_ComMModeSwitch_Project_FULL_COM
          TrueAL_ComModeRequest_Project_NO_COM: BswMActionListExecution=BSWM_TRIGGER
            AC_ComMModeSwitch_Project_NO_COM (BswMActionListItem): category=TOOL_CONFIGURED, BswMAbortOnFail=0, BswMActionListItemIndex=10, BswMActionListItemRef=BswMModeControl/AC_ComMModeSwitch_Project_NO_COM
          TrueAL_DiagnosticSessionNotification_DEFAULT_SESSION: BswMActionListExecution=BSWM_TRIGGER
            AC_RteSwitch_DcmDiagnosticSessionControl_DCM_DEFAULT_SESSION (BswMActionListItem):
              category = TOOL_CONFIGURED
              BswMAbortOnFail = 0
              BswMActionListItemIndex = 10
              BswMActionListItemRef = BswMModeControl/AC_RteSwitch_DcmDiagnosticSessionControl_DCM_DEFAULT_SESSION
          TrueAL_DiagnosticSessionNotification_ECU_PROGRAMMING_MODE: BswMActionListExecution=BSWM_TRIGGER
            AC_RteSwitch_DcmDiagnosticSessionControl_DCM_ECU_PROGRAMMING_MODE (BswMActionListItem):
              category = TOOL_CONFIGURED
              BswMAbortOnFail = 0
              BswMActionListItemIndex = 10
              BswMActionListItemRef = BswMModeControl/AC_RteSwitch_DcmDiagnosticSessionControl_DCM_ECU_PROGRAMMING_MODE
          TrueAL_DiagnosticSessionNotification_EXTENDED_DIAGNOSTIC_MODE: BswMActionListExecution=BSWM_TRIGGER
            AC_RteSwitch_DcmDiagnosticSessionControl_DCM_EXTENDED_DIAGNOSTIC_MODE (BswMActionListItem):
              category = TOOL_CONFIGURED
              BswMAbortOnFail = 0
              BswMActionListItemIndex = 10
              BswMActionListItemRef = BswMModeControl/AC_RteSwitch_DcmDiagnosticSessionControl_DCM_EXTENDED_DIAGNOSTIC_MODE
          TrueAL_DiagnosticSessionNotification_EXTENDED_DIAGNOSTIC_SESSION: BswMActionListExecution=BSWM_TRIGGER
            AC_RteSwitch_DcmDiagnosticSessionControl_DCM_EXTENDED_DIAGNOSTIC_SESSION (BswMActionListItem):
              category = TOOL_CONFIGURED
              BswMAbortOnFail = 0
              BswMActionListItemIndex = 10
              BswMActionListItemRef = BswMModeControl/AC_RteSwitch_DcmDiagnosticSessionControl_DCM_EXTENDED_DIAGNOSTIC_SESSION
          TrueAL_DiagnosticSessionNotification_PROGRAMMING_SESSION: BswMActionListExecution=BSWM_TRIGGER
            AC_RteSwitch_DcmDiagnosticSessionControl_DCM_PROGRAMMING_SESSION (BswMActionListItem):
              category = TOOL_CONFIGURED
              BswMAbortOnFail = 0
              BswMActionListItemIndex = 10
              BswMActionListItemRef = BswMModeControl/AC_RteSwitch_DcmDiagnosticSessionControl_DCM_PROGRAMMING_SESSION
          TrueAL_DiagnosticSessionNotification_QUIESCENT_CURRENT_DIAGNOSTIC_MODE_START: BswMActionListExecution=BSWM_TRIGGER
            AC_RteSwitch_DcmDiagnosticSessionControl_DCM_QUIESCENT_CURRENT_DIAGNOSTIC_MODE_START (BswMActionListItem):
              category = TOOL_CONFIGURED
              BswMAbortOnFail = 0
              BswMActionListItemIndex = 10
              BswMActionListItemRef = BswMModeControl/AC_RteSwitch_DcmDiagnosticSessionControl_DCM_QUIESCENT_CURRENT_DIAGNOSTIC_MODE_START
          TrueAL_DiagnosticSessionNotification_SAFETY_SYSTEM_DIAGNOSTIC_SESSION: BswMActionListExecution=BSWM_TRIGGER
            AC_RteSwitch_DcmDiagnosticSessionControl_DCM_SAFETY_SYSTEM_DIAGNOSTIC_SESSION (BswMActionListItem):
              category = TOOL_CONFIGURED
              BswMAbortOnFail = 0
              BswMActionListItemIndex = 10
              BswMActionListItemRef = BswMModeControl/AC_RteSwitch_DcmDiagnosticSessionControl_DCM_SAFETY_SYSTEM_DIAGNOSTIC_SESSION
          TrueAL_DiagnosticSessionNotification_SLEEP_MODE_START_REQUEST: BswMActionListExecution=BSWM_TRIGGER
            AC_RteSwitch_DcmDiagnosticSessionControl_DCM_SLEEP_MODE_START_REQUEST (BswMActionListItem):
              category = TOOL_CONFIGURED
              BswMAbortOnFail = 0
              BswMActionListItemIndex = 10
              BswMActionListItemRef = BswMModeControl/AC_RteSwitch_DcmDiagnosticSessionControl_DCM_SLEEP_MODE_START_REQUEST
          TrueAL_EcuStateTo_OFF: BswMActionListExecution=BSWM_TRIGGER
            AC_SchMSwitch_EcuMode_ECUM_STATE_OFF (BswMActionListItem):
              category = TOOL_CONFIGURED
              BswMAbortOnFail = 0
              BswMActionListItemIndex = 10
              BswMActionListItemRef = BswMModeControl/AC_SchMSwitch_EcuMode_ECUM_STATE_OFF
            AC_UserCallout_EcuState_ENTRY_OFF (BswMActionListItem): category=TOOL_CONFIGURED, BswMAbortOnFail=0, BswMActionListItemIndex=20, BswMActionListItemRef=BswMModeControl/AC_UserCallout_EcuState_ENTRY_OFF
          TrueAL_EcuStateTo_RESET: BswMActionListExecution=BSWM_TRIGGER
            AC_SchMSwitch_EcuMode_ECUM_STATE_RESET (BswMActionListItem):
              category = TOOL_CONFIGURED
              BswMAbortOnFail = 0
              BswMActionListItemIndex = 10
              BswMActionListItemRef = BswMModeControl/AC_SchMSwitch_EcuMode_ECUM_STATE_RESET
            AC_UserCallout_EcuState_ENTRY_RESET (BswMActionListItem): category=TOOL_CONFIGURED, BswMAbortOnFail=0, BswMActionListItemIndex=20, BswMActionListItemRef=BswMModeControl/AC_UserCallout_EcuState_ENTRY_RESET
          TrueAL_EcuStateTo_RUN_From_SLEEP: BswMActionListExecution=BSWM_TRIGGER
            3 x BswMActionListItem, all with category=TOOL_CONFIGURED, BswMAbortOnFail=0:
              AC_SchMSwitch_EcuMode_ECUM_STATE_RUN: BswMActionListItemIndex=10, BswMActionListItemRef=BswMModeControl/AC_SchMSwitch_EcuMode_ECUM_STATE_RUN
              AC_RteSwitch_EcuMode_ECUM_STATE_RUN: BswMActionListItemIndex=20, BswMActionListItemRef=BswMModeControl/AC_RteSwitch_EcuMode_ECUM_STATE_RUN
              AC_UserCallout_EcuState_ENTRY_RUN: BswMActionListItemIndex=30, BswMActionListItemRef=BswMModeControl/AC_UserCallout_EcuState_ENTRY_RUN
          TrueAL_EcuStateTo_RUN_From_STARTUP: BswMActionListExecution=BSWM_TRIGGER
            3 x BswMActionListItem, all with category=TOOL_CONFIGURED, BswMAbortOnFail=0:
              AC_SchMSwitch_EcuMode_ECUM_STATE_RUN: BswMActionListItemIndex=10, BswMActionListItemRef=BswMModeControl/AC_SchMSwitch_EcuMode_ECUM_STATE_RUN
              AC_RteSwitch_EcuMode_ECUM_STATE_RUN: BswMActionListItemIndex=20, BswMActionListItemRef=BswMModeControl/AC_RteSwitch_EcuMode_ECUM_STATE_RUN
              AC_UserCallout_EcuState_ENTRY_RUN: BswMActionListItemIndex=30, BswMActionListItemRef=BswMModeControl/AC_UserCallout_EcuState_ENTRY_RUN
          TrueAL_EcuStateTo_SHUTDOWN: BswMActionListExecution=BSWM_TRIGGER
            3 x BswMActionListItem, all with category=TOOL_CONFIGURED, BswMAbortOnFail=0:
              AC_SchMSwitch_EcuMode_ECUM_STATE_SHUTDOWN: BswMActionListItemIndex=10, BswMActionListItemRef=BswMModeControl/AC_SchMSwitch_EcuMode_ECUM_STATE_SHUTDOWN
              AC_RteSwitch_EcuMode_ECUM_STATE_SHUTDOWN: BswMActionListItemIndex=20, BswMActionListItemRef=BswMModeControl/AC_RteSwitch_EcuMode_ECUM_STATE_SHUTDOWN
              AC_UserCallout_EcuState_ENTRY_SHUTDOWN: BswMActionListItemIndex=30, BswMActionListItemRef=BswMModeControl/AC_UserCallout_EcuState_ENTRY_SHUTDOWN
          TrueAL_EcuStateTo_SLEEP: BswMActionListExecution=BSWM_TRIGGER
            3 x BswMActionListItem, all with category=TOOL_CONFIGURED, BswMAbortOnFail=0:
              AC_SchMSwitch_EcuMode_ECUM_STATE_SLEEP: BswMActionListItemIndex=10, BswMActionListItemRef=BswMModeControl/AC_SchMSwitch_EcuMode_ECUM_STATE_SLEEP
              AC_RteSwitch_EcuMode_ECUM_STATE_SLEEP: BswMActionListItemIndex=20, BswMActionListItemRef=BswMModeControl/AC_RteSwitch_EcuMode_ECUM_STATE_SLEEP
              AC_UserCallout_EcuState_ENTRY_SLEEP: BswMActionListItemIndex=30, BswMActionListItemRef=BswMModeControl/AC_UserCallout_EcuState_ENTRY_SLEEP
          TrueAL_EcuStateTo_STARTUP_THREE: BswMActionListExecution=BSWM_TRIGGER
            AC_SchMSwitch_EcuMode_ECUM_STATE_STARTUP_THREE (BswMActionListItem):
              category = TOOL_CONFIGURED
              BswMAbortOnFail = 0
              BswMActionListItemIndex = 10
              BswMActionListItemRef = BswMModeControl/AC_SchMSwitch_EcuMode_ECUM_STATE_STARTUP_THREE
            AC_UserCallout_EcuState_ENTRY_STARTUP_THREE (BswMActionListItem):
              category = TOOL_CONFIGURED
              BswMAbortOnFail = 0
              BswMActionListItemIndex = 20
              BswMActionListItemRef = BswMModeControl/AC_UserCallout_EcuState_ENTRY_STARTUP_THREE
          TrueAL_EcuStateTo_STARTUP_TWO: BswMActionListExecution=BSWM_TRIGGER
            AC_SchMSwitch_EcuMode_ECUM_STATE_STARTUP_TWO (BswMActionListItem):
              category = TOOL_CONFIGURED
              BswMAbortOnFail = 0
              BswMActionListItemIndex = 10
              BswMActionListItemRef = BswMModeControl/AC_SchMSwitch_EcuMode_ECUM_STATE_STARTUP_TWO
            AC_UserCallout_EcuState_ENTRY_STARTUP_TWO (BswMActionListItem):
              category = TOOL_CONFIGURED
              BswMAbortOnFail = 0
              BswMActionListItemIndex = 20
              BswMActionListItemRef = BswMModeControl/AC_UserCallout_EcuState_ENTRY_STARTUP_TWO
          TrueAL_EcuState_OFF: BswMActionListExecution=BSWM_TRIGGER
            AC_EcuMGoDown_BSWM (BswMActionListItem): category=TOOL_CONFIGURED, BswMAbortOnFail=0, BswMActionListItemIndex=10, BswMActionListItemRef=BswMModeControl/AC_EcuMGoDown_BSWM
          TrueAL_EcuState_RESET: BswMActionListExecution=BSWM_TRIGGER
            AC_EcuMGoDown_BSWM (BswMActionListItem): category=TOOL_CONFIGURED, BswMAbortOnFail=0, BswMActionListItemIndex=10, BswMActionListItemRef=BswMModeControl/AC_EcuMGoDown_BSWM
          TrueAL_EcuState_RUN: BswMActionListExecution=BSWM_TRIGGER
            AC_UserCallout_EcuState_EXIT_RUN (BswMActionListItem): category=TOOL_CONFIGURED, BswMAbortOnFail=0, BswMActionListItemIndex=10, BswMActionListItemRef=BswMModeControl/AC_UserCallout_EcuState_EXIT_RUN
          TrueAL_EcuState_SHUTDOWN: BswMActionListExecution=BSWM_TRIGGER
            5 x BswMActionListItem, all with category=TOOL_CONFIGURED, BswMAbortOnFail=0:
              AL_ComModeAllow_ALL_FALSE: BswMActionListItemIndex=10, BswMActionListItemRef=BswMModeControl/AL_ComModeAllow_ALL_FALSE
              AL_DriverPreDeinit: BswMActionListItemIndex=20, BswMActionListItemRef=BswMModeControl/AL_DriverPreDeinit
              AL_RteStop: BswMActionListItemIndex=30, BswMActionListItemRef=BswMModeControl/AL_RteStop
              AL_DriverDeinit: BswMActionListItemIndex=40, BswMActionListItemRef=BswMModeControl/AL_DriverDeinit
              AC_UserCallout_EcuState_EXIT_SHUTDOWN: BswMActionListItemIndex=50, BswMActionListItemRef=BswMModeControl/AC_UserCallout_EcuState_EXIT_SHUTDOWN
          TrueAL_EcuState_SLEEP: BswMActionListExecution=BSWM_TRIGGER
            AC_UserCallout_EcuM_GoHalt (BswMActionListItem): category=TOOL_CONFIGURED, BswMAbortOnFail=0, BswMActionListItemIndex=10, BswMActionListItemRef=BswMModeControl/AC_UserCallout_EcuM_GoHalt
            AC_UserCallout_EcuState_EXIT_SLEEP (BswMActionListItem): category=TOOL_CONFIGURED, BswMAbortOnFail=0, BswMActionListItemIndex=20, BswMActionListItemRef=BswMModeControl/AC_UserCallout_EcuState_EXIT_SLEEP
          TrueAL_EcuState_STARTUP_THREE: BswMActionListExecution=BSWM_TRIGGER
            5 x BswMActionListItem, all with category=TOOL_CONFIGURED, BswMAbortOnFail=0:
              AL_DriverInitThree: BswMActionListItemIndex=10, BswMActionListItemRef=BswMModeControl/AL_DriverInitThree
              AL_ComModeAllow_ALL_TRUE: BswMActionListItemIndex=20, BswMActionListItemRef=BswMModeControl/AL_ComModeAllow_ALL_TRUE
              AL_RteStart: BswMActionListItemIndex=30, BswMActionListItemRef=BswMModeControl/AL_RteStart
              AC_RteSwitch_InitState_COMPLETE: BswMActionListItemIndex=40, BswMActionListItemRef=BswMModeControl/AC_RteSwitch_InitState_COMPLETE
              AC_UserCallout_EcuState_EXIT_STARTUP_THREE: BswMActionListItemIndex=50, BswMActionListItemRef=BswMModeControl/AC_UserCallout_EcuState_EXIT_STARTUP_THREE
          TrueAL_EcuState_STARTUP_TWO: BswMActionListExecution=BSWM_TRIGGER
            AL_DriverInitTwo (BswMActionListItem): category=TOOL_CONFIGURED, BswMAbortOnFail=0, BswMActionListItemIndex=10, BswMActionListItemRef=BswMModeControl/AL_DriverInitTwo
            AC_UserCallout_EcuState_EXIT_STARTUP_TWO (BswMActionListItem):
              category = TOOL_CONFIGURED
              BswMAbortOnFail = 0
              BswMActionListItemIndex = 20
              BswMActionListItemRef = BswMModeControl/AC_UserCallout_EcuState_EXIT_STARTUP_TWO
          TrueAL_ShutdownTargetTo_OFF: BswMActionListExecution=BSWM_TRIGGER
            AC_EcuMSelectShutdownTarget_OFF (BswMActionListItem): category=TOOL_CONFIGURED, BswMAbortOnFail=0, BswMActionListItemIndex=10, BswMActionListItemRef=BswMModeControl/AC_EcuMSelectShutdownTarget_OFF
            AC_UserCallout_ShutdownTargetTo_OFF (BswMActionListItem): category=TOOL_CONFIGURED, BswMAbortOnFail=0, BswMActionListItemIndex=20, BswMActionListItemRef=BswMModeControl/AC_UserCallout_ShutdownTargetTo_OFF
          TrueAL_ShutdownTargetTo_RESET: BswMActionListExecution=BSWM_TRIGGER
            AC_EcuMSelectShutdownTarget_RESET_MCU (BswMActionListItem):
              category = TOOL_CONFIGURED
              BswMAbortOnFail = 0
              BswMActionListItemIndex = 10
              BswMActionListItemRef = BswMModeControl/AC_EcuMSelectShutdownTarget_RESET_MCU
            AC_UserCallout_ShutdownTargetTo_RESET (BswMActionListItem):
              category = TOOL_CONFIGURED
              BswMAbortOnFail = 0
              BswMActionListItemIndex = 20
              BswMActionListItemRef = BswMModeControl/AC_UserCallout_ShutdownTargetTo_RESET
          TrueAL_ShutdownTargetTo_RUN: BswMActionListExecution=BSWM_TRIGGER
            AC_UserCallout_ShutdownTargetTo_RUN (BswMActionListItem): category=TOOL_CONFIGURED, BswMAbortOnFail=0, BswMActionListItemIndex=10, BswMActionListItemRef=BswMModeControl/AC_UserCallout_ShutdownTargetTo_RUN
          TrueAL_ShutdownTargetTo_SLEEP: BswMActionListExecution=BSWM_TRIGGER
            AC_UserCallout_ShutdownTargetTo_SLEEP (BswMActionListItem):
              category = TOOL_CONFIGURED
              BswMAbortOnFail = 0
              BswMActionListItemIndex = 10
              BswMActionListItemRef = BswMModeControl/AC_UserCallout_ShutdownTargetTo_SLEEP
          TrueAL_WakeupEventNotification_CAN1RX: BswMActionListExecution=BSWM_TRIGGER
            AC_RteSwitch_WakeupEvent_CAN1RX (BswMActionListItem): category=TOOL_CONFIGURED, BswMAbortOnFail=0, BswMActionListItemIndex=10, BswMActionListItemRef=BswMModeControl/AC_RteSwitch_WakeupEvent_CAN1RX
          TrueAL_WakeupEventNotification_CAN1RX_POLL: BswMActionListExecution=BSWM_TRIGGER
            AC_RteSwitch_WakeupEvent_CAN1RX_POLL (BswMActionListItem):
              category = TOOL_CONFIGURED
              BswMAbortOnFail = 0
              BswMActionListItemIndex = 10
              BswMActionListItemRef = BswMModeControl/AC_RteSwitch_WakeupEvent_CAN1RX_POLL
        7 x BswMSwitchPort, all with category=TOOL_CONFIGURED:
          ComMMode_Project: BswMModeSwitchInterfaceRef=ComMModeInterface_Project
          DcmDiagnosticSessionControl: BswMModeSwitchInterfaceRef=DcmDiagnosticSessionControl
          EcuMode: BswMModeSwitchInterfaceRef=EcuModeInterface
          InitState: BswMModeSwitchInterfaceRef=InitStateInterface
          PduGroupRx_Project: BswMModeSwitchInterfaceRef=PduGroupRxInterface_Project
          PduGroupTx_Project: BswMModeSwitchInterfaceRef=PduGroupTxInterface_Project
          WakeupEvent: BswMModeSwitchInterfaceRef=WakeupEventInterface
