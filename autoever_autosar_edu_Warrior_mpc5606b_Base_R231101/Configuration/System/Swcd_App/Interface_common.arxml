AUTOSAR XML (schema 4-3-0)
package /Interface
  sender receiver interface If_DriverInputValidatedData
    5 x data:
      BrakeSw: type=boolean
      AccelSw: type=boolean
      SocLevel: type=uint8
      VehicleSpeed: type=uint8
      DriverInputFault: type=uint8
  sender receiver interface If_VcuToDrv
    data RegenLevel: type=uint8
    data RegenEnable: type=boolean
    data LimitReason: type=uint8
  sender receiver interface If_DrvToVcu
    6 x data:
      BrakeSw: type=boolean
      AccelSw: type=boolean
      SocLevel: type=uint8
      VehicleSpeed: type=uint8
      DriverInputFault: type=uint8
      AliveCounter: type=uint8
