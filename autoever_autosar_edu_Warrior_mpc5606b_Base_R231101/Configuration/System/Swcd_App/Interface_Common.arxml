AUTOSAR XML (schema 4-3-0)
package /Interface
  sender receiver interface If_DriverInputData
    5 x data:
      BrakeSw: type=boolean
      AccelSw: type=boolean
      SocLevel: type=uint8
      VehicleSpeed: type=uint8
      ReadStatus: type=boolean
  sender receiver interface If_DriverValidatedData
    data DriverValidatedData: type=ADT_DriverInputValidatedData
