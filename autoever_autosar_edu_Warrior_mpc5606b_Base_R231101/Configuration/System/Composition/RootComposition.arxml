AUTOSAR XML (schema 4-0-3)
package /AUTOSAR
  composition sw component type CSWC_RootCompostion
    12 x component:
      SWC_Actuator: type=SWC_Actuator
      SWC_ComM: type=SWC_ComM
      SWC_DiagnosticMonitor: type=SWC_DiagnosticMonitor
      SWC_DiagnosticService: type=SWC_DiagnosticService
      SWC_WdgMTest: type=SWC_WdgMTest
      SWC_ErrM: type=SWC_ErrM
      SWC_AppMode: type=SWC_AppMode
      SWC_TestModeUser: type=SWC_TestModeUser
      SWC_TestModeManager: type=SWC_TestModeManager
      SWC_CanCom: type=SWC_CanCom
      SWC_InputDiag: type=SWC_InputDiag
      SWC_LedCtrl: type=SWC_LedCtrl
