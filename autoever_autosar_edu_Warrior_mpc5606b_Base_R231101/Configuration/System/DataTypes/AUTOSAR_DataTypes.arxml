AUTOSAR XML (schema 4-0-3)
standard types defined: boolean, uint8, uint8_least, uint16, uint16_least, uint32, uint32_least, sint8, sint8_least, sint16, sint16_least, sint32, sint32_least, float32, float64
package /AUTOSAR_DataTypes/ImplementationDataTypes
  impl type ADT_DriverInputValidatedData: category=STRUCTURE
    5 x element, all with category=TYPE_REFERENCE:
      BrakeSw: implementation-data-type=boolean
      AccelSw: implementation-data-type=boolean
      SocLevel: implementation-data-type=uint8
      VehicleSpeed: implementation-data-type=uint8
      DriverInputFault: implementation-data-type=uint8
