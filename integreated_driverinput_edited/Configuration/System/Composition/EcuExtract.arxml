AUTOSAR XML (schema 4-0-3)
package /ECU_EXTRACT
  system EcuExtract: category=ECU_EXTRACT
    system mapping DataMappings
      data-mappings:
        communication-direction=OUT, data-element=SWC_CanCom.RootSwCompositionPrototype.Project_DriverStatus.AliveCounter, system-signal=SystemSignal_Project_DriverStatus_AliveCounter
        communication-direction=OUT, data-element=SWC_CanCom.RootSwCompositionPrototype.Project_DriverStatus.SocLevel, system-signal=SystemSignal_Project_DriverStatus_SocLevel
        communication-direction=OUT, data-element=SWC_CanCom.RootSwCompositionPrototype.Project_DriverStatus.BrakeSw, system-signal=SystemSignal_Project_DriverStatus_BrakeSw
        communication-direction=OUT, data-element=SWC_CanCom.RootSwCompositionPrototype.Project_DriverStatus.VehicleSpeed, system-signal=SystemSignal_Project_DriverStatus_VehicleSpeed
        communication-direction=IN, data-element=SWC_CanCom.RootSwCompositionPrototype.Project_VCURegenStatus.LimitReason, system-signal=SystemSignal_Project_VCURegenStatus_LimitReason
        communication-direction=IN, data-element=SWC_CanCom.RootSwCompositionPrototype.Project_VCURegenStatus.RegenEnable, system-signal=SystemSignal_Project_VCURegenStatus_RegenEnable
        communication-direction=OUT, data-element=SWC_CanCom.RootSwCompositionPrototype.Project_DriverStatus.AccelSw, system-signal=SystemSignal_Project_DriverStatus_AccelSw
        communication-direction=OUT, data-element=SWC_CanCom.RootSwCompositionPrototype.Project_DriverStatus.DriverInputFault, system-signal=SystemSignal_Project_DriverStatus_DriverInputFault
        communication-direction=IN, data-element=SWC_CanCom.RootSwCompositionPrototype.Project_VCURegenStatus.RegenLevel, system-signal=SystemSignal_Project_VCURegenStatus_RegenLevel
    system mapping SwMappings
      sw-mappings:
        swc to ecu mapping SwMapping0: ecu-instance=ECU1
          component:
            RootSwCompositionPrototype.SWC_Actuator
            RootSwCompositionPrototype.SWC_AppMode
            RootSwCompositionPrototype.SWC_CanCom
            RootSwCompositionPrototype.SWC_ComM
            RootSwCompositionPrototype.SWC_DiagnosticMonitor
            RootSwCompositionPrototype.SWC_DiagnosticService
            RootSwCompositionPrototype.SWC_ErrM
            RootSwCompositionPrototype.SWC_HwInput
            RootSwCompositionPrototype.SWC_InputDiag
            RootSwCompositionPrototype.SWC_LedCtrl
            RootSwCompositionPrototype.SWC_TestModeManager
            RootSwCompositionPrototype.SWC_TestModeUser
            RootSwCompositionPrototype.SWC_WdgMTest
            RootSwCompositionPrototype.Svc_IoHwAb
            RootSwCompositionPrototype.BswM
            RootSwCompositionPrototype.ComM
            RootSwCompositionPrototype.Dcm
            RootSwCompositionPrototype.Dem
            RootSwCompositionPrototype.Det
            RootSwCompositionPrototype.EcuM
            RootSwCompositionPrototype.FiM
            RootSwCompositionPrototype.NvM
            RootSwCompositionPrototype.WdgM
    system mapping PncMappings
    root-software-compositions:
      root sw composition prototype RootSwCompositionPrototype: software-composition=EcuComposition
  ecu instance ECU1: associated-com-i-pdu-group=[ISignalIPduGroupTx_ECU1_Project, ISignalIPduGroupRx_ECU1_Project]
    can communication controller ECU1_Project
    can communication connector Conn_ECU1_Project: comm-controller=ECU1_Project
  composition sw component type EcuComposition
    23 x component:
      SWC_Actuator: type=SWC_Actuator
      SWC_AppMode: type=SWC_AppMode
      SWC_CanCom: type=SWC_CanCom
      SWC_ComM: type=SWC_ComM
      SWC_DiagnosticMonitor: type=SWC_DiagnosticMonitor
      SWC_DiagnosticService: type=SWC_DiagnosticService
      SWC_ErrM: type=SWC_ErrM
      SWC_HwInput: type=SWC_HwInput
      SWC_InputDiag: type=SWC_InputDiag
      SWC_LedCtrl: type=SWC_LedCtrl
      SWC_TestModeManager: type=SWC_TestModeManager
      SWC_TestModeUser: type=SWC_TestModeUser
      SWC_WdgMTest: type=SWC_WdgMTest
      Svc_IoHwAb: type=IoHwAb
      BswM: type=BswM
      ComM: type=ComM
      Dcm: type=Dcm
      Dem: type=Dem
      Det: type=Det
      EcuM: type=EcuM
      FiM: type=FiM
      NvM: type=NvM
      WdgM: type=WdgM
    connect SWC_HwInput.P_DriverInputData -> SWC_InputDiag.R_DriverInput
    connect SWC_InputDiag.P_DriverInputValidatedData -> SWC_CanCom.R_DriverInputValidatedData
    connect SWC_InputDiag.P_DriverInputValidatedData -> SWC_LedCtrl.R_DriverInputValidatedData
    connect SWC_CanCom.P_VcuToDrv -> SWC_LedCtrl.R_VcuToDrv
    connect Svc_IoHwAb.P_IoHwAbDigitalDirectLogical_LED01 -> SWC_LedCtrl.R_Led1Ctrl
    connect Svc_IoHwAb.P_IoHwAbDigitalDirectLogical_LED02 -> SWC_LedCtrl.R_Led2Ctrl
    connect Svc_IoHwAb.P_IoHwAbDigitalDirectLogical_LED03 -> SWC_LedCtrl.R_Led3Ctrl
    connect Svc_IoHwAb.P_IoHwAbDigitalDirectLogical_LED04 -> SWC_LedCtrl.R_Led4Ctrl
    connect Svc_IoHwAb.P_IoHwAbDigitalDirectLogical_S{01..04} -> SWC_HwInput.R_SW{01..04}
    connect Svc_IoHwAb.P_IoHwAbAnalogInputDirectLogical_Pot -> SWC_HwInput.R_POT
