AUTOSAR XML (schema 4-0-3)
package /Adc
  module config Adc: implementation-config-variant=VARIANT-POST-BUILD, module-description=BswImplementation_Adc
    AdcConfigSet_0 (AdcConfigSet)
      AdcHwUnit_0 (AdcHwUnit):
        AdcClockSource = CLK_SRC_0
        AdcHwUnitId = ADC_UNIT_0
        AdcPrescale = 2
        AdcPowerDownDelay = 15
        AdcAltPowerDownDelay = 15
        AdcMuxDelay = 15
        AdcAutoClockOff = 0
        AdcBypassSampling = 0
        AdcPresamplingEnableSignal = ADC_PRESAMP_VOLTAGE_V0
        32 x AdcChannel, all with AdcChannelConvTime=0, AdcChannelRefVoltsrcHigh=UPPER_REF_VOLT_0, AdcChannelRefVoltsrcLow=LOWER_REF_VOLT_0, AdcChannelResolution=10, AdcChannelSampTime=7, AdcEnablePresampling=0:
          AdcChannel_0: AdcChannelId=0, AdcHwChannel=ANP_0
            AdcThresholdControl: AdcEnableThresholds=0, AdcThresholdControlRegister=ADC_THRESHOLD_REG_0, AdcHighThreshold=1023, AdcLowThreshold=0, AdcWdogNotification=NULL_PTR
          AdcChannel_1: AdcChannelId=1, AdcHwChannel=ANP_1
            AdcThresholdControl: AdcEnableThresholds=0, AdcThresholdControlRegister=ADC_THRESHOLD_REG_0, AdcHighThreshold=1023, AdcLowThreshold=0, AdcWdogNotification=NULL_PTR
          AdcChannel_2: AdcChannelId=2, AdcHwChannel=ANP_2
            AdcThresholdControl: AdcEnableThresholds=0, AdcThresholdControlRegister=ADC_THRESHOLD_REG_0, AdcHighThreshold=1023, AdcLowThreshold=0, AdcWdogNotification=NULL_PTR
          AdcChannel_3: AdcChannelId=3, AdcHwChannel=ANP_3
            AdcThresholdControl: AdcEnableThresholds=0, AdcThresholdControlRegister=ADC_THRESHOLD_REG_0, AdcHighThreshold=1023, AdcLowThreshold=0, AdcWdogNotification=NULL_PTR
          AdcChannel_4: AdcChannelId=4, AdcHwChannel=ANP_4
            AdcThresholdControl: AdcEnableThresholds=0, AdcThresholdControlRegister=ADC_THRESHOLD_REG_0, AdcHighThreshold=1023, AdcLowThreshold=0, AdcWdogNotification=NULL_PTR
          AdcChannel_5: AdcChannelId=5, AdcHwChannel=ANP_5
            AdcThresholdControl: AdcEnableThresholds=0, AdcThresholdControlRegister=ADC_THRESHOLD_REG_0, AdcHighThreshold=1023, AdcLowThreshold=0, AdcWdogNotification=NULL_PTR
          AdcChannel_6: AdcChannelId=6, AdcHwChannel=ANP_6
            AdcThresholdControl: AdcEnableThresholds=0, AdcThresholdControlRegister=ADC_THRESHOLD_REG_0, AdcHighThreshold=1023, AdcLowThreshold=0, AdcWdogNotification=NULL_PTR
          AdcChannel_7: AdcChannelId=7, AdcHwChannel=ANP_7
            AdcThresholdControl: AdcEnableThresholds=0, AdcThresholdControlRegister=ADC_THRESHOLD_REG_0, AdcHighThreshold=1023, AdcLowThreshold=0, AdcWdogNotification=NULL_PTR
          AdcChannel_8: AdcChannelId=8, AdcHwChannel=ANP_8
            AdcThresholdControl: AdcEnableThresholds=0, AdcThresholdControlRegister=ADC_THRESHOLD_REG_0, AdcHighThreshold=1023, AdcLowThreshold=0, AdcWdogNotification=NULL_PTR
          AdcChannel_9: AdcChannelId=9, AdcHwChannel=ANP_9
            AdcThresholdControl: AdcEnableThresholds=0, AdcThresholdControlRegister=ADC_THRESHOLD_REG_0, AdcHighThreshold=1023, AdcLowThreshold=0, AdcWdogNotification=NULL_PTR
          AdcChannel_10: AdcChannelId=10, AdcHwChannel=ANP_10
            AdcThresholdControl: AdcEnableThresholds=0, AdcThresholdControlRegister=ADC_THRESHOLD_REG_0, AdcHighThreshold=1023, AdcLowThreshold=0, AdcWdogNotification=NULL_PTR
          AdcChannel_11: AdcChannelId=11, AdcHwChannel=ANP_11
            AdcThresholdControl: AdcEnableThresholds=0, AdcThresholdControlRegister=ADC_THRESHOLD_REG_0, AdcHighThreshold=1023, AdcLowThreshold=0, AdcWdogNotification=NULL_PTR
          AdcChannel_12: AdcChannelId=12, AdcHwChannel=ANP_12
            AdcThresholdControl: AdcEnableThresholds=0, AdcThresholdControlRegister=ADC_THRESHOLD_REG_0, AdcHighThreshold=1023, AdcLowThreshold=0, AdcWdogNotification=NULL_PTR
          AdcChannel_13: AdcChannelId=13, AdcHwChannel=ANP_13
            AdcThresholdControl: AdcEnableThresholds=0, AdcThresholdControlRegister=ADC_THRESHOLD_REG_0, AdcHighThreshold=1023, AdcLowThreshold=0, AdcWdogNotification=NULL_PTR
          AdcChannel_14: AdcChannelId=14, AdcHwChannel=ANP_14
            AdcThresholdControl: AdcEnableThresholds=0, AdcThresholdControlRegister=ADC_THRESHOLD_REG_0, AdcHighThreshold=1023, AdcLowThreshold=0, AdcWdogNotification=NULL_PTR
          AdcChannel_15: AdcChannelId=15, AdcHwChannel=ANP_15
            AdcThresholdControl: AdcEnableThresholds=0, AdcThresholdControlRegister=ADC_THRESHOLD_REG_0, AdcHighThreshold=1023, AdcLowThreshold=0, AdcWdogNotification=NULL_PTR
          AdcChannel_16: AdcChannelId=16, AdcHwChannel=ANS_0
            AdcThresholdControl: AdcEnableThresholds=0, AdcThresholdControlRegister=ADC_THRESHOLD_REG_0, AdcHighThreshold=1023, AdcLowThreshold=0, AdcWdogNotification=NULL_PTR
          AdcChannel_17: AdcChannelId=17, AdcHwChannel=ANS_1
            AdcThresholdControl: AdcEnableThresholds=0, AdcThresholdControlRegister=ADC_THRESHOLD_REG_0, AdcHighThreshold=1023, AdcLowThreshold=0, AdcWdogNotification=NULL_PTR
          AdcChannel_18: AdcChannelId=18, AdcHwChannel=ANS_2
            AdcThresholdControl: AdcEnableThresholds=0, AdcThresholdControlRegister=ADC_THRESHOLD_REG_0, AdcHighThreshold=1023, AdcLowThreshold=0, AdcWdogNotification=NULL_PTR
          AdcChannel_19: AdcChannelId=19, AdcHwChannel=ANX_0_CH_64
            AdcThresholdControl: AdcEnableThresholds=0, AdcThresholdControlRegister=ADC_THRESHOLD_REG_0, AdcHighThreshold=1023, AdcLowThreshold=0, AdcWdogNotification=NULL_PTR
          AdcChannel_20: AdcChannelId=20, AdcHwChannel=ANX_0_CH_65
            AdcThresholdControl: AdcEnableThresholds=0, AdcThresholdControlRegister=ADC_THRESHOLD_REG_0, AdcHighThreshold=1023, AdcLowThreshold=0, AdcWdogNotification=NULL_PTR
          AdcChannel_21: AdcChannelId=21, AdcHwChannel=ANS_5
            AdcThresholdControl: AdcEnableThresholds=0, AdcThresholdControlRegister=ADC_THRESHOLD_REG_0, AdcHighThreshold=1023, AdcLowThreshold=0, AdcWdogNotification=NULL_PTR
          AdcChannel_22: AdcChannelId=22, AdcHwChannel=ANS_6
            AdcThresholdControl: AdcEnableThresholds=0, AdcThresholdControlRegister=ADC_THRESHOLD_REG_0, AdcHighThreshold=1023, AdcLowThreshold=0, AdcWdogNotification=NULL_PTR
          AdcChannel_23: AdcChannelId=23, AdcHwChannel=ANS_7
            AdcThresholdControl: AdcEnableThresholds=0, AdcThresholdControlRegister=ADC_THRESHOLD_REG_0, AdcHighThreshold=1023, AdcLowThreshold=0, AdcWdogNotification=NULL_PTR
          AdcChannel_24: AdcChannelId=24, AdcHwChannel=ANS_8
            AdcThresholdControl: AdcEnableThresholds=0, AdcThresholdControlRegister=ADC_THRESHOLD_REG_0, AdcHighThreshold=1023, AdcLowThreshold=0, AdcWdogNotification=NULL_PTR
          AdcChannel_25: AdcChannelId=25, AdcHwChannel=ANS_9
            AdcThresholdControl: AdcEnableThresholds=0, AdcThresholdControlRegister=ADC_THRESHOLD_REG_0, AdcHighThreshold=1023, AdcLowThreshold=0, AdcWdogNotification=NULL_PTR
          AdcChannel_26: AdcChannelId=26, AdcHwChannel=ANS_10
            AdcThresholdControl: AdcEnableThresholds=0, AdcThresholdControlRegister=ADC_THRESHOLD_REG_0, AdcHighThreshold=1023, AdcLowThreshold=0, AdcWdogNotification=NULL_PTR
          AdcChannel_27: AdcChannelId=27, AdcHwChannel=ANS_11
            AdcThresholdControl: AdcEnableThresholds=0, AdcThresholdControlRegister=ADC_THRESHOLD_REG_0, AdcHighThreshold=1023, AdcLowThreshold=0, AdcWdogNotification=NULL_PTR
          AdcChannel_28: AdcChannelId=28, AdcHwChannel=ANS_12
            AdcThresholdControl: AdcEnableThresholds=0, AdcThresholdControlRegister=ADC_THRESHOLD_REG_0, AdcHighThreshold=1023, AdcLowThreshold=0, AdcWdogNotification=NULL_PTR
          AdcChannel_29: AdcChannelId=29, AdcHwChannel=ANS_13
            AdcThresholdControl: AdcEnableThresholds=0, AdcThresholdControlRegister=ADC_THRESHOLD_REG_0, AdcHighThreshold=1023, AdcLowThreshold=0, AdcWdogNotification=NULL_PTR
          AdcChannel_30: AdcChannelId=30, AdcHwChannel=ANS_14
            AdcThresholdControl: AdcEnableThresholds=0, AdcThresholdControlRegister=ADC_THRESHOLD_REG_0, AdcHighThreshold=1023, AdcLowThreshold=0, AdcWdogNotification=NULL_PTR
          AdcChannel_31: AdcChannelId=31, AdcHwChannel=ANS_15
            AdcThresholdControl: AdcEnableThresholds=0, AdcThresholdControlRegister=ADC_THRESHOLD_REG_0, AdcHighThreshold=1023, AdcLowThreshold=0, AdcWdogNotification=NULL_PTR
        33 x AdcGroup, all with AdcGroupAccessMode=ADC_ACCESS_MODE_SINGLE, AdcGroupConversionMode=ADC_CONV_MODE_ONESHOT, AdcGroupConversionType=ADC_CONV_TYPE_NORMAL, AdcGroupPriority=0, AdcGroupReplacement=ADC_GROUP_REPL_ABORT_RESTART, AdcGroupTriggSrc=ADC_TRIGG_SRC_SW, AdcHwTrigSignal=ADC_HW_TRIG_RISING_EDGE, AdcHwTrigTimer=0, AdcStreamingBufferMode=ADC_STREAM_BUFFER_LINEAR, AdcStreamingNumSamples=1, AdcEnableChDisableChGroup=0, AdcMultipleHardwareTriggerGroup=0:
          AdcAllGroup0: AdcGroupId=32, AdcNotification=AdcAllGrp0Nf, AdcWithoutInterrupts=0, AdcGroupDefinition=AdcChannel_0, AdcGroupDefinition=AdcChannel_1, AdcGroupDefinition=AdcChannel_2, AdcGroupDefinition=AdcChannel_3, AdcGroupDefinition=AdcChannel_4, AdcGroupDefinition=AdcChannel_5, AdcGroupDefinition=AdcChannel_6, AdcGroupDefinition=AdcChannel_7, AdcGroupDefinition=AdcChannel_8, AdcGroupDefinition=AdcChannel_9, AdcGroupDefinition=AdcChannel_10, AdcGroupDefinition=AdcChannel_11, AdcGroupDefinition=AdcChannel_12, AdcGroupDefinition=AdcChannel_13, AdcGroupDefinition=AdcChannel_14, AdcGroupDefinition=AdcChannel_15, AdcGroupDefinition=AdcChannel_16, AdcGroupDefinition=AdcChannel_17, AdcGroupDefinition=AdcChannel_18, AdcGroupDefinition=AdcChannel_19, AdcGroupDefinition=AdcChannel_20, AdcGroupDefinition=AdcChannel_21, AdcGroupDefinition=AdcChannel_22, AdcGroupDefinition=AdcChannel_23, AdcGroupDefinition=AdcChannel_24, AdcGroupDefinition=AdcChannel_25, AdcGroupDefinition=AdcChannel_26, AdcGroupDefinition=AdcChannel_27, AdcGroupDefinition=AdcChannel_28, AdcGroupDefinition=AdcChannel_29, AdcGroupDefinition=AdcChannel_30, AdcGroupDefinition=AdcChannel_31
            AdcGroupConversionConfiguration: AdcLatchingDuration=ADC_HALF_CLOCK_CYCLE, AdcComparisonDuration=ADC_TWO_LATCH_CYCLE, AdcSamplingDuration=3
          AdcGroup_0: AdcGroupId=0, AdcNotification=NULL_PTR, AdcWithoutInterrupts=1, AdcGroupDefinition=AdcChannel_0
            AdcGroupConversionConfiguration: AdcLatchingDuration=ADC_ONE_CLOCK_CYCLE, AdcComparisonDuration=ADC_THREE_LATCH_CYCLE, AdcSamplingDuration=3
          AdcGroup_1: AdcGroupId=1, AdcNotification=NULL_PTR, AdcWithoutInterrupts=1, AdcGroupDefinition=AdcChannel_1
            AdcGroupConversionConfiguration: AdcLatchingDuration=ADC_HALF_CLOCK_CYCLE, AdcComparisonDuration=ADC_TWO_LATCH_CYCLE, AdcSamplingDuration=3
          AdcGroup_2: AdcGroupId=2, AdcNotification=NULL_PTR, AdcWithoutInterrupts=1, AdcGroupDefinition=AdcChannel_2
            AdcGroupConversionConfiguration: AdcLatchingDuration=ADC_HALF_CLOCK_CYCLE, AdcComparisonDuration=ADC_TWO_LATCH_CYCLE, AdcSamplingDuration=3
          AdcGroup_3: AdcGroupId=3, AdcNotification=NULL_PTR, AdcWithoutInterrupts=1, AdcGroupDefinition=AdcChannel_3
            AdcGroupConversionConfiguration: AdcLatchingDuration=ADC_HALF_CLOCK_CYCLE, AdcComparisonDuration=ADC_TWO_LATCH_CYCLE, AdcSamplingDuration=3
          AdcGroup_4: AdcGroupId=4, AdcNotification=NULL_PTR, AdcWithoutInterrupts=1, AdcGroupDefinition=AdcChannel_4
            AdcGroupConversionConfiguration: AdcLatchingDuration=ADC_HALF_CLOCK_CYCLE, AdcComparisonDuration=ADC_TWO_LATCH_CYCLE, AdcSamplingDuration=3
          AdcGroup_5: AdcGroupId=5, AdcNotification=NULL_PTR, AdcWithoutInterrupts=1, AdcGroupDefinition=AdcChannel_5
            AdcGroupConversionConfiguration: AdcLatchingDuration=ADC_HALF_CLOCK_CYCLE, AdcComparisonDuration=ADC_TWO_LATCH_CYCLE, AdcSamplingDuration=3
          AdcGroup_6: AdcGroupId=6, AdcNotification=NULL_PTR, AdcWithoutInterrupts=1, AdcGroupDefinition=AdcChannel_6
            AdcGroupConversionConfiguration: AdcLatchingDuration=ADC_HALF_CLOCK_CYCLE, AdcComparisonDuration=ADC_TWO_LATCH_CYCLE, AdcSamplingDuration=3
          AdcGroup_7: AdcGroupId=7, AdcNotification=NULL_PTR, AdcWithoutInterrupts=1, AdcGroupDefinition=AdcChannel_7
            AdcGroupConversionConfiguration: AdcLatchingDuration=ADC_HALF_CLOCK_CYCLE, AdcComparisonDuration=ADC_TWO_LATCH_CYCLE, AdcSamplingDuration=3
          AdcGroup_8: AdcGroupId=8, AdcNotification=NULL_PTR, AdcWithoutInterrupts=1, AdcGroupDefinition=AdcChannel_8
            AdcGroupConversionConfiguration: AdcLatchingDuration=ADC_HALF_CLOCK_CYCLE, AdcComparisonDuration=ADC_TWO_LATCH_CYCLE, AdcSamplingDuration=3
          AdcGroup_9: AdcGroupId=9, AdcNotification=NULL_PTR, AdcWithoutInterrupts=1, AdcGroupDefinition=AdcChannel_9
            AdcGroupConversionConfiguration: AdcLatchingDuration=ADC_HALF_CLOCK_CYCLE, AdcComparisonDuration=ADC_TWO_LATCH_CYCLE, AdcSamplingDuration=3
          AdcGroup_10: AdcGroupId=10, AdcNotification=NULL_PTR, AdcWithoutInterrupts=1, AdcGroupDefinition=AdcChannel_10
            AdcGroupConversionConfiguration: AdcLatchingDuration=ADC_HALF_CLOCK_CYCLE, AdcComparisonDuration=ADC_TWO_LATCH_CYCLE, AdcSamplingDuration=3
          AdcGroup_11: AdcGroupId=11, AdcNotification=NULL_PTR, AdcWithoutInterrupts=1, AdcGroupDefinition=AdcChannel_11
            AdcGroupConversionConfiguration: AdcLatchingDuration=ADC_HALF_CLOCK_CYCLE, AdcComparisonDuration=ADC_TWO_LATCH_CYCLE, AdcSamplingDuration=3
          AdcGroup_12: AdcGroupId=12, AdcNotification=NULL_PTR, AdcWithoutInterrupts=1, AdcGroupDefinition=AdcChannel_12
            AdcGroupConversionConfiguration: AdcLatchingDuration=ADC_HALF_CLOCK_CYCLE, AdcComparisonDuration=ADC_TWO_LATCH_CYCLE, AdcSamplingDuration=3
          AdcGroup_13: AdcGroupId=13, AdcNotification=NULL_PTR, AdcWithoutInterrupts=1, AdcGroupDefinition=AdcChannel_13
            AdcGroupConversionConfiguration: AdcLatchingDuration=ADC_HALF_CLOCK_CYCLE, AdcComparisonDuration=ADC_TWO_LATCH_CYCLE, AdcSamplingDuration=3
          AdcGroup_14: AdcGroupId=14, AdcNotification=NULL_PTR, AdcWithoutInterrupts=1, AdcGroupDefinition=AdcChannel_14
            AdcGroupConversionConfiguration: AdcLatchingDuration=ADC_HALF_CLOCK_CYCLE, AdcComparisonDuration=ADC_TWO_LATCH_CYCLE, AdcSamplingDuration=3
          AdcGroup_15: AdcGroupId=15, AdcNotification=NULL_PTR, AdcWithoutInterrupts=1, AdcGroupDefinition=AdcChannel_15
            AdcGroupConversionConfiguration: AdcLatchingDuration=ADC_HALF_CLOCK_CYCLE, AdcComparisonDuration=ADC_TWO_LATCH_CYCLE, AdcSamplingDuration=3
          AdcGroup_16: AdcGroupId=16, AdcNotification=NULL_PTR, AdcWithoutInterrupts=1, AdcGroupDefinition=AdcChannel_16
            AdcGroupConversionConfiguration: AdcLatchingDuration=ADC_HALF_CLOCK_CYCLE, AdcComparisonDuration=ADC_TWO_LATCH_CYCLE, AdcSamplingDuration=3
          AdcGroup_17: AdcGroupId=17, AdcNotification=NULL_PTR, AdcWithoutInterrupts=1, AdcGroupDefinition=AdcChannel_17
            AdcGroupConversionConfiguration: AdcLatchingDuration=ADC_HALF_CLOCK_CYCLE, AdcComparisonDuration=ADC_TWO_LATCH_CYCLE, AdcSamplingDuration=3
          AdcGroup_18: AdcGroupId=18, AdcNotification=NULL_PTR, AdcWithoutInterrupts=1, AdcGroupDefinition=AdcChannel_18
            AdcGroupConversionConfiguration: AdcLatchingDuration=ADC_HALF_CLOCK_CYCLE, AdcComparisonDuration=ADC_TWO_LATCH_CYCLE, AdcSamplingDuration=3
          AdcGroup_19: AdcGroupId=19, AdcNotification=NULL_PTR, AdcWithoutInterrupts=1, AdcGroupDefinition=AdcChannel_19
            AdcGroupConversionConfiguration: AdcLatchingDuration=ADC_HALF_CLOCK_CYCLE, AdcComparisonDuration=ADC_TWO_LATCH_CYCLE, AdcSamplingDuration=3
          AdcGroup_20: AdcGroupId=20, AdcNotification=NULL_PTR, AdcWithoutInterrupts=1, AdcGroupDefinition=AdcChannel_20
            AdcGroupConversionConfiguration: AdcLatchingDuration=ADC_HALF_CLOCK_CYCLE, AdcComparisonDuration=ADC_TWO_LATCH_CYCLE, AdcSamplingDuration=3
          AdcGroup_21: AdcGroupId=21, AdcNotification=NULL_PTR, AdcWithoutInterrupts=1, AdcGroupDefinition=AdcChannel_21
            AdcGroupConversionConfiguration: AdcLatchingDuration=ADC_HALF_CLOCK_CYCLE, AdcComparisonDuration=ADC_TWO_LATCH_CYCLE, AdcSamplingDuration=3
          AdcGroup_22: AdcGroupId=22, AdcNotification=NULL_PTR, AdcWithoutInterrupts=1, AdcGroupDefinition=AdcChannel_22
            AdcGroupConversionConfiguration: AdcLatchingDuration=ADC_HALF_CLOCK_CYCLE, AdcComparisonDuration=ADC_TWO_LATCH_CYCLE, AdcSamplingDuration=3
          AdcGroup_23: AdcGroupId=23, AdcNotification=NULL_PTR, AdcWithoutInterrupts=1, AdcGroupDefinition=AdcChannel_23
            AdcGroupConversionConfiguration: AdcLatchingDuration=ADC_HALF_CLOCK_CYCLE, AdcComparisonDuration=ADC_TWO_LATCH_CYCLE, AdcSamplingDuration=3
          AdcGroup_24: AdcGroupId=24, AdcNotification=NULL_PTR, AdcWithoutInterrupts=1, AdcGroupDefinition=AdcChannel_24
            AdcGroupConversionConfiguration: AdcLatchingDuration=ADC_HALF_CLOCK_CYCLE, AdcComparisonDuration=ADC_TWO_LATCH_CYCLE, AdcSamplingDuration=3
          AdcGroup_25: AdcGroupId=25, AdcNotification=NULL_PTR, AdcWithoutInterrupts=1, AdcGroupDefinition=AdcChannel_25
            AdcGroupConversionConfiguration: AdcLatchingDuration=ADC_HALF_CLOCK_CYCLE, AdcComparisonDuration=ADC_TWO_LATCH_CYCLE, AdcSamplingDuration=3
          AdcGroup_26: AdcGroupId=26, AdcNotification=NULL_PTR, AdcWithoutInterrupts=1, AdcGroupDefinition=AdcChannel_26
            AdcGroupConversionConfiguration: AdcLatchingDuration=ADC_HALF_CLOCK_CYCLE, AdcComparisonDuration=ADC_TWO_LATCH_CYCLE, AdcSamplingDuration=3
          AdcGroup_27: AdcGroupId=27, AdcNotification=NULL_PTR, AdcWithoutInterrupts=1, AdcGroupDefinition=AdcChannel_27
            AdcGroupConversionConfiguration: AdcLatchingDuration=ADC_HALF_CLOCK_CYCLE, AdcComparisonDuration=ADC_TWO_LATCH_CYCLE, AdcSamplingDuration=3
          AdcGroup_28: AdcGroupId=28, AdcNotification=NULL_PTR, AdcWithoutInterrupts=1, AdcGroupDefinition=AdcChannel_28
            AdcGroupConversionConfiguration: AdcLatchingDuration=ADC_HALF_CLOCK_CYCLE, AdcComparisonDuration=ADC_TWO_LATCH_CYCLE, AdcSamplingDuration=3
          AdcGroup_29: AdcGroupId=29, AdcNotification=NULL_PTR, AdcWithoutInterrupts=1, AdcGroupDefinition=AdcChannel_29
            AdcGroupConversionConfiguration: AdcLatchingDuration=ADC_HALF_CLOCK_CYCLE, AdcComparisonDuration=ADC_TWO_LATCH_CYCLE, AdcSamplingDuration=3
          AdcGroup_30: AdcGroupId=30, AdcNotification=NULL_PTR, AdcWithoutInterrupts=1, AdcGroupDefinition=AdcChannel_30
            AdcGroupConversionConfiguration: AdcLatchingDuration=ADC_HALF_CLOCK_CYCLE, AdcComparisonDuration=ADC_TWO_LATCH_CYCLE, AdcSamplingDuration=3
          AdcGroup_31: AdcGroupId=31, AdcNotification=NULL_PTR, AdcWithoutInterrupts=1, AdcGroupDefinition=AdcChannel_31
            AdcGroupConversionConfiguration: AdcLatchingDuration=ADC_HALF_CLOCK_CYCLE, AdcComparisonDuration=ADC_TWO_LATCH_CYCLE, AdcSamplingDuration=3
        AdcNormalAltConvTimings:
          AdcLatchingDurationNormal = ADC_HALF_CLOCK_CYCLE
          AdcComparisonDurationNormal = ADC_TWO_LATCH_CYCLE
          AdcSamplingDurationNormal = 3
          AdcLatchingDurationAlt = ADC_HALF_CLOCK_CYCLE
          AdcComparisonDurationAlt = ADC_TWO_LATCH_CYCLE
          AdcSamplingDurationAlt = 3
      AdcGeneric: AdcPriorityQueueMaxDepth=1, AdcTransferType=ADC_INTERRUPT
    AdcGeneral:
      AdcDeInitApi = 0
      AdcDevErrorDetect = 1
      AdcEnableLimitCheck = 0
      AdcEnableQueuing = 0
      AdcEnableStartStopGroupApi = 1
      AdcGrpNotifCapability = 1
      AdcHwTriggerApi = 0
      AdcPriorityImplementation = ADC_PRIORITY_NONE
      AdcReadGroupApi = 1
      AdcResultAlignment = ADC_ALIGN_RIGHT
      AdcVersionInfoApi = 0
      AdcConvTimeOnce = 0
      AdcPreSamplingOnce = 0
      AdcWdgThresholdOnce = 0
      AdcSetOnceRegisters = 0
      ADCDirectDMAResultBufferCopy = 0
      AdcTimeout = 65535
      AdcMuxDelaySupport = 0
      AdcMuxDelaySupportPerGroup = 0
    AdcPublishedInformation: AdcMaxChannelResolution=10, AdcChannelValueSigned=0, AdcGroupFirstChannelFixed=0
    CommonPublishedInformation:
      ArReleaseMajorVersion = 4
      ArReleaseMinorVersion = 0
      ArReleaseRevisionVersion = 3
      ModuleId = 123
      SwMajorVersion = 1
      SwMinorVersion = 0
      VendorId = 43
      SwPatchVersion = 1
    NonAutosar:
      AdcEnableCtuTrigNonAutosarApi = 0
      AdcSetModeApi = 1
      AdcEnableDualClockMode = 0
      AdcEnableGroupDependentChannelNames = 0
      AdcBypassConsistencyLoop = 0
      AdcEnableChDisableChApi = 0
      AdcGetInjectedConvStatusApi = 0
      AdcErrataInterruptedNormalGroup = 1
      AdcErrataOptimizedSwAbort = 1
      AdcDisableDemReportErrorStatus = 0
      AdcEnableThresholdConfiguration = 0
    AdcDemEventParameterRefs: ADC_E_TIMEOUT=ADC_E_TIMEOUT
