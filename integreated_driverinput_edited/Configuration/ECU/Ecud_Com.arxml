AUTOSAR XML (schema 4-0-3)
package /AUTOSAR
  module config Com: implementation-config-variant=VARIANT-PRE-COMPILE, module-description=BswImplementation_Com
    ComConfig: ComConfigurationId=0
      ComIPduGroupRx_ECU1_Project (ComIPduGroup): category=TOOL_CONFIGURED, ComIPduGroupHandleId=0
      ComIPduGroupTx_ECU1_Project (ComIPduGroup): category=TOOL_CONFIGURED, ComIPduGroupHandleId=1
      ComTimeBase: category=TOOL_CONFIGURED, ComGwTimeBase=0.005, ComRxTimeBase=0.005, ComTxTimeBase=0.005
      22 x ComIPdu, all with category=TOOL_CONFIGURED, ComIPduSignalProcessing=DEFERRED:
        ComIPdu_Project_DriverStatus: ComIPduDirection=SEND, ComIPduHandleId=14, ComIPduType=NORMAL, ComIPduSignalRef=ComISignal_Project_DriverStatus_BrakeSw, ComIPduSignalRef=ComISignal_Project_DriverStatus_AccelSw, ComIPduSignalRef=ComISignal_Project_DriverStatus_SocLevel, ComIPduSignalRef=ComISignal_Project_DriverStatus_DriverInputFault, ComIPduSignalRef=ComISignal_Project_DriverStatus_AliveCounter, ComIPduSignalRef=ComISignal_Project_DriverStatus_VehicleSpeed, ComPduIdRef=Pdu_ISignalIPdu_Project_DriverStatus, ComIPduGroupRef=ComIPduGroupTx_ECU1_Project
          ComTxIpdu_ComIPdu_Project_DriverStatus (ComTxIPdu): category=TOOL_CONFIGURED, ComTxIPduUnusedAreasDefault=0, ComMinimumDelayTime=0.0
            ComTxModeTrue_ComTxIpdu_ComIPdu_Project_DriverStatus (ComTxModeTrue): category=TOOL_CONFIGURED
              ComTxMode_ComTxModeTrue_ComTxIpdu_ComIPdu_Project_DriverStatus (ComTxMode): category=TOOL_CONFIGURED, ComTxModeTimeOffset=0.0, ComTxModeTimePeriod=0.01, ComTxModeMode=PERIODIC
        ComIPdu_Project_VCURegenStatus: ComIPduDirection=RECEIVE, ComIPduHandleId=0, ComIPduType=NORMAL, ComIPduSignalRef=ComISignal_Project_VCURegenStatus_RegenEnable, ComIPduSignalRef=ComISignal_Project_VCURegenStatus_RegenLevel, ComIPduSignalRef=ComISignal_Project_VCURegenStatus_LimitReason, ComPduIdRef=Pdu_ISignalIPdu_Project_VCURegenStatus, ComIPduGroupRef=ComIPduGroupRx_ECU1_Project
        ComIPdu_Project_GST_Msg_TP2: ComIPduDirection=RECEIVE, ComIPduHandleId=1, ComIPduType=TP, ComIPduSignalRef=ComISignal_Project_GST_Msg_TP2_Project_GST_Msg_TP2_signal, ComPduIdRef=Pdu_ISignalIPdu_Project_GST_Msg_TP2, ComIPduGroupRef=ComIPduGroupRx_ECU1_Project
        ComIPdu_Project_GST_Msg_TP1: ComIPduDirection=RECEIVE, ComIPduHandleId=2, ComIPduType=TP, ComIPduSignalRef=ComISignal_Project_GST_Msg_TP1_Project_GST_Msg_TP1_signal, ComPduIdRef=Pdu_ISignalIPdu_Project_GST_Msg_TP1, ComIPduGroupRef=ComIPduGroupRx_ECU1_Project
        ComIPdu_Project_ECU1_Msg_GW1: ComIPduDirection=SEND, ComIPduHandleId=3, ComIPduType=NORMAL, ComIPduSignalRef=ComISignal_Project_ECU1_Msg_GW1_ECU1_Msg_GW1_Sig1, ComIPduSignalRef=ComISignal_Project_ECU1_Msg_GW1_ECU1_Msg_GW1_Sig2, ComPduIdRef=Pdu_ISignalIPdu_Project_ECU1_Msg_GW1, ComIPduGroupRef=ComIPduGroupTx_ECU1_Project
          ComTxIpdu_ComIPdu_Project_ECU1_Msg_GW1 (ComTxIPdu): category=TOOL_CONFIGURED, ComTxIPduUnusedAreasDefault=0, ComMinimumDelayTime=0.02
            ComTxModeTrue_ComTxIpdu_ComIPdu_Project_ECU1_Msg_GW1 (ComTxModeTrue): category=TOOL_CONFIGURED
              ComTxMode_ComTxModeTrue_ComTxIpdu_ComIPdu_Project_ECU1_Msg_GW1 (ComTxMode): category=TOOL_CONFIGURED, ComTxModeNumberOfRepetitions=3, ComTxModeRepetitionPeriod=0.04, ComTxModeMode=DIRECT
        ComIPdu_Project_ECU1_Msg_TP2: ComIPduDirection=SEND, ComIPduHandleId=0, ComIPduType=TP, ComIPduSignalRef=ComISignal_Project_ECU1_Msg_TP2_Project_ECU1_Msg_TP2_signal, ComPduIdRef=Pdu_ISignalIPdu_Project_ECU1_Msg_TP2, ComIPduGroupRef=ComIPduGroupTx_ECU1_Project
          ComTxIpdu_ComIPdu_Project_ECU1_Msg_TP2 (ComTxIPdu): category=TOOL_CONFIGURED, ComTxIPduUnusedAreasDefault=0, ComMinimumDelayTime=0.0
            ComTxModeTrue_ComTxIpdu_ComIPdu_Project_ECU1_Msg_TP2 (ComTxModeTrue): category=TOOL_CONFIGURED
              ComTxMode_ComTxModeTrue_ComTxIpdu_ComIPdu_Project_ECU1_Msg_TP2 (ComTxMode): category=TOOL_CONFIGURED, ComTxModeNumberOfRepetitions=0, ComTxModeRepetitionPeriod=0.0, ComTxModeMode=DIRECT
        ComIPdu_Project_ECU2_Msg_PIF1: ComIPduDirection=RECEIVE, ComIPduHandleId=3, ComIPduType=NORMAL, ComIPduSignalRef=ComISignal_Project_ECU2_Msg_PIF1_ECU2_Msg_PIF1_Sig1, ComIPduSignalRef=ComISignal_Project_ECU2_Msg_PIF1_ECU2_Msg_PIF1_Sig2, ComPduIdRef=Pdu_ISignalIPdu_Project_ECU2_Msg_PIF1, ComIPduGroupRef=ComIPduGroupRx_ECU1_Project
        ComIPdu_Project_ECU2_Msg_POE1: ComIPduDirection=RECEIVE, ComIPduHandleId=4, ComIPduType=NORMAL, ComIPduSignalRef=ComISignal_Project_ECU2_Msg_POE1_ECU2_Msg_POE1_Sig2, ComIPduSignalRef=ComISignal_Project_ECU2_Msg_POE1_ECU2_Msg_POE1_Sig1, ComPduIdRef=Pdu_ISignalIPdu_Project_ECU2_Msg_POE1, ComIPduGroupRef=ComIPduGroupRx_ECU1_Project
        ComIPdu_Project_ECU1_Msg_IF1: ComIPduDirection=SEND, ComIPduHandleId=2, ComIPduType=NORMAL, ComIPduSignalRef=ComISignal_Project_ECU1_Msg_IF1_ECU1_Msg_IF1_Sig1, ComIPduSignalRef=ComISignal_Project_ECU1_Msg_IF1_ECU1_Msg_IF1_Sig2, ComPduIdRef=Pdu_ISignalIPdu_Project_ECU1_Msg_IF1, ComIPduGroupRef=ComIPduGroupTx_ECU1_Project
          ComTxIpdu_ComIPdu_Project_ECU1_Msg_IF1 (ComTxIPdu): category=TOOL_CONFIGURED, ComTxIPduUnusedAreasDefault=0, ComMinimumDelayTime=0.02
            ComTxModeTrue_ComTxIpdu_ComIPdu_Project_ECU1_Msg_IF1 (ComTxModeTrue): category=TOOL_CONFIGURED
              ComTxMode_ComTxModeTrue_ComTxIpdu_ComIPdu_Project_ECU1_Msg_IF1 (ComTxMode): category=TOOL_CONFIGURED, ComTxModeNumberOfRepetitions=3, ComTxModeRepetitionPeriod=0.2, ComTxModeMode=DIRECT
        ComIPdu_Project_ECU2_Msg_OE1: ComIPduDirection=RECEIVE, ComIPduHandleId=5, ComIPduType=NORMAL, ComIPduSignalRef=ComISignal_Project_ECU2_Msg_OE1_ECU2_Msg_OE1_Sig1, ComIPduSignalRef=ComISignal_Project_ECU2_Msg_OE1_ECU2_Msg_OE1_Sig2, ComPduIdRef=Pdu_ISignalIPdu_Project_ECU2_Msg_OE1, ComIPduGroupRef=ComIPduGroupRx_ECU1_Project
        ComIPdu_Project_ECU2_Msg_P1: ComIPduDirection=RECEIVE, ComIPduHandleId=6, ComIPduType=NORMAL, ComIPduSignalRef=ComISignal_Project_ECU2_Msg_P1_ECU2_Msg_P1_Sig1, ComIPduSignalRef=ComISignal_Project_ECU2_Msg_P1_ECU2_Msg_P1_Sig2, ComPduIdRef=Pdu_ISignalIPdu_Project_ECU2_Msg_P1, ComIPduGroupRef=ComIPduGroupRx_ECU1_Project
        ComIPdu_Project_ECU1_Msg_POE3: ComIPduDirection=SEND, ComIPduHandleId=13, ComIPduType=NORMAL, ComIPduSignalRef=ComISignal_Project_ECU1_Msg_POE3_ECU1_Msg_POE3_Sig1, ComIPduSignalRef=ComISignal_Project_ECU1_Msg_POE3_ECU1_Msg_POE3_Sig2, ComPduIdRef=Pdu_ISignalIPdu_Project_ECU1_Msg_POE3, ComIPduGroupRef=ComIPduGroupTx_ECU1_Project
          ComTxIpdu_ComIPdu_Project_ECU1_Msg_POE3 (ComTxIPdu): category=TOOL_CONFIGURED, ComTxIPduUnusedAreasDefault=0, ComMinimumDelayTime=0.02
            ComTxModeTrue_ComTxIpdu_ComIPdu_Project_ECU1_Msg_POE3 (ComTxModeTrue): category=TOOL_CONFIGURED
              ComTxMode_ComTxModeTrue_ComTxIpdu_ComIPdu_Project_ECU1_Msg_POE3 (ComTxMode):
                category = TOOL_CONFIGURED
                ComTxModeTimeOffset = 0.0
                ComTxModeTimePeriod = 0.2
                ComTxModeNumberOfRepetitions = 3
                ComTxModeRepetitionPeriod = 0.04
                ComTxModeMode = MIXED
        ComIPdu_Project_ECU1_Msg_TP1: ComIPduDirection=SEND, ComIPduHandleId=1, ComIPduType=TP, ComIPduSignalRef=ComISignal_Project_ECU1_Msg_TP1_Project_ECU1_Msg_TP1_signal, ComPduIdRef=Pdu_ISignalIPdu_Project_ECU1_Msg_TP1, ComIPduGroupRef=ComIPduGroupTx_ECU1_Project
          ComTxIpdu_ComIPdu_Project_ECU1_Msg_TP1 (ComTxIPdu): category=TOOL_CONFIGURED, ComTxIPduUnusedAreasDefault=0, ComMinimumDelayTime=0.0
            ComTxModeTrue_ComTxIpdu_ComIPdu_Project_ECU1_Msg_TP1 (ComTxModeTrue): category=TOOL_CONFIGURED
              ComTxMode_ComTxModeTrue_ComTxIpdu_ComIPdu_Project_ECU1_Msg_TP1 (ComTxMode): category=TOOL_CONFIGURED, ComTxModeNumberOfRepetitions=0, ComTxModeRepetitionPeriod=0.0, ComTxModeMode=DIRECT
        ComIPdu_Project_ECU1_Msg_P4: ComIPduDirection=SEND, ComIPduHandleId=8, ComIPduType=NORMAL, ComIPduSignalRef=ComISignal_Project_ECU1_Msg_P4_ECU1_Msg_P4_Sig1, ComIPduSignalRef=ComISignal_Project_ECU1_Msg_P4_ECU1_Msg_P4_Sig2, ComPduIdRef=Pdu_ISignalIPdu_Project_ECU1_Msg_P4, ComIPduGroupRef=ComIPduGroupTx_ECU1_Project
          ComTxIpdu_ComIPdu_Project_ECU1_Msg_P4 (ComTxIPdu): category=TOOL_CONFIGURED, ComTxIPduUnusedAreasDefault=0, ComMinimumDelayTime=0.02
            ComTxModeTrue_ComTxIpdu_ComIPdu_Project_ECU1_Msg_P4 (ComTxModeTrue): category=TOOL_CONFIGURED
              ComTxMode_ComTxModeTrue_ComTxIpdu_ComIPdu_Project_ECU1_Msg_P4 (ComTxMode): category=TOOL_CONFIGURED, ComTxModeTimeOffset=0.0, ComTxModeTimePeriod=0.2, ComTxModeMode=PERIODIC
        ComIPdu_Project_ECU1_Msg_P3: ComIPduDirection=SEND, ComIPduHandleId=9, ComIPduType=NORMAL, ComIPduSignalRef=ComISignal_Project_ECU1_Msg_P3_ECU1_Msg_P3_Sig1, ComIPduSignalRef=ComISignal_Project_ECU1_Msg_P3_ECU1_Msg_P3_Sig2, ComPduIdRef=Pdu_ISignalIPdu_Project_ECU1_Msg_P3, ComIPduGroupRef=ComIPduGroupTx_ECU1_Project
          ComTxIpdu_ComIPdu_Project_ECU1_Msg_P3 (ComTxIPdu): category=TOOL_CONFIGURED, ComTxIPduUnusedAreasDefault=0, ComMinimumDelayTime=0.02
            ComTxModeTrue_ComTxIpdu_ComIPdu_Project_ECU1_Msg_P3 (ComTxModeTrue): category=TOOL_CONFIGURED
              ComTxMode_ComTxModeTrue_ComTxIpdu_ComIPdu_Project_ECU1_Msg_P3 (ComTxMode): category=TOOL_CONFIGURED, ComTxModeTimeOffset=0.0, ComTxModeTimePeriod=0.2, ComTxModeMode=PERIODIC
        ComIPdu_Project_ECU1_Msg_PIF1: ComIPduDirection=SEND, ComIPduHandleId=7, ComIPduType=NORMAL, ComIPduSignalRef=ComISignal_Project_ECU1_Msg_PIF1_ECU1_Msg_PIF1_Sig1, ComIPduSignalRef=ComISignal_Project_ECU1_Msg_PIF1_ECU1_Msg_PIF1_Sig2, ComPduIdRef=Pdu_ISignalIPdu_Project_ECU1_Msg_PIF1, ComIPduGroupRef=ComIPduGroupTx_ECU1_Project
          ComTxIpdu_ComIPdu_Project_ECU1_Msg_PIF1 (ComTxIPdu): category=TOOL_CONFIGURED, ComTxIPduUnusedAreasDefault=0, ComMinimumDelayTime=0.02
            ComTxModeTrue_ComTxIpdu_ComIPdu_Project_ECU1_Msg_PIF1 (ComTxModeTrue): category=TOOL_CONFIGURED
              ComTxMode_ComTxModeTrue_ComTxIpdu_ComIPdu_Project_ECU1_Msg_PIF1 (ComTxMode):
                category = TOOL_CONFIGURED
                ComTxModeTimeOffset = 0.0
                ComTxModeTimePeriod = 0.5
                ComTxModeNumberOfRepetitions = 3
                ComTxModeRepetitionPeriod = 0.2
                ComTxModeMode = MIXED
        ComIPdu_Project_ECU1_Msg_P2: ComIPduDirection=SEND, ComIPduHandleId=10, ComIPduType=NORMAL, ComIPduSignalRef=ComISignal_Project_ECU1_Msg_P2_ECU1_Msg_P2_Sig1, ComIPduSignalRef=ComISignal_Project_ECU1_Msg_P2_ECU1_Msg_P2_Sig2, ComPduIdRef=Pdu_ISignalIPdu_Project_ECU1_Msg_P2, ComIPduGroupRef=ComIPduGroupTx_ECU1_Project
          ComTxIpdu_ComIPdu_Project_ECU1_Msg_P2 (ComTxIPdu): category=TOOL_CONFIGURED, ComTxIPduUnusedAreasDefault=0, ComMinimumDelayTime=0.02
            ComTxModeTrue_ComTxIpdu_ComIPdu_Project_ECU1_Msg_P2 (ComTxModeTrue): category=TOOL_CONFIGURED
              ComTxMode_ComTxModeTrue_ComTxIpdu_ComIPdu_Project_ECU1_Msg_P2 (ComTxMode): category=TOOL_CONFIGURED, ComTxModeTimeOffset=0.0, ComTxModeTimePeriod=0.2, ComTxModeMode=PERIODIC
        ComIPdu_Project_ECU1_Msg_P1: ComIPduDirection=SEND, ComIPduHandleId=6, ComIPduType=NORMAL, ComIPduSignalRef=ComISignal_Project_ECU1_Msg_P1_ECU1_Msg_P1_Sig1, ComIPduSignalRef=ComISignal_Project_ECU1_Msg_P1_ECU1_Msg_P1_Sig2, ComPduIdRef=Pdu_ISignalIPdu_Project_ECU1_Msg_P1, ComIPduGroupRef=ComIPduGroupTx_ECU1_Project
          ComTxIpdu_ComIPdu_Project_ECU1_Msg_P1 (ComTxIPdu): category=TOOL_CONFIGURED, ComTxIPduUnusedAreasDefault=0, ComMinimumDelayTime=0.02
            ComTxModeTrue_ComTxIpdu_ComIPdu_Project_ECU1_Msg_P1 (ComTxModeTrue): category=TOOL_CONFIGURED
              ComTxMode_ComTxModeTrue_ComTxIpdu_ComIPdu_Project_ECU1_Msg_P1 (ComTxMode): category=TOOL_CONFIGURED, ComTxModeTimeOffset=0.0, ComTxModeTimePeriod=0.5, ComTxModeMode=PERIODIC
        ComIPdu_Project_ECU1_Msg_POE2: ComIPduDirection=SEND, ComIPduHandleId=11, ComIPduType=NORMAL, ComIPduSignalRef=ComISignal_Project_ECU1_Msg_POE2_ECU1_Msg_POE2_Sig1, ComIPduSignalRef=ComISignal_Project_ECU1_Msg_POE2_ECU1_Msg_POE2_Sig2, ComPduIdRef=Pdu_ISignalIPdu_Project_ECU1_Msg_POE2, ComIPduGroupRef=ComIPduGroupTx_ECU1_Project
          ComTxIpdu_ComIPdu_Project_ECU1_Msg_POE2 (ComTxIPdu): category=TOOL_CONFIGURED, ComTxIPduUnusedAreasDefault=0, ComMinimumDelayTime=0.02
            ComTxModeTrue_ComTxIpdu_ComIPdu_Project_ECU1_Msg_POE2 (ComTxModeTrue): category=TOOL_CONFIGURED
              ComTxMode_ComTxModeTrue_ComTxIpdu_ComIPdu_Project_ECU1_Msg_POE2 (ComTxMode):
                category = TOOL_CONFIGURED
                ComTxModeTimeOffset = 0.0
                ComTxModeTimePeriod = 0.2
                ComTxModeNumberOfRepetitions = 3
                ComTxModeRepetitionPeriod = 0.04
                ComTxModeMode = MIXED
        ComIPdu_Project_ECU1_Msg_POE1: ComIPduDirection=SEND, ComIPduHandleId=12, ComIPduType=NORMAL, ComIPduSignalRef=ComISignal_Project_ECU1_Msg_POE1_ECU1_Msg_POE1_Sig1, ComIPduSignalRef=ComISignal_Project_ECU1_Msg_POE1_ECU1_Msg_POE1_Sig2, ComPduIdRef=Pdu_ISignalIPdu_Project_ECU1_Msg_POE1, ComIPduGroupRef=ComIPduGroupTx_ECU1_Project
          ComTxIpdu_ComIPdu_Project_ECU1_Msg_POE1 (ComTxIPdu): category=TOOL_CONFIGURED, ComTxIPduUnusedAreasDefault=0, ComMinimumDelayTime=0.02
            ComTxModeTrue_ComTxIpdu_ComIPdu_Project_ECU1_Msg_POE1 (ComTxModeTrue): category=TOOL_CONFIGURED
              ComTxMode_ComTxModeTrue_ComTxIpdu_ComIPdu_Project_ECU1_Msg_POE1 (ComTxMode):
                category = TOOL_CONFIGURED
                ComTxModeTimeOffset = 0.0
                ComTxModeTimePeriod = 0.2
                ComTxModeNumberOfRepetitions = 3
                ComTxModeRepetitionPeriod = 0.04
                ComTxModeMode = MIXED
        ComIPdu_Project_ECU1_Msg_OE2: ComIPduDirection=SEND, ComIPduHandleId=4, ComIPduType=NORMAL, ComIPduSignalRef=ComISignal_Project_ECU1_Msg_OE2_ECU1_Msg_OE2_Sig1, ComIPduSignalRef=ComISignal_Project_ECU1_Msg_OE2_ECU1_Msg_OE2_Sig2, ComIPduSignalRef=ComISignal_Project_ECU1_Msg_OE2_ECU1_Msg_OE2_Sig3, ComIPduSignalRef=ComISignal_Project_ECU1_Msg_OE2_ECU1_Msg_OE2_Sig4, ComIPduSignalRef=ComISignal_Project_ECU1_Msg_OE2_ECU1_Msg_OE2_Sig5, ComPduIdRef=Pdu_ISignalIPdu_Project_ECU1_Msg_OE2, ComIPduGroupRef=ComIPduGroupTx_ECU1_Project
          ComTxIpdu_ComIPdu_Project_ECU1_Msg_OE2 (ComTxIPdu): category=TOOL_CONFIGURED, ComTxIPduUnusedAreasDefault=0, ComMinimumDelayTime=0.02
            ComTxModeTrue_ComTxIpdu_ComIPdu_Project_ECU1_Msg_OE2 (ComTxModeTrue): category=TOOL_CONFIGURED
              ComTxMode_ComTxModeTrue_ComTxIpdu_ComIPdu_Project_ECU1_Msg_OE2 (ComTxMode): category=TOOL_CONFIGURED, ComTxModeNumberOfRepetitions=3, ComTxModeRepetitionPeriod=0.04, ComTxModeMode=DIRECT
        ComIPdu_Project_ECU1_Msg_OE1: ComIPduDirection=SEND, ComIPduHandleId=5, ComIPduType=NORMAL, ComIPduSignalRef=ComISignal_Project_ECU1_Msg_OE1_ECU1_Msg_OE1_Sig1, ComIPduSignalRef=ComISignal_Project_ECU1_Msg_OE1_ECU1_Msg_OE1_Sig2, ComPduIdRef=Pdu_ISignalIPdu_Project_ECU1_Msg_OE1, ComIPduGroupRef=ComIPduGroupTx_ECU1_Project
          ComTxIpdu_ComIPdu_Project_ECU1_Msg_OE1 (ComTxIPdu): category=TOOL_CONFIGURED, ComTxIPduUnusedAreasDefault=0, ComMinimumDelayTime=0.02
            ComTxModeTrue_ComTxIpdu_ComIPdu_Project_ECU1_Msg_OE1 (ComTxModeTrue): category=TOOL_CONFIGURED
              ComTxMode_ComTxModeTrue_ComTxIpdu_ComIPdu_Project_ECU1_Msg_OE1 (ComTxMode): category=TOOL_CONFIGURED, ComTxModeNumberOfRepetitions=3, ComTxModeRepetitionPeriod=0.04, ComTxModeMode=DIRECT
      48 x ComSignal, all with category=TOOL_CONFIGURED, ComSigReportIdsMEnable=0:
        ComISignal_Project_DriverStatus_BrakeSw: ComBitPosition=0, ComBitSize=1, ComSignalEndianness=LITTLE_ENDIAN, ComSignalInitValue=0, ComSignalLength=1, ComSignalType=BOOLEAN, ComTransferProperty=PENDING, ComHandleId=29, ComSystemTemplateSystemSignalRef=BrakeSw
        ComISignal_Project_DriverStatus_AccelSw: ComBitPosition=1, ComBitSize=1, ComSignalEndianness=LITTLE_ENDIAN, ComSignalInitValue=0, ComSignalLength=1, ComSignalType=BOOLEAN, ComTransferProperty=PENDING, ComHandleId=30, ComSystemTemplateSystemSignalRef=AccelSw
        ComISignal_Project_DriverStatus_SocLevel: ComBitPosition=2, ComBitSize=2, ComSignalEndianness=LITTLE_ENDIAN, ComSignalInitValue=0, ComSignalLength=1, ComSignalType=UINT8, ComTransferProperty=PENDING, ComHandleId=31, ComSystemTemplateSystemSignalRef=SocLevel
        ComISignal_Project_DriverStatus_DriverInputFault: ComBitPosition=4, ComBitSize=2, ComSignalEndianness=LITTLE_ENDIAN, ComSignalInitValue=0, ComSignalLength=1, ComSignalType=UINT8, ComTransferProperty=PENDING, ComHandleId=32, ComSystemTemplateSystemSignalRef=DriverInputFault
        ComISignal_Project_DriverStatus_AliveCounter: ComBitPosition=8, ComBitSize=4, ComSignalEndianness=LITTLE_ENDIAN, ComSignalInitValue=0, ComSignalLength=1, ComSignalType=UINT8, ComTransferProperty=PENDING, ComHandleId=33, ComSystemTemplateSystemSignalRef=AliveCounter
        ComISignal_Project_DriverStatus_VehicleSpeed: ComBitPosition=16, ComBitSize=8, ComSignalEndianness=LITTLE_ENDIAN, ComSignalInitValue=0, ComSignalLength=1, ComSignalType=UINT8, ComTransferProperty=PENDING, ComHandleId=34, ComSystemTemplateSystemSignalRef=VehicleSpeed
        ComISignal_Project_ECU1_Msg_GW1_ECU1_Msg_GW1_Sig1: ComBitPosition=7, ComBitSize=8, ComSignalEndianness=BIG_ENDIAN, ComSignalInitValue=0, ComSignalLength=1, ComSignalType=UINT8, ComTransferProperty=TRIGGERED, ComHandleId=4, ComSystemTemplateSystemSignalRef=ECU1_Msg_GW1_Sig1
        ComISignal_Project_ECU1_Msg_GW1_ECU1_Msg_GW1_Sig2: ComBitPosition=15, ComBitSize=8, ComSignalEndianness=BIG_ENDIAN, ComSignalInitValue=0, ComSignalLength=1, ComSignalType=UINT8, ComTransferProperty=TRIGGERED, ComHandleId=5, ComSystemTemplateSystemSignalRef=ECU1_Msg_GW1_Sig2
        ComISignal_Project_ECU1_Msg_IF1_ECU1_Msg_IF1_Sig1: ComBitPosition=7, ComBitSize=8, ComSignalEndianness=BIG_ENDIAN, ComSignalInitValue=0, ComSignalLength=1, ComSignalType=UINT8, ComTransferProperty=TRIGGERED, ComHandleId=2, ComSystemTemplateSystemSignalRef=ECU1_Msg_IF1_Sig1
        ComISignal_Project_ECU1_Msg_IF1_ECU1_Msg_IF1_Sig2: ComBitPosition=15, ComBitSize=8, ComSignalEndianness=BIG_ENDIAN, ComSignalInitValue=0, ComSignalLength=1, ComSignalType=UINT8, ComTransferProperty=TRIGGERED, ComHandleId=3, ComSystemTemplateSystemSignalRef=ECU1_Msg_IF1_Sig2
        ComISignal_Project_ECU1_Msg_OE1_ECU1_Msg_OE1_Sig1: ComBitPosition=7, ComBitSize=8, ComSignalEndianness=BIG_ENDIAN, ComSignalInitValue=0, ComSignalLength=1, ComSignalType=UINT8, ComTransferProperty=TRIGGERED_WITHOUT_REPETITION, ComHandleId=11, ComSystemTemplateSystemSignalRef=ECU1_Msg_OE1_Sig1
        ComISignal_Project_ECU1_Msg_OE1_ECU1_Msg_OE1_Sig2: ComBitPosition=12, ComBitSize=8, ComSignalEndianness=LITTLE_ENDIAN, ComSignalInitValue=0, ComSignalLength=1, ComSignalType=UINT8, ComTransferProperty=TRIGGERED_ON_CHANGE_WITHOUT_REPETITION, ComHandleId=12, ComSystemTemplateSystemSignalRef=ECU1_Msg_OE1_Sig2
        ComISignal_Project_ECU1_Msg_OE2_ECU1_Msg_OE2_Sig1: ComBitPosition=7, ComBitSize=8, ComSignalEndianness=BIG_ENDIAN, ComSignalInitValue=0, ComSignalLength=1, ComSignalType=UINT8, ComTransferProperty=TRIGGERED, ComHandleId=6, ComSystemTemplateSystemSignalRef=ECU1_Msg_OE2_Sig1
        ComISignal_Project_ECU1_Msg_OE2_ECU1_Msg_OE2_Sig2: ComBitPosition=11, ComBitSize=8, ComSignalEndianness=BIG_ENDIAN, ComSignalInitValue=0, ComSignalLength=1, ComSignalType=UINT8, ComTransferProperty=TRIGGERED_ON_CHANGE, ComHandleId=7, ComSystemTemplateSystemSignalRef=ECU1_Msg_OE2_Sig2
        ComISignal_Project_ECU1_Msg_OE2_ECU1_Msg_OE2_Sig3: ComBitPosition=17, ComBitSize=2, ComSignalEndianness=BIG_ENDIAN, ComSignalInitValue=0, ComSignalLength=1, ComSignalType=UINT8, ComTransferProperty=TRIGGERED_ON_CHANGE, ComHandleId=8, ComSystemTemplateSystemSignalRef=ECU1_Msg_OE2_Sig3
        ComISignal_Project_ECU1_Msg_OE2_ECU1_Msg_OE2_Sig4: ComBitPosition=26, ComBitSize=3, ComSignalEndianness=BIG_ENDIAN, ComSignalInitValue=0, ComSignalLength=1, ComSignalType=UINT8, ComTransferProperty=TRIGGERED_ON_CHANGE, ComHandleId=9, ComSystemTemplateSystemSignalRef=ECU1_Msg_OE2_Sig4
        ComISignal_Project_ECU1_Msg_OE2_ECU1_Msg_OE2_Sig5: ComBitPosition=35, ComBitSize=4, ComSignalEndianness=BIG_ENDIAN, ComSignalInitValue=0, ComSignalLength=1, ComSignalType=UINT8, ComTransferProperty=TRIGGERED_ON_CHANGE, ComHandleId=10, ComSystemTemplateSystemSignalRef=ECU1_Msg_OE2_Sig5
        ComISignal_Project_ECU1_Msg_P1_ECU1_Msg_P1_Sig1: ComBitPosition=7, ComBitSize=8, ComSignalEndianness=BIG_ENDIAN, ComSignalInitValue=0, ComSignalLength=1, ComSignalType=UINT8, ComTransferProperty=PENDING, ComHandleId=13, ComSystemTemplateSystemSignalRef=ECU1_Msg_P1_Sig1
        ComISignal_Project_ECU1_Msg_P1_ECU1_Msg_P1_Sig2: ComBitPosition=15, ComBitSize=8, ComSignalEndianness=BIG_ENDIAN, ComSignalInitValue=0, ComSignalLength=1, ComSignalType=UINT8, ComTransferProperty=PENDING, ComHandleId=14, ComSystemTemplateSystemSignalRef=ECU1_Msg_P1_Sig2
        ComISignal_Project_ECU1_Msg_P2_ECU1_Msg_P2_Sig1: ComBitPosition=7, ComBitSize=8, ComSignalEndianness=BIG_ENDIAN, ComSignalInitValue=0, ComSignalLength=1, ComSignalType=UINT8, ComTransferProperty=PENDING, ComHandleId=21, ComSystemTemplateSystemSignalRef=ECU1_Msg_P2_Sig1
        ComISignal_Project_ECU1_Msg_P2_ECU1_Msg_P2_Sig2: ComBitPosition=15, ComBitSize=8, ComSignalEndianness=BIG_ENDIAN, ComSignalInitValue=0, ComSignalLength=1, ComSignalType=UINT8, ComTransferProperty=PENDING, ComHandleId=22, ComSystemTemplateSystemSignalRef=ECU1_Msg_P2_Sig2
        ComISignal_Project_ECU1_Msg_P3_ECU1_Msg_P3_Sig1: ComBitPosition=7, ComBitSize=8, ComSignalEndianness=BIG_ENDIAN, ComSignalInitValue=0, ComSignalLength=1, ComSignalType=UINT8, ComTransferProperty=PENDING, ComHandleId=19, ComSystemTemplateSystemSignalRef=ECU1_Msg_P3_Sig1
        ComISignal_Project_ECU1_Msg_P3_ECU1_Msg_P3_Sig2: ComBitPosition=15, ComBitSize=8, ComSignalEndianness=BIG_ENDIAN, ComSignalInitValue=0, ComSignalLength=1, ComSignalType=UINT8, ComTransferProperty=PENDING, ComHandleId=20, ComSystemTemplateSystemSignalRef=ECU1_Msg_P3_Sig2
        ComISignal_Project_ECU1_Msg_P4_ECU1_Msg_P4_Sig1: ComBitPosition=7, ComBitSize=8, ComSignalEndianness=BIG_ENDIAN, ComSignalInitValue=0, ComSignalLength=1, ComSignalType=UINT8, ComTransferProperty=PENDING, ComHandleId=17, ComSystemTemplateSystemSignalRef=ECU1_Msg_P4_Sig1
        ComISignal_Project_ECU1_Msg_P4_ECU1_Msg_P4_Sig2: ComBitPosition=15, ComBitSize=8, ComSignalEndianness=BIG_ENDIAN, ComSignalInitValue=0, ComSignalLength=1, ComSignalType=UINT8, ComTransferProperty=PENDING, ComHandleId=18, ComSystemTemplateSystemSignalRef=ECU1_Msg_P4_Sig2
        ComISignal_Project_ECU1_Msg_PIF1_ECU1_Msg_PIF1_Sig1: ComBitPosition=7, ComBitSize=8, ComSignalEndianness=BIG_ENDIAN, ComSignalInitValue=0, ComSignalLength=1, ComSignalType=UINT8, ComTransferProperty=TRIGGERED, ComHandleId=15, ComSystemTemplateSystemSignalRef=ECU1_Msg_PIF1_Sig1
        ComISignal_Project_ECU1_Msg_PIF1_ECU1_Msg_PIF1_Sig2: ComBitPosition=15, ComBitSize=8, ComSignalEndianness=BIG_ENDIAN, ComSignalInitValue=0, ComSignalLength=1, ComSignalType=UINT8, ComTransferProperty=TRIGGERED, ComHandleId=16, ComSystemTemplateSystemSignalRef=ECU1_Msg_PIF1_Sig2
        ComISignal_Project_ECU1_Msg_POE1_ECU1_Msg_POE1_Sig1: ComBitPosition=7, ComBitSize=8, ComSignalEndianness=BIG_ENDIAN, ComSignalInitValue=0, ComSignalLength=1, ComSignalType=UINT8, ComTransferProperty=TRIGGERED_WITHOUT_REPETITION, ComHandleId=25, ComSystemTemplateSystemSignalRef=ECU1_Msg_POE1_Sig1
        ComISignal_Project_ECU1_Msg_POE1_ECU1_Msg_POE1_Sig2: ComBitPosition=15, ComBitSize=8, ComSignalEndianness=BIG_ENDIAN, ComSignalInitValue=0, ComSignalLength=1, ComSignalType=UINT8, ComTransferProperty=TRIGGERED_ON_CHANGE_WITHOUT_REPETITION, ComHandleId=26, ComSystemTemplateSystemSignalRef=ECU1_Msg_POE1_Sig2
        ComISignal_Project_ECU1_Msg_POE2_ECU1_Msg_POE2_Sig1: ComBitPosition=7, ComBitSize=8, ComSignalEndianness=BIG_ENDIAN, ComSignalInitValue=0, ComSignalLength=1, ComSignalType=UINT8, ComTransferProperty=TRIGGERED, ComHandleId=23, ComSystemTemplateSystemSignalRef=ECU1_Msg_POE2_Sig1
        ComISignal_Project_ECU1_Msg_POE2_ECU1_Msg_POE2_Sig2: ComBitPosition=15, ComBitSize=8, ComSignalEndianness=BIG_ENDIAN, ComSignalInitValue=0, ComSignalLength=1, ComSignalType=UINT8, ComTransferProperty=TRIGGERED_ON_CHANGE, ComHandleId=24, ComSystemTemplateSystemSignalRef=ECU1_Msg_POE2_Sig2
        ComISignal_Project_ECU1_Msg_POE3_ECU1_Msg_POE3_Sig1: ComBitPosition=7, ComBitSize=8, ComSignalEndianness=BIG_ENDIAN, ComSignalInitValue=0, ComSignalLength=1, ComSignalType=UINT8, ComTransferProperty=TRIGGERED_WITHOUT_REPETITION, ComHandleId=27, ComSystemTemplateSystemSignalRef=ECU1_Msg_POE3_Sig1
        ComISignal_Project_ECU1_Msg_POE3_ECU1_Msg_POE3_Sig2: ComBitPosition=15, ComBitSize=8, ComSignalEndianness=BIG_ENDIAN, ComSignalInitValue=0, ComSignalLength=1, ComSignalType=UINT8, ComTransferProperty=TRIGGERED_ON_CHANGE_WITHOUT_REPETITION, ComHandleId=28, ComSystemTemplateSystemSignalRef=ECU1_Msg_POE3_Sig2
        ComISignal_Project_ECU1_Msg_TP1_Project_ECU1_Msg_TP1_signal: ComBitPosition=0, ComSignalEndianness=opaque, ComSignalInitValue=0 0 0 0 0 0 0 0, ComSignalLength=8, ComSignalType=UINT8_N, ComTransferProperty=TRIGGERED_WITHOUT_REPETITION, ComHandleId=1, ComSystemTemplateSystemSignalRef=Project_ECU1_Msg_TP1_signal
        ComISignal_Project_ECU1_Msg_TP2_Project_ECU1_Msg_TP2_signal: ComBitPosition=0, ComSignalEndianness=opaque, ComSignalInitValue=0 0 0 0 0 0 0 0, ComSignalLength=8, ComSignalType=UINT8_N, ComTransferProperty=TRIGGERED_WITHOUT_REPETITION, ComHandleId=0, ComSystemTemplateSystemSignalRef=Project_ECU1_Msg_TP2_signal
        ComISignal_Project_ECU2_Msg_OE1_ECU2_Msg_OE1_Sig1: ComBitPosition=7, ComBitSize=8, ComSignalEndianness=BIG_ENDIAN, ComSignalInitValue=0, ComSignalLength=1, ComSignalType=UINT8, ComTransferProperty=TRIGGERED_WITHOUT_REPETITION, ComHandleId=9, ComTimeout=0.0, ComSystemTemplateSystemSignalRef=ECU2_Msg_OE1_Sig1
        ComISignal_Project_ECU2_Msg_OE1_ECU2_Msg_OE1_Sig2: ComBitPosition=15, ComBitSize=8, ComSignalEndianness=BIG_ENDIAN, ComSignalInitValue=0, ComSignalLength=1, ComSignalType=UINT8, ComTransferProperty=TRIGGERED_WITHOUT_REPETITION, ComHandleId=10, ComTimeout=0.0, ComSystemTemplateSystemSignalRef=ECU2_Msg_OE1_Sig2
        ComISignal_Project_ECU2_Msg_P1_ECU2_Msg_P1_Sig1: ComBitPosition=7, ComBitSize=8, ComSignalEndianness=BIG_ENDIAN, ComSignalInitValue=0, ComSignalLength=1, ComSignalType=UINT8, ComTransferProperty=PENDING, ComHandleId=11, ComTimeout=0.0, ComSystemTemplateSystemSignalRef=ECU2_Msg_P1_Sig1
        ComISignal_Project_ECU2_Msg_P1_ECU2_Msg_P1_Sig2: ComBitPosition=15, ComBitSize=8, ComSignalEndianness=BIG_ENDIAN, ComSignalInitValue=0, ComSignalLength=1, ComSignalType=UINT8, ComTransferProperty=PENDING, ComHandleId=12, ComTimeout=0.0, ComSystemTemplateSystemSignalRef=ECU2_Msg_P1_Sig2
        ComISignal_Project_ECU2_Msg_PIF1_ECU2_Msg_PIF1_Sig1: ComBitPosition=23, ComBitSize=8, ComSignalEndianness=BIG_ENDIAN, ComSignalInitValue=0, ComSignalLength=1, ComSignalType=UINT8, ComTransferProperty=TRIGGERED, ComHandleId=5, ComTimeout=0.0, ComSystemTemplateSystemSignalRef=ECU2_Msg_PIF1_Sig1
        ComISignal_Project_ECU2_Msg_PIF1_ECU2_Msg_PIF1_Sig2: ComBitPosition=31, ComBitSize=8, ComSignalEndianness=BIG_ENDIAN, ComSignalInitValue=0, ComSignalLength=1, ComSignalType=UINT8, ComTransferProperty=TRIGGERED, ComHandleId=6, ComTimeout=0.0, ComSystemTemplateSystemSignalRef=ECU2_Msg_PIF1_Sig2
        ComISignal_Project_ECU2_Msg_POE1_ECU2_Msg_POE1_Sig2: ComBitPosition=23, ComBitSize=8, ComSignalEndianness=BIG_ENDIAN, ComSignalInitValue=0, ComSignalLength=1, ComSignalType=UINT8, ComTransferProperty=TRIGGERED_ON_CHANGE, ComHandleId=7, ComTimeout=0.0, ComSystemTemplateSystemSignalRef=ECU2_Msg_POE1_Sig2
        ComISignal_Project_ECU2_Msg_POE1_ECU2_Msg_POE1_Sig1: ComBitPosition=31, ComBitSize=8, ComSignalEndianness=BIG_ENDIAN, ComSignalInitValue=0, ComSignalLength=1, ComSignalType=UINT8, ComTransferProperty=TRIGGERED, ComHandleId=8, ComTimeout=0.0, ComSystemTemplateSystemSignalRef=ECU2_Msg_POE1_Sig1
        ComISignal_Project_GST_Msg_TP1_Project_GST_Msg_TP1_signal: ComBitPosition=0, ComSignalEndianness=opaque, ComSignalInitValue=0 0 0 0 0 0 0 0, ComSignalLength=8, ComSignalType=UINT8_N, ComTransferProperty=TRIGGERED_WITHOUT_REPETITION, ComHandleId=4, ComTimeout=0.0, ComSystemTemplateSystemSignalRef=Project_GST_Msg_TP1_signal
        ComISignal_Project_GST_Msg_TP2_Project_GST_Msg_TP2_signal: ComBitPosition=0, ComSignalEndianness=opaque, ComSignalInitValue=0 0 0 0 0 0 0 0, ComSignalLength=8, ComSignalType=UINT8_N, ComTransferProperty=TRIGGERED_WITHOUT_REPETITION, ComHandleId=3, ComTimeout=0.0, ComSystemTemplateSystemSignalRef=Project_GST_Msg_TP2_signal
        ComISignal_Project_VCURegenStatus_RegenEnable: ComBitPosition=0, ComBitSize=1, ComSignalEndianness=LITTLE_ENDIAN, ComSignalInitValue=0, ComSignalLength=1, ComSignalType=BOOLEAN, ComTransferProperty=PENDING, ComHandleId=0, ComTimeout=0.0, ComNotification=Rte_COMCbk_ComISignal_Project_VCURegenStatus_RegenEnable, ComSystemTemplateSystemSignalRef=RegenEnable
        ComISignal_Project_VCURegenStatus_RegenLevel: ComBitPosition=1, ComBitSize=2, ComSignalEndianness=LITTLE_ENDIAN, ComSignalInitValue=0, ComSignalLength=1, ComSignalType=UINT8, ComTransferProperty=PENDING, ComHandleId=1, ComTimeout=0.0, ComNotification=Rte_COMCbk_ComISignal_Project_VCURegenStatus_RegenLevel, ComSystemTemplateSystemSignalRef=RegenLevel
        ComISignal_Project_VCURegenStatus_LimitReason: ComBitPosition=8, ComBitSize=3, ComSignalEndianness=LITTLE_ENDIAN, ComSignalInitValue=0, ComSignalLength=1, ComSignalType=UINT8, ComTransferProperty=PENDING, ComHandleId=2, ComTimeout=0.0, ComNotification=Rte_COMCbk_ComISignal_Project_VCURegenStatus_LimitReason, ComSystemTemplateSystemSignalRef=LimitReason
    ComGeneral:
      ComConfigurationUseDet = 1
      ComEnableMDTForCyclicTransmission = 1
      ComRetryFailedTransmitRequests = 0
      ComSupportedIPduGroups = 2
      ComVersionInfoApi = 0
      ComMainFunctionBasedTransmit = 1
      ComEnableSignalGroupArrayApi = 0
