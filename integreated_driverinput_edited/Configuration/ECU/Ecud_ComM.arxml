AUTOSAR XML (schema 4-0-3)
package /AUTOSAR
  module config ComM: implementation-config-variant=VARIANT-PRE-COMPILE, module-description=BswImplementation_ComM
    ComMConfigSet: ComMPncEnabled=0
      ComMChannel_Project (ComMChannel):
        category = TOOL_CONFIGURED
        ComMBusType = COMM_BUS_TYPE_CAN
        ComMChannelId = 0
        ComMFullCommRequestNotificationEnabled = 0
        ComMGlobalNvmBlockDescriptor = 0
        ComMMainFunctionPeriod = 0.005
        ComMNoCom = 0
        ComMNoWakeup = 0
        ComMNetworkManagement_Project (ComMNetworkManagement): category=TOOL_CONFIGURED, ComMNmLightTimeout=0, ComMNmVariant=LIGHT, ComMPncNmRequest=0
        ComMUserPerChannel_Project (ComMUserPerChannel): category=TOOL_CONFIGURED, ComMUserChannel=ComMUser_Project
      ComMUser_Project (ComMUser): category=TOOL_CONFIGURED, ComMUserIdentifier=0
    ComMGeneral:
      ComMDevErrorDetect = 1
      ComMDirectUserMapping = 0
      ComMEcuGroupClassification = 3
      ComMModeLimitationEnabled = 0
      ComMPncGatewayEnabled = 0
      ComMPncSupport = 0
      ComMSynchronousWakeUp = 0
      ComMTMinFullComModeDuration = 0.01
      ComMVersionInfoApi = 1
      ComMWakeupInhibitionEnabled = 0
      ComMCanCMSupport = 0
