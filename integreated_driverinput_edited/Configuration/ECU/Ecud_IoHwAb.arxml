AUTOSAR XML (schema 4-0-3)
package /AUTOSAR
  module config IoHwAb: implementation-config-variant=VARIANT-PRE-COMPILE, module-description=BswImplementation_IoHwAb
    IoHwAbGeneral: IoHwAbDevErrorDetect=1, IoHwAbVersionInfoApi=0, IoHwAbMcalVendorVersion=FREESCALE_MPC560XB_101HF5
      IoHwAbPortPinChs
        13 x IoHwAbPortPinCh, all with IoHwAbPolarity=HighActive:
          IoHwAbPortPinCh_PortE_Pin0: IoHwAbHwDioChRef=DioPort_E_DioChannel_0, IoHwAbHwPortPinRef=PortContainer_E_PortPin_0
          IoHwAbPortPinCh_PortE_Pin4: IoHwAbHwDioChRef=DioPort_E_DioChannel_4, IoHwAbHwPortPinRef=PortContainer_E_PortPin_4
          IoHwAbPortPinCh_PortG_Pin{6..9}: IoHwAbHwDioChRef=DioPort_G_DioChannel_{6..9}, IoHwAbHwPortPinRef=PortContainer_G_PortPin_{6..9}
          IoHwAbPortPinCh_PortE_Pin{1..3}: IoHwAbHwDioChRef=DioPort_E_DioChannel_{1..3}, IoHwAbHwPortPinRef=PortContainer_E_PortPin_{1..3}
          IoHwAbPortPinCh_PortE_Pin5: IoHwAbHwDioChRef=DioPort_E_DioChannel_5, IoHwAbHwPortPinRef=PortContainer_E_PortPin_5
          IoHwAbPortPinCh_PortB_Pin5: IoHwAbHwDioChRef=DioPort_B_DioChannel_5, IoHwAbHwPortPinRef=PortContainer_B_PortPin_5
          IoHwAbPortPinCh_PortE_Pin6: IoHwAbHwDioChRef=DioPort_E_DioChannel_6, IoHwAbHwPortPinRef=PortContainer_E_PortPin_6
          IoHwAbPortPinCh_PortE_Pin7: IoHwAbHwDioChRef=DioPort_E_DioChannel_7, IoHwAbHwPortPinRef=PortContainer_E_PortPin_7
      IoHwAbAdcSetting: IoHwAbAdcReadDirectMaxDelay=0xFFFF
        IoHwAbAdcGroups
          IoHwAbAdcGroup0 (IoHwAbAdcGroup): IoHwAbHwAdcGroupRef=AdcGroup_0
        IoHwAbAdcAllGroups: IoHwAbHwAdcAllGroupRef=AdcAllGroup0
          IoHwAbAdcGroupInAll: IoHwAbHwAdcGroupRef=AdcGroup_4
    IoHwAbConfig:
      IoHwAbUseLowPowerFlag = 0
      IoHwAbUseDigitalDirect = 1
      IoHwAbUseAnalogInputDirect = 1
      IoHwAbUsePwm = 1
      IoHwAbUseGpt = 1
      IoHwAbUseIcu = 1
      IoHwAbUseOcu = 0
      IoHwAbUseIOManager = 1
      IoHwAbDigitalDirect
        8 x IoHwAbDigitalDirectLogical:
          IoHwAbDigitalDirectLogical_S01: IoHwAbPortPinChRef=(unset), IoHwAbPortPinChRef=IoHwAbPortPinCh_PortE_Pin0
          IoHwAbDigitalDirectLogical_LED01: IoHwAbPortPinChRef=IoHwAbPortPinCh_PortE_Pin4
          IoHwAbDigitalDirectLogical_LED02: IoHwAbPortPinChRef=IoHwAbPortPinCh_PortE_Pin5
          IoHwAbDigitalDirectLogical_LED03: IoHwAbPortPinChRef=IoHwAbPortPinCh_PortE_Pin6
          IoHwAbDigitalDirectLogical_LED04: IoHwAbPortPinChRef=IoHwAbPortPinCh_PortE_Pin7
          IoHwAbDigitalDirectLogical_S02: IoHwAbPortPinChRef=IoHwAbPortPinCh_PortE_Pin1
          IoHwAbDigitalDirectLogical_S03: IoHwAbPortPinChRef=IoHwAbPortPinCh_PortE_Pin2
          IoHwAbDigitalDirectLogical_S04: IoHwAbPortPinChRef=IoHwAbPortPinCh_PortE_Pin3
      IoHwAbAnalogInputDirect
        IoHwAbAnalogInputDirectLogical_Pot (IoHwAbAnalogInputDirectLogical): IoHwAbAdcGroupRef=IoHwAbAdcGroup0
      IoHwAbPwm
        IoHwAbPwm_0 (IoHwAbPwmLogical): IoHwAbPwmCallbackViaRte=0, IoHwAbHwPwmChRef=PwmChannel_0
      IoHwAbGpt
        IoHwAbGptLogical0 (IoHwAbGptLogical): IoHwAbGptCallbackViaRte=1, IoHwAbHwGptChRef=GptChannelConfiguration_IoHwAbTest
      IoHwAbIcu
        IoHwAbIcuLogical_Timestamp_PA8 (IoHwAbIcuLogical): IoHwAbIcuCallbackViaRte=1, IoHwAbHwIcuChRef=IcuChannel_Timestamp
      IoHwAbIOManager:
        IoHwAbUseAnalogInput = 1
        IoHwAbUseDigitalInput = 0
        IoHwAbUseDigitalOutput = 0
        IoHwAbUseInputSupplySwitch = 0
        IoHwAbUseVoltageMonitoring = 0
        IoHwAbMultipleActivationDelay = 200
        IoHwAbTaskFG1Ref = OsTask_BSW_FG1_IOManager
        IoHwAbTaskFG2Ref = OsTask_BSW_FG2_IOManager
        IoHwAbIOMTimer: IoHwAbGptChRef=GptChannelConfiguration_IoHwAbTest
        IoHwAbAnalogInput
          IoHwAbAnalogInputLogical_PD00 (IoHwAbAnalogInputLogical): IoHwAbDirectAccess=1, IoHwAbDefaultValue=0, IoHwAbFilterConstant=0, IoHwAbAdcGroupRef=IoHwAbAdcGroupInAll
      IoHwAbDemEventParameterRefs:
        IOHWAB_E_WRONG_STATE = IOHWAB_E_WRONG_STATE
        IOHWAB_E_WRONG_SETTING = IOHWAB_E_WRONG_SETTING
        IOHWAB_E_WRONG_PARAM = IOHWAB_E_WRONG_PARAM
        IOHWAB_E_SETUP_FAIL = IOHWAB_E_SETUP_FAIL
        IOHWAB_E_PROC_FAIL = IOHWAB_E_PROC_FAIL
        IOHWAB_E_BUSY = IOHWAB_E_BUSY
